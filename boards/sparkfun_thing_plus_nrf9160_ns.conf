## boards/sparkfun_thing_plus_nrf9160_ns.conf
```kconfig
#
# Board-specific config for SparkFun Thing Plus nRF9160 (non-secure)
# Applied automatically when building with -b sparkfun_thing_plus_nrf9160_ns
#
# This board (co-developed by Circuit Dojo LLC) uses:
#   - nRF9160 SiP with integrated LTE-M / NB-IoT modem and GPS receiver
#   - UART0 for console (115200 baud)
#   - LIS2DH accelerometer on I2C1
#   - W25Q32JV 4MB SPI flash
#   - TPS63031 3.3V regulator
#
# Non-Secure build (TrustZone) is REQUIRED for NRF_MODEM_LIB on this board.
#

# Regulator driver (required: TPS63031 power rail in board DTS)
CONFIG_REGULATOR=y
```
