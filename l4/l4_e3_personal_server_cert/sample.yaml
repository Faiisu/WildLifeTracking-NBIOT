## l4/l4_e3_personal_server_cert/sample.yaml
```yaml
sample:
  name: Lesson 4 Exercise 3 Personal Server Certificate Version
tests:
  cellular_fundamentals.l4.e3_personal_server_cert:
    build_only: true
    platform_allow: nrf9160dk_nrf9160_ns nrf9161dk_nrf9161_ns thingy91_nrf9160_ns thingy91x_nrf9151_ns
    tags: cellular
```
