## CMakeLists.txt
```
#
# Copyright (c) 2026 Cellular Asset Tracker Project
# SPDX-License-Identifier: Apache-2.0
#

cmake_minimum_required(VERSION 3.20.0)

# Load local broker endpoint/credentials overlay when present (ignored by Git).
set(SLEEP_APP_MQTT_CREDENTIALS_FILE
  ${CMAKE_CURRENT_SOURCE_DIR}/config/mqtt-credentials.conf
)
if(EXISTS ${SLEEP_APP_MQTT_CREDENTIALS_FILE})
  set(EXTRA_CONF_FILE ${SLEEP_APP_MQTT_CREDENTIALS_FILE} ${EXTRA_CONF_FILE})
endif()

find_package(Zephyr REQUIRED HINTS $ENV{ZEPHYR_BASE})
project(sleep_mode_sys_off)

# The broker CA is a local deployment asset (never commit to Git).
set(SLEEP_APP_CERT_GEN_DIR ${CMAKE_CURRENT_BINARY_DIR}/certs)
zephyr_include_directories(${SLEEP_APP_CERT_GEN_DIR})
if(EXISTS ${CMAKE_CURRENT_SOURCE_DIR}/credentials/ca-cert.pem)
  generate_inc_file_for_target(app credentials/ca-cert.pem
    ${SLEEP_APP_CERT_GEN_DIR}/ca-cert.pem)
endif()

target_sources(app PRIVATE
  src/main.c
  src/tracker_mqtt.c
)
```

## Kconfig
```
#
# Copyright (c) 2026 Cellular Asset Tracker Project
# SPDX-License-Identifier: Apache-2.0
#

menu "Sleep Mode 2: nRF9160 System OFF + Motion Wake-up"

config SLEEP_APP_LTE_CONNECT_TIMEOUT_SECONDS
	int "LTE registration timeout in seconds"
	default 30
	range 10 300
	help
	  Maximum time to wait for home or roaming LTE registration. If LTE is
	  not found within this timeout, the firmware shuts down the modem and
	  goes directly to System OFF.

config SLEEP_APP_CELL_MEAS_TIMEOUT_SECONDS
	int "LTE cell location measurement timeout in seconds"
	default 30
	range 5 180
	help
	  Maximum time to wait for LTE_LC_EVT_NEIGHBOR_CELL_MEAS before
	  cancelling and entering System OFF.

config TRACKER_MAX_NEIGHBOR_CELLS
	int "Maximum neighbor cells stored per report"
	default 6
	range 0 16
	help
	  Maximum number of neighbor cells retained in each cell report JSON
	  payload.

config SLEEP_APP_MOTION_WAKEUP
	bool "Enable LIS2DH12 motion wake-up from System OFF"
	default n
	help
	  Configures the on-board LIS2DH12 accelerometer (accel0) in low-power
	  any-motion mode on INT1 (P0.29) and arms GPIO level sense before
	  entering System OFF. Disabled by default in favor of MODE button
	  (sw0) wake-up.

config SLEEP_APP_MOTION_THRESHOLD_MS2
	int "Motion wake-up threshold in m/s^2"
	default 2
	range 1 19
	depends on SLEEP_APP_MOTION_WAKEUP
	help
	  Slope acceleration threshold in m/s^2 for LIS2DH12 any-motion
	  interrupt (e.g., 2 m/s^2 is approximately 0.2 g).

config SLEEP_APP_MOTION_DURATION_SAMPLES
	int "Motion wake-up duration in ODR samples"
	default 1
	range 0 127
	depends on SLEEP_APP_MOTION_WAKEUP
	help
	  Number of consecutive ODR samples above threshold required to assert
	  the motion interrupt (at 10 Hz ODR, 1 sample is 100 ms).

config SLEEP_APP_BUTTON_WAKEUP
	bool "Also allow sw0 (MODE button) to wake from System OFF"
	default y
	help
	  Arms sw0 (P0.12) with GPIO_INT_LEVEL_ACTIVE so pressing MODE also
	  wakes the nRF9160 from System OFF on the bench.

config SLEEP_APP_STATUS_LED
	bool "Blink board LED0 while searching for LTE"
	default y
	help
	  Blinks led0 while searching for LTE so bench operation is visible
	  without a debugger. Disable (or use release.conf) during microamp
	  power measurements.

config SLEEP_APP_LTE_BLINK_INTERVAL_MS
	int "LED0 blink half-period while searching for LTE (ms)"
	default 250
	range 50 2000
	depends on SLEEP_APP_STATUS_LED
	help
	  Interval in milliseconds between LED0 toggles while waiting for LTE
	  registration.

config MQTT_BROKER_HOSTNAME
	string "MQTT Broker Hostname"
	default "test.mosquitto.org"
	help
	  Hostname or IP address of the target MQTT broker.

config MQTT_BROKER_PORT
	int "MQTT Broker Port"
	default 8883
	help
	  Port number of the target MQTT broker (1883 plaintext, 8883 TLS).

config MQTT_PUB_TOPIC
	string "MQTT Publish Topic"
	default "test/nrf91/cell"
	help
	  MQTT topic to publish LTE serving and neighbor cell measurements.

config MQTT_PUB_QOS
	int "MQTT publish QoS"
	range 0 1
	default 1
	help
	  0 sends at most once; 1 sends at least once and waits for PUBACK.

config MQTT_CLIENT_ID
	string "MQTT Client ID (leave blank to use IMEI)"
	default ""
	help
	  Custom MQTT client ID. If empty, nrf-<IMEI> is derived via AT+CGSN.

config MQTT_BROKER_USERNAME
	string "MQTT broker username"
	default ""
	help
	  Optional MQTT username. Keep real credentials in git-ignored
	  config/mqtt-credentials.conf.

config MQTT_BROKER_PASSWORD
	string "MQTT broker password"
	default ""
	help
	  Optional MQTT password (requires non-empty username). Keep real
	  credentials in git-ignored config/mqtt-credentials.conf.

endmenu

source "Kconfig.zephyr"
```

## sample.yaml
```
sample:
  description: System 2 deep-sleep firmware using nRF9160 System OFF and LIS2DH12 motion GPIO wake-up
  name: Sleep Mode 2 (System OFF + Motion Wake-up)

common:
  sysbuild: true
  build_only: true
  integration_platforms:
    - sparkfun_thing_plus/nrf9160/ns
  platform_allow:
    - circuitdojo_feather/nrf9160/ns
    - sparkfun_thing_plus/nrf9160/ns

tests:
  app.sleep_mode_sys_off: {}
```

## prj.conf
```kconfig
#
# Copyright (c) 2026 Cellular Asset Tracker Project
# SPDX-License-Identifier: Apache-2.0
#

# Application memory sizing (sized for MQTT + TLS + cell JSON formatting)
CONFIG_MAIN_STACK_SIZE=8192
CONFIG_HEAP_MEM_POOL_SIZE=8192

# RTT-only logging; keep UART/console disabled to avoid serial power draw
CONFIG_LOG=y
CONFIG_USE_SEGGER_RTT=y
CONFIG_LOG_BACKEND_RTT=y
CONFIG_LOG_BACKEND_RTT_MODE_DROP=y
CONFIG_LOG_BACKEND_UART=n
CONFIG_SERIAL=n
CONFIG_CONSOLE=n
CONFIG_UART_CONSOLE=n
CONFIG_UART_INTERRUPT_DRIVEN=n
CONFIG_TFM_LOG_LEVEL_SILENCE=y
CONFIG_TFM_SECURE_UART=n

# System OFF, reset cause reporting, and device power management
CONFIG_POWEROFF=y
CONFIG_HWINFO=y
CONFIG_PM_DEVICE=y
CONFIG_FLASH=y
CONFIG_SPI_NOR=y

# Modem, LTE Link Control, and Cell Measurement
CONFIG_NRF_MODEM_LIB=y
CONFIG_LTE_LINK_CONTROL=y
CONFIG_LTE_NETWORK_MODE_LTE_M_NBIOT=y
CONFIG_LTE_LC_NEIGHBOR_CELL_MEAS_MODULE=y
CONFIG_LTE_NEIGHBOR_CELLS_MAX=6

# Networking offload required by nRF modem library
CONFIG_NETWORKING=y
CONFIG_NET_NATIVE=n
CONFIG_NET_SOCKETS=y
CONFIG_NET_SOCKETS_OFFLOAD=y

# MQTT Helper + TLS
CONFIG_MQTT_HELPER=y
CONFIG_MQTT_CLEAN_SESSION=y
CONFIG_MQTT_LIB_TLS=y
CONFIG_MBEDTLS=y
CONFIG_TLS_CREDENTIALS=y
CONFIG_MODEM_KEY_MGMT=y
CONFIG_MQTT_HELPER_SEC_TAG=24
CONFIG_MQTT_BROKER_PORT=8883
CONFIG_MQTT_HELPER_PORT=8883
CONFIG_MQTT_PUB_TOPIC="test/nrf91"
CONFIG_MQTT_PUB_QOS=1
CONFIG_MQTT_CLIENT_ID="WLTK01"

# GPIO, I2C, and LIS2DH12 (kept in power-down ODR=0; wake via MODE button sw0)
CONFIG_GPIO=y
CONFIG_I2C=y
CONFIG_SENSOR=y
CONFIG_LIS2DH=y
CONFIG_LIS2DH_TRIGGER_NONE=y
CONFIG_LIS2DH_OPER_MODE_LOW_POWER=y
CONFIG_LIS2DH_ACCEL_RANGE_2G=y
CONFIG_LIS2DH_ODR_RUNTIME=y

# State timings: LTE wait 30s -> get location -> MQTT -> System OFF (MODE wake)
CONFIG_SLEEP_APP_LTE_CONNECT_TIMEOUT_SECONDS=30
CONFIG_SLEEP_APP_CELL_MEAS_TIMEOUT_SECONDS=30
CONFIG_SLEEP_APP_MOTION_WAKEUP=n
CONFIG_SLEEP_APP_BUTTON_WAKEUP=y
CONFIG_SLEEP_APP_STATUS_LED=y
```

## release.conf
```kconfig
#
# Release / low-power measurement overlay.
# Disables logging, RTT, and LEDs for microamp System OFF profiling.
# Usage:
#   west build -p always -b sparkfun_thing_plus/nrf9160/ns \
#     myprojects/sleep_mode_sys_off --sysbuild -- -DEXTRA_CONF_FILE=release.conf
#

CONFIG_LOG=n
CONFIG_USE_SEGGER_RTT=n
CONFIG_LOG_BACKEND_RTT=n
CONFIG_LOG_BACKEND_RTT_MODE_DROP=n
CONFIG_ASSERT=n
CONFIG_THREAD_NAME=n
CONFIG_SLEEP_APP_STATUS_LED=n
```

## src/main.c
```c
/*
 * Copyright (c) 2026 Cellular Asset Tracker Project
 * SPDX-License-Identifier: Apache-2.0
 */

#include <errno.h>
#include <stdbool.h>
#include <stdint.h>
#include <string.h>

#include <zephyr/device.h>
#include <zephyr/devicetree.h>
#include <zephyr/drivers/gpio.h>
#include <zephyr/drivers/hwinfo.h>
#include <zephyr/drivers/sensor.h>
#include <zephyr/kernel.h>
#include <zephyr/logging/log.h>
#include <zephyr/pm/device.h>
#include <zephyr/sys/atomic.h>
#include <zephyr/sys/poweroff.h>

#include <modem/lte_lc.h>
#include <modem/nrf_modem_lib.h>

#include "tracker_cell.h"
#include "tracker_mqtt.h"

LOG_MODULE_REGISTER(sleep_mode_sys_off, LOG_LEVEL_INF);

enum app_state {
	STATE_START,
	STATE_CONNECT_LTE,
	STATE_GET_LOCATION,
	STATE_MQTT_SEND,
	STATE_SYSTEM_OFF,
};

static K_SEM_DEFINE(lte_connected_sem, 0, 1);
static K_SEM_DEFINE(cell_meas_sem, 0, 1);

static atomic_t lte_registered;
static atomic_t meas_active;

static struct tracker_cell_report latest_meas;
static int meas_result;
static bool mqtt_ready;

#if DT_NODE_HAS_STATUS(DT_ALIAS(led0), okay) && defined(CONFIG_SLEEP_APP_STATUS_LED)
static const struct gpio_dt_spec status_led = GPIO_DT_SPEC_GET(DT_ALIAS(led0), gpios);
static bool status_led_ready;
static bool lte_blink_led_on;
static atomic_t lte_blinking;
static struct k_work_delayable lte_blink_work;

static void lte_blink_work_handler(struct k_work *work)
{
	ARG_UNUSED(work);

	if (!status_led_ready || !atomic_get(&lte_blinking)) {
		return;
	}

	lte_blink_led_on = !lte_blink_led_on;
	(void)gpio_pin_set_dt(&status_led, lte_blink_led_on ? 1 : 0);
	(void)k_work_reschedule(&lte_blink_work,
				K_MSEC(CONFIG_SLEEP_APP_LTE_BLINK_INTERVAL_MS));
}
#endif

#if defined(CONFIG_SLEEP_APP_MOTION_WAKEUP)
static const struct gpio_dt_spec accel_irq =
	GPIO_DT_SPEC_GET(DT_ALIAS(accel0), irq_gpios);
#endif

#if defined(CONFIG_SLEEP_APP_BUTTON_WAKEUP) && DT_NODE_HAS_STATUS(DT_ALIAS(sw0), okay)
static const struct gpio_dt_spec wake_button = GPIO_DT_SPEC_GET(DT_ALIAS(sw0), gpios);
#endif

static void log_reset_cause(void)
{
	uint32_t reset_cause = 0;
	int err = hwinfo_get_reset_cause(&reset_cause);

	if (err != 0) {
		LOG_WRN("Could not read reset cause: %d", err);
		return;
	}

	if (reset_cause & RESET_LOW_POWER_WAKE) {
		LOG_INF("Boot reason: WAKEUP FROM SYSTEM OFF (GPIO DETECT)");
	} else if (reset_cause & RESET_DEBUG) {
		LOG_INF("Boot reason: debugger reset");
	} else if (reset_cause & RESET_PIN) {
		LOG_INF("Boot reason: reset pin");
	} else if (reset_cause & RESET_POR) {
		LOG_INF("Boot reason: power-on reset");
	} else {
		LOG_INF("Boot reason: 0x%08x", reset_cause);
	}

	err = hwinfo_clear_reset_cause();
	if (err != 0) {
		LOG_WRN("Could not clear reset cause: %d", err);
	}
}

static void status_led_init(void)
{
#if DT_NODE_HAS_STATUS(DT_ALIAS(led0), okay) && defined(CONFIG_SLEEP_APP_STATUS_LED)
	if (!gpio_is_ready_dt(&status_led)) {
		LOG_WRN("Status LED GPIO not ready");
		return;
	}

	int err = gpio_pin_configure_dt(&status_led, GPIO_OUTPUT_INACTIVE);
	if (err != 0) {
		LOG_WRN("Failed to configure status LED: %d", err);
		return;
	}

	k_work_init_delayable(&lte_blink_work, lte_blink_work_handler);
	status_led_ready = true;
#endif
}

static void status_led_lte_blink_start(void)
{
#if DT_NODE_HAS_STATUS(DT_ALIAS(led0), okay) && defined(CONFIG_SLEEP_APP_STATUS_LED)
	if (!status_led_ready) {
		return;
	}

	atomic_set(&lte_blinking, 1);
	lte_blink_led_on = true;
	(void)gpio_pin_set_dt(&status_led, 1);
	(void)k_work_reschedule(&lte_blink_work,
				K_MSEC(CONFIG_SLEEP_APP_LTE_BLINK_INTERVAL_MS));
#endif
}

static void status_led_lte_blink_stop(void)
{
#if DT_NODE_HAS_STATUS(DT_ALIAS(led0), okay) && defined(CONFIG_SLEEP_APP_STATUS_LED)
	struct k_work_sync sync;

	if (!status_led_ready) {
		return;
	}

	atomic_clear(&lte_blinking);
	(void)k_work_cancel_delayable_sync(&lte_blink_work, &sync);
	lte_blink_led_on = false;
	(void)gpio_pin_set_dt(&status_led, 0);
#endif
}

static void suspend_external_flash(void)
{
#if DT_NODE_HAS_STATUS(DT_NODELABEL(w25q32jv), okay) && \
	defined(CONFIG_PM_DEVICE) && defined(CONFIG_SPI_NOR)
	const struct device *flash_dev = DEVICE_DT_GET(DT_NODELABEL(w25q32jv));

	if (!device_is_ready(flash_dev)) {
		LOG_WRN("External flash w25q32jv not ready; skipping suspend");
		return;
	}

	int err = pm_device_action_run(flash_dev, PM_DEVICE_ACTION_SUSPEND);
	if (err != 0 && err != -EALREADY) {
		LOG_WRN("Failed to suspend external flash: %d", err);
	} else {
		LOG_INF("External flash suspended (Deep Power-Down)");
	}
#endif
}

static int16_t convert_rsrp_dbm(int16_t rsrp_idx)
{
	if (rsrp_idx == LTE_LC_CELL_RSRP_INVALID) {
		return TRACKER_RSRP_DBM_INVALID;
	}
	return (rsrp_idx < 0) ? (rsrp_idx - 140) : (rsrp_idx - 141);
}

static int16_t convert_rsrq(int16_t rsrq_idx)
{
	if (rsrq_idx == LTE_LC_CELL_RSRQ_INVALID) {
		return TRACKER_RSRQ_INVALID;
	}
	return rsrq_idx;
}

static void handle_neighbor_cell_meas(const struct lte_lc_cells_info *cells)
{
	if (!atomic_cas(&meas_active, 1, 0)) {
		return;
	}

	memset(&latest_meas, 0, sizeof(latest_meas));
	if (cells->current_cell.id == LTE_LC_CELL_EUTRAN_ID_INVALID) {
		meas_result = -ENODATA;
		LOG_WRN("Cell measurement completed without a valid serving cell");
		k_sem_give(&cell_meas_sem);
		return;
	}

	latest_meas.uptime_ms = k_uptime_get();
	latest_meas.meas_time_ms = cells->current_cell.measurement_time;
	latest_meas.mcc = cells->current_cell.mcc;
	latest_meas.mnc = cells->current_cell.mnc;
	latest_meas.tac = cells->current_cell.tac;
	latest_meas.cell_id = cells->current_cell.id;
	latest_meas.earfcn = cells->current_cell.earfcn;
	latest_meas.pci = cells->current_cell.phys_cell_id;
	latest_meas.rsrp_dbm = convert_rsrp_dbm(cells->current_cell.rsrp);
	latest_meas.rsrq = convert_rsrq(cells->current_cell.rsrq);

#if CONFIG_TRACKER_MAX_NEIGHBOR_CELLS > 0
	if (cells->neighbor_cells != NULL && cells->ncells_count > 0) {
		uint8_t copy_count = cells->ncells_count;

		if (copy_count > CONFIG_TRACKER_MAX_NEIGHBOR_CELLS) {
			copy_count = CONFIG_TRACKER_MAX_NEIGHBOR_CELLS;
		}
		latest_meas.ncell_count = copy_count;
		for (uint8_t i = 0; i < copy_count; i++) {
			latest_meas.ncells[i].earfcn = cells->neighbor_cells[i].earfcn;
			latest_meas.ncells[i].pci = cells->neighbor_cells[i].phys_cell_id;
			latest_meas.ncells[i].rsrp_dbm =
				convert_rsrp_dbm(cells->neighbor_cells[i].rsrp);
			latest_meas.ncells[i].rsrq =
				convert_rsrq(cells->neighbor_cells[i].rsrq);
		}
	}
#endif

	meas_result = 0;
	LOG_INF("Cell location: MCC=%d MNC=%d TAC=%u CID=%u PCI=%u RSRP=%d dBm (ncells=%u)",
		latest_meas.mcc, latest_meas.mnc, latest_meas.tac,
		latest_meas.cell_id, latest_meas.pci, latest_meas.rsrp_dbm,
		latest_meas.ncell_count);
	k_sem_give(&cell_meas_sem);
}

static void lte_event_handler(const struct lte_lc_evt *const evt)
{
	switch (evt->type) {
	case LTE_LC_EVT_NW_REG_STATUS:
		if (evt->nw_reg_status == LTE_LC_NW_REG_REGISTERED_HOME ||
		    evt->nw_reg_status == LTE_LC_NW_REG_REGISTERED_ROAMING) {
			atomic_set(&lte_registered, 1);
			LOG_INF("LTE registered (%s)",
				evt->nw_reg_status == LTE_LC_NW_REG_REGISTERED_HOME ?
				"home" : "roaming");
			k_sem_give(&lte_connected_sem);
		} else {
			atomic_clear(&lte_registered);
		}
		break;

	case LTE_LC_EVT_NEIGHBOR_CELL_MEAS:
		handle_neighbor_cell_meas(&evt->cells_info);
		break;

	default:
		break;
	}
}

static int modem_connect_lte(k_timeout_t timeout)
{
	int err;

	k_sem_reset(&lte_connected_sem);
	status_led_lte_blink_start();

	err = lte_lc_func_mode_set(LTE_LC_FUNC_MODE_NORMAL);
	if (err != 0) {
		LOG_ERR("Failed to activate LTE: %d", err);
		status_led_lte_blink_stop();
		return err;
	}

	err = k_sem_take(&lte_connected_sem, timeout);
	status_led_lte_blink_stop();
	if (err != 0) {
		LOG_WRN("LTE not found within %d s",
			CONFIG_SLEEP_APP_LTE_CONNECT_TIMEOUT_SECONDS);
		return -ETIMEDOUT;
	}

	return 0;
}

static int modem_measure_cells(struct tracker_cell_report *out, k_timeout_t timeout)
{
	struct lte_lc_ncellmeas_params params = {
		.search_type = LTE_LC_NEIGHBOR_SEARCH_TYPE_DEFAULT,
	};
	int err;

	k_sem_reset(&cell_meas_sem);
	meas_result = -ENODATA;
	atomic_set(&meas_active, 1);

	err = lte_lc_neighbor_cell_measurement(&params);
	if (err != 0) {
		atomic_clear(&meas_active);
		LOG_ERR("lte_lc_neighbor_cell_measurement failed: %d", err);
		return err;
	}

	err = k_sem_take(&cell_meas_sem, timeout);
	if (err != 0) {
		if (atomic_cas(&meas_active, 1, 0)) {
			(void)lte_lc_neighbor_cell_measurement_cancel();
			LOG_WRN("LTE cell measurement timed out");
			return -ETIMEDOUT;
		}
		err = k_sem_take(&cell_meas_sem, K_MSEC(100));
		if (err != 0) {
			return -ETIMEDOUT;
		}
	}

	if (meas_result != 0) {
		return meas_result;
	}

	*out = latest_meas;
	return 0;
}

static void shutdown_modem_cleanly(void)
{
	int err = lte_lc_power_off();

	if (err != 0) {
		LOG_WRN("lte_lc_power_off failed: %d", err);
	}

	err = nrf_modem_lib_shutdown();
	if (err != 0) {
		LOG_WRN("nrf_modem_lib_shutdown failed: %d", err);
	} else {
		LOG_INF("Modem cleanly powered off and shut down");
	}
}

#if defined(CONFIG_SLEEP_APP_MOTION_WAKEUP)
static void accel_dummy_handler(const struct device *dev,
				const struct sensor_trigger *trig)
{
	ARG_UNUSED(dev);
	ARG_UNUSED(trig);
}

static int arm_accel_sys_off_wakeup(void)
{
	const struct device *accel = DEVICE_DT_GET(DT_ALIAS(accel0));
	struct sensor_value slope_th = {
		.val1 = CONFIG_SLEEP_APP_MOTION_THRESHOLD_MS2,
		.val2 = 0,
	};
	struct sensor_value slope_dur = {
		.val1 = CONFIG_SLEEP_APP_MOTION_DURATION_SAMPLES,
		.val2 = 0,
	};
	static const struct sensor_trigger motion_trig = {
		.type = SENSOR_TRIG_DELTA,
		.chan = SENSOR_CHAN_ACCEL_XYZ,
	};
	int err;

	if (!device_is_ready(accel)) {
		LOG_ERR("Accelerometer accel0 is not ready");
		return -ENODEV;
	}

	if (!gpio_is_ready_dt(&accel_irq)) {
		LOG_ERR("Accelerometer IRQ GPIO is not ready");
		return -ENODEV;
	}

	err = sensor_attr_set(accel, SENSOR_CHAN_ACCEL_XYZ,
			      SENSOR_ATTR_SLOPE_TH, &slope_th);
	if (err != 0) {
		LOG_ERR("Failed to set LIS2DH slope threshold: %d", err);
		return err;
	}

	err = sensor_attr_set(accel, SENSOR_CHAN_ACCEL_XYZ,
			      SENSOR_ATTR_SLOPE_DUR, &slope_dur);
	if (err != 0) {
		LOG_ERR("Failed to set LIS2DH slope duration: %d", err);
		return err;
	}

	err = sensor_trigger_set(accel, &motion_trig, accel_dummy_handler);
	if (err != 0) {
		LOG_ERR("Failed to enable LIS2DH any-motion trigger: %d", err);
		return err;
	}

	/* Wait for deferred LIS2DH I2C register writes to complete. */
	k_sleep(K_MSEC(100));

	err = gpio_pin_configure_dt(&accel_irq, GPIO_INPUT);
	if (err != 0) {
		LOG_ERR("Failed to configure accel IRQ pin as input: %d", err);
		return err;
	}

	if (gpio_pin_get_dt(&accel_irq) > 0) {
		LOG_WRN("Accel IRQ pin is currently active; waiting 150 ms to settle");
		k_sleep(K_MSEC(150));
	}

	err = gpio_pin_interrupt_configure_dt(&accel_irq, GPIO_INT_LEVEL_ACTIVE);
	if (err != 0) {
		LOG_ERR("Failed to arm accel IRQ level sense for System OFF: %d", err);
		return err;
	}

	LOG_INF("LIS2DH12 System OFF wake-up armed on P0.%d (threshold=%d m/s^2, dur=%d)",
		accel_irq.pin,
		CONFIG_SLEEP_APP_MOTION_THRESHOLD_MS2,
		CONFIG_SLEEP_APP_MOTION_DURATION_SAMPLES);

	return 0;
}
#else
static int arm_accel_sys_off_wakeup(void)
{
	const struct device *accel = DEVICE_DT_GET(DT_ALIAS(accel0));

	if (device_is_ready(accel)) {
		struct sensor_value odr = { .val1 = 0, .val2 = 0 };
		int err = sensor_attr_set(accel, SENSOR_CHAN_ACCEL_XYZ,
					  SENSOR_ATTR_SAMPLING_FREQUENCY, &odr);
		if (err != 0) {
			LOG_WRN("Failed to power down LIS2DH12: %d", err);
		} else {
			LOG_INF("LIS2DH12 powered down (ODR=0)");
		}
	}

	return 0;
}
#endif

static int arm_button_sys_off_wakeup(void)
{
#if defined(CONFIG_SLEEP_APP_BUTTON_WAKEUP) && DT_NODE_HAS_STATUS(DT_ALIAS(sw0), okay)
	int err;

	if (!gpio_is_ready_dt(&wake_button)) {
		LOG_ERR("Wake button sw0 GPIO not ready");
		return -ENODEV;
	}

	err = gpio_pin_configure_dt(&wake_button, GPIO_INPUT);
	if (err != 0) {
		LOG_ERR("Failed to configure sw0 as input: %d", err);
		return err;
	}

	/* Wait if MODE button is currently held down so we don't wake immediately. */
	while (gpio_pin_get_dt(&wake_button) > 0) {
		LOG_INF("Waiting for MODE button release...");
		k_sleep(K_MSEC(100));
	}

	err = gpio_pin_interrupt_configure_dt(&wake_button, GPIO_INT_LEVEL_ACTIVE);
	if (err != 0) {
		LOG_ERR("Failed to arm sw0 System OFF wake-up: %d", err);
		return err;
	}

	LOG_INF("MODE button sw0 (P0.%d) System OFF wake-up armed", wake_button.pin);
#endif
	return 0;
}

int main(void)
{
	enum app_state state = STATE_START;
	struct tracker_cell_report cell_report;
	int err;

	status_led_init();
	LOG_INF("=== System 2: LTE(30s) -> Location -> MQTT -> System OFF ===");
	LOG_INF("Wake source: %s%s",
		IS_ENABLED(CONFIG_SLEEP_APP_BUTTON_WAKEUP) ? "MODE button (sw0)" : "",
		IS_ENABLED(CONFIG_SLEEP_APP_MOTION_WAKEUP) ? " + LIS2DH12 motion" : "");

	log_reset_cause();
	suspend_external_flash();

	err = nrf_modem_lib_init();
	if (err != 0) {
		LOG_ERR("nrf_modem_lib_init failed: %d", err);
		return 0;
	}
	lte_lc_register_handler(lte_event_handler);

	err = tracker_mqtt_init();
	if (err != 0) {
		LOG_WRN("MQTT init failed (%d); MQTT sending will be skipped", err);
		mqtt_ready = false;
	} else {
		mqtt_ready = true;
	}

	while (true) {
		switch (state) {
		case STATE_START:
			LOG_INF("[STATE] START");
			state = STATE_CONNECT_LTE;
			break;

		case STATE_CONNECT_LTE:
			LOG_INF("[STATE] LTE (wait up to %d s)",
				CONFIG_SLEEP_APP_LTE_CONNECT_TIMEOUT_SECONDS);
			err = modem_connect_lte(
				K_SECONDS(CONFIG_SLEEP_APP_LTE_CONNECT_TIMEOUT_SECONDS));
			if (err != 0) {
				LOG_WRN("LTE not found -> direct to SYSTEM OFF");
				state = STATE_SYSTEM_OFF;
			} else {
				state = STATE_GET_LOCATION;
			}
			break;

		case STATE_GET_LOCATION:
			LOG_INF("[STATE] GET LOCATION (LTE cell measurement)");
			err = modem_measure_cells(
				&cell_report,
				K_SECONDS(CONFIG_SLEEP_APP_CELL_MEAS_TIMEOUT_SECONDS));
			if (err != 0) {
				LOG_WRN("Get location failed (%d) -> SYSTEM OFF", err);
				state = STATE_SYSTEM_OFF;
			} else {
				state = STATE_MQTT_SEND;
			}
			break;

		case STATE_MQTT_SEND:
			LOG_INF("[STATE] MQTT SENDING");
			if (!mqtt_ready) {
				LOG_WRN("MQTT not initialized (check CA cert/credentials)");
			} else {
				err = tracker_mqtt_connect(K_SECONDS(15));
				if (err == 0) {
					err = tracker_mqtt_publish_cell_report(
						&cell_report, K_SECONDS(15));
					if (err != 0) {
						LOG_ERR("MQTT publish failed: %d", err);
					}
				}
				(void)tracker_mqtt_disconnect(K_SECONDS(10));
			}
			state = STATE_SYSTEM_OFF;
			break;

		case STATE_SYSTEM_OFF:
			LOG_INF("[STATE] SYSTEM OFF");
			shutdown_modem_cleanly();

			err = arm_accel_sys_off_wakeup();
			if (err != 0) {
				LOG_ERR("Failed to prepare accel (%d); aborting System OFF", err);
				return 0;
			}
			err = arm_button_sys_off_wakeup();
			if (err != 0) {
				LOG_ERR("Failed to arm MODE button wake-up (%d); aborting System OFF",
					err);
				return 0;
			}

			LOG_INF("Entering nRF9160 System OFF now (press MODE button to wake)...");
			k_sleep(K_MSEC(150));
			sys_poweroff();
			break;
		}
	}

	return 0;
}
```

## src/tracker_mqtt.c
```c
/*
 * Copyright (c) 2026 Cellular Asset Tracker Project
 * SPDX-License-Identifier: Apache-2.0
 */

#include <errno.h>
#include <stdarg.h>
#include <stdio.h>
#include <string.h>

#include <zephyr/kernel.h>
#include <zephyr/logging/log.h>
#include <zephyr/sys/atomic.h>

#include <modem/lte_lc.h>
#include <modem/modem_key_mgmt.h>
#include <net/mqtt_helper.h>
#include <nrf_modem_at.h>

#include "tracker_mqtt.h"

LOG_MODULE_REGISTER(tracker_mqtt, LOG_LEVEL_INF);

#define IMEI_LEN             15
#define CGSN_RESPONSE_LENGTH (IMEI_LEN + 6 + 1)
#define CLIENT_ID_LEN        (sizeof("nrf-") + IMEI_LEN)
#define MQTT_PAYLOAD_MAX_LEN 1024

static K_SEM_DEFINE(mqtt_conn_sem, 0, 1);
static K_SEM_DEFINE(mqtt_puback_sem, 0, 1);
static K_SEM_DEFINE(mqtt_disconnected_sem, 0, 1);

static char client_id_buf[CLIENT_ID_LEN];
static char payload_buf[MQTT_PAYLOAD_MAX_LEN];

static enum mqtt_conn_return_code connack_result;
static int puback_result;
static uint16_t pending_publish_id;
static atomic_t connect_attempted;

static const unsigned char broker_ca_certificate[] = {
#if __has_include("ca-cert.pem")
#include "ca-cert.pem"
#else
	""
#endif
};

static int append_fmt(char *buf, size_t cap, size_t *pos, const char *fmt, ...)
{
	va_list args;
	int written;

	if (*pos >= cap) {
		return -EMSGSIZE;
	}

	va_start(args, fmt);
	written = vsnprintf(buf + *pos, cap - *pos, fmt, args);
	va_end(args);

	if (written < 0 || (size_t)written >= (cap - *pos)) {
		return -EMSGSIZE;
	}

	*pos += (size_t)written;
	return 0;
}

static int append_optional_int16(char *buf, size_t cap, size_t *pos,
				 int16_t value, int16_t invalid_sentinel)
{
	if (value == invalid_sentinel) {
		return append_fmt(buf, cap, pos, "null");
	}
	return append_fmt(buf, cap, pos, "%d", value);
}

static int format_cell_report_json(const struct tracker_cell_report *report,
				   char *buf, size_t cap, size_t *out_len)
{
	size_t pos = 0;
	int err;

	err = append_fmt(buf, cap, &pos,
			 "{\"device_id\":\"%s\",\"uptime_ms\":%lld,"
			 "\"source\":\"lte\",\"gnss\":null,\"lte\":"
			 "{\"mcc\":%d,\"mnc\":%d,\"tac\":",
			 client_id_buf, (long long)report->uptime_ms,
			 report->mcc, report->mnc);
	if (err != 0) {
		return err;
	}

	if (report->tac == LTE_LC_CELL_TAC_INVALID) {
		err = append_fmt(buf, cap, &pos, "null");
	} else {
		err = append_fmt(buf, cap, &pos, "%u", report->tac);
	}
	if (err != 0) {
		return err;
	}

	err = append_fmt(buf, cap, &pos,
			 ",\"cid\":%u,\"earfcn\":%u,\"pci\":%u,\"rsrp\":",
			 report->cell_id, report->earfcn, report->pci);
	if (err != 0) {
		return err;
	}

	err = append_optional_int16(buf, cap, &pos, report->rsrp_dbm,
				    TRACKER_RSRP_DBM_INVALID);
	if (err != 0) {
		return err;
	}

	err = append_fmt(buf, cap, &pos, ",\"rsrq\":");
	if (err != 0) {
		return err;
	}

	err = append_optional_int16(buf, cap, &pos, report->rsrq,
				    TRACKER_RSRQ_INVALID);
	if (err != 0) {
		return err;
	}

	err = append_fmt(buf, cap, &pos, ",\"ncells\":[");
	if (err != 0) {
		return err;
	}

#if CONFIG_TRACKER_MAX_NEIGHBOR_CELLS > 0
	for (uint8_t i = 0; i < report->ncell_count &&
	     i < CONFIG_TRACKER_MAX_NEIGHBOR_CELLS; i++) {
		const struct tracker_neighbor_cell *nc = &report->ncells[i];

		err = append_fmt(buf, cap, &pos,
				 "%s{\"earfcn\":%u,\"pci\":%u,\"rsrp\":",
				 (i > 0) ? "," : "", nc->earfcn, nc->pci);
		if (err != 0) {
			return err;
		}
		err = append_optional_int16(buf, cap, &pos, nc->rsrp_dbm,
					    TRACKER_RSRP_DBM_INVALID);
		if (err != 0) {
			return err;
		}
		err = append_fmt(buf, cap, &pos, ",\"rsrq\":");
		if (err != 0) {
			return err;
		}
		err = append_optional_int16(buf, cap, &pos, nc->rsrq,
					    TRACKER_RSRQ_INVALID);
		if (err != 0) {
			return err;
		}
		err = append_fmt(buf, cap, &pos, "}");
		if (err != 0) {
			return err;
		}
	}
#endif

	err = append_fmt(buf, cap, &pos, "]}}");
	if (err != 0) {
		return err;
	}

	*out_len = pos;
	return 0;
}

static int broker_ca_provision(void)
{
	bool exists;
	int err;
	int comparison;

	if (sizeof(broker_ca_certificate) <= 1) {
		LOG_ERR("TLS is enabled but credentials/ca-cert.pem is missing");
		return -ENOENT;
	}

	err = modem_key_mgmt_exists(CONFIG_MQTT_HELPER_SEC_TAG,
				    MODEM_KEY_MGMT_CRED_TYPE_CA_CHAIN, &exists);
	if (err != 0) {
		LOG_ERR("Failed to check MQTT broker CA: %d", err);
		return err;
	}

	if (exists) {
		comparison = modem_key_mgmt_cmp(CONFIG_MQTT_HELPER_SEC_TAG,
						MODEM_KEY_MGMT_CRED_TYPE_CA_CHAIN,
						broker_ca_certificate,
						sizeof(broker_ca_certificate) - 1);
		if (comparison == 0) {
			LOG_INF("MQTT broker CA already provisioned");
			return 0;
		}

		err = modem_key_mgmt_delete(CONFIG_MQTT_HELPER_SEC_TAG,
					    MODEM_KEY_MGMT_CRED_TYPE_CA_CHAIN);
		if (err != 0) {
			LOG_ERR("Failed to replace MQTT broker CA: %d", err);
			return err;
		}
	}

	err = modem_key_mgmt_write(CONFIG_MQTT_HELPER_SEC_TAG,
				   MODEM_KEY_MGMT_CRED_TYPE_CA_CHAIN,
				   broker_ca_certificate,
				   sizeof(broker_ca_certificate) - 1);
	if (err != 0) {
		LOG_ERR("Failed to provision MQTT broker CA: %d", err);
		return err;
	}

	LOG_INF("MQTT broker CA provisioned in sec tag %d", CONFIG_MQTT_HELPER_SEC_TAG);
	return 0;
}

static int client_id_get(char *buffer, size_t buffer_len)
{
	char imei_buf[CGSN_RESPONSE_LENGTH];
	int len;
	int err;

	if (strlen(CONFIG_MQTT_CLIENT_ID) > 0) {
		len = snprintf(buffer, buffer_len, "%s", CONFIG_MQTT_CLIENT_ID);
		if (len < 0 || (size_t)len >= buffer_len) {
			LOG_ERR("Configured MQTT client ID is too long");
			return -EMSGSIZE;
		}
		return 0;
	}

	err = nrf_modem_at_cmd(imei_buf, sizeof(imei_buf), "AT+CGSN");
	if (err != 0) {
		LOG_ERR("Failed to obtain IMEI via AT+CGSN: %d", err);
		return err;
	}

	imei_buf[IMEI_LEN] = '\0';
	len = snprintf(buffer, buffer_len, "nrf-%.*s", IMEI_LEN, imei_buf);
	if (len < 0 || (size_t)len >= buffer_len) {
		LOG_ERR("Generated MQTT client ID is too long");
		return -EMSGSIZE;
	}

	LOG_INF("MQTT client ID: %s", buffer);
	return 0;
}

static void on_mqtt_connack(enum mqtt_conn_return_code return_code, bool session_present)
{
	ARG_UNUSED(session_present);

	connack_result = return_code;
	if (return_code == MQTT_CONNECTION_ACCEPTED) {
		LOG_INF("MQTT connected to %s:%d", CONFIG_MQTT_BROKER_HOSTNAME,
			CONFIG_MQTT_BROKER_PORT);
	} else {
		LOG_ERR("MQTT broker rejected connection: %d", return_code);
	}

	k_sem_give(&mqtt_conn_sem);
}

static void on_mqtt_disconnect(int result)
{
	atomic_clear(&connect_attempted);
	if (result == 0) {
		LOG_INF("MQTT disconnected");
	} else {
		LOG_WRN("MQTT disconnected with result: %d", result);
	}
	k_sem_give(&mqtt_disconnected_sem);
}

static void on_mqtt_puback(uint16_t message_id, int result)
{
	if (message_id != pending_publish_id) {
		LOG_WRN("Unexpected MQTT PUBACK ID: %u", message_id);
		return;
	}

	puback_result = result;
	if (result != 0) {
		LOG_ERR("MQTT PUBACK failed for ID %u: %d", message_id, result);
	} else {
		LOG_INF("MQTT PUBACK received (ID: %u)", message_id);
	}
	k_sem_give(&mqtt_puback_sem);
}

int tracker_mqtt_init(void)
{
	struct mqtt_helper_cfg mqtt_cfg = {
		.cb = {
			.on_connack = on_mqtt_connack,
			.on_disconnect = on_mqtt_disconnect,
			.on_puback = on_mqtt_puback,
		},
	};
	int err;

	if (strlen(CONFIG_MQTT_BROKER_PASSWORD) > 0 &&
	    strlen(CONFIG_MQTT_BROKER_USERNAME) == 0) {
		LOG_ERR("MQTT password is configured without a username");
		return -EINVAL;
	}

	if (IS_ENABLED(CONFIG_MQTT_LIB_TLS)) {
		err = broker_ca_provision();
		if (err != 0) {
			return err;
		}
	}

	err = mqtt_helper_init(&mqtt_cfg);
	if (err != 0) {
		LOG_ERR("mqtt_helper_init failed: %d", err);
		return err;
	}

	return client_id_get(client_id_buf, sizeof(client_id_buf));
}

int tracker_mqtt_connect(k_timeout_t timeout)
{
	struct mqtt_helper_conn_params conn_params = {
		.hostname.ptr = CONFIG_MQTT_BROKER_HOSTNAME,
		.hostname.size = strlen(CONFIG_MQTT_BROKER_HOSTNAME),
		.device_id.ptr = client_id_buf,
		.device_id.size = strlen(client_id_buf),
		.user_name.ptr = CONFIG_MQTT_BROKER_USERNAME,
		.user_name.size = strlen(CONFIG_MQTT_BROKER_USERNAME),
		.password.ptr = CONFIG_MQTT_BROKER_PASSWORD,
		.password.size = strlen(CONFIG_MQTT_BROKER_PASSWORD),
	};
	int err;

	LOG_INF("Connecting to MQTT broker (%s:%d)...", CONFIG_MQTT_BROKER_HOSTNAME,
		CONFIG_MQTT_BROKER_PORT);
	k_sem_reset(&mqtt_conn_sem);
	connack_result = MQTT_UNACCEPTABLE_PROTOCOL_VERSION;

	err = mqtt_helper_connect(&conn_params);
	if (err != 0) {
		LOG_ERR("mqtt_helper_connect failed: %d", err);
		return err;
	}
	atomic_set(&connect_attempted, 1);

	err = k_sem_take(&mqtt_conn_sem, timeout);
	if (err != 0) {
		LOG_ERR("MQTT CONNACK timed out");
		return -ETIMEDOUT;
	}
	if (connack_result != MQTT_CONNECTION_ACCEPTED) {
		return -ECONNREFUSED;
	}

	return 0;
}

int tracker_mqtt_publish_cell_report(const struct tracker_cell_report *report,
				     k_timeout_t timeout)
{
	struct mqtt_publish_param param = { 0 };
	size_t payload_len = 0;
	int err;

	if (report == NULL) {
		return -EINVAL;
	}

	err = format_cell_report_json(report, payload_buf, sizeof(payload_buf), &payload_len);
	if (err != 0) {
		LOG_ERR("Cell report JSON formatting failed: %d", err);
		return err;
	}

	param.message.payload.data = (uint8_t *)payload_buf;
	param.message.payload.len = payload_len;
	param.message.topic.qos = (enum mqtt_qos)CONFIG_MQTT_PUB_QOS;
	param.message.topic.topic.utf8 = CONFIG_MQTT_PUB_TOPIC;
	param.message.topic.topic.size = strlen(CONFIG_MQTT_PUB_TOPIC);
	pending_publish_id = mqtt_helper_msg_id_get();
	param.message_id = pending_publish_id;

	LOG_INF("Publishing cell report to '%s' (QoS %d, %zu bytes): %s",
		CONFIG_MQTT_PUB_TOPIC, CONFIG_MQTT_PUB_QOS, payload_len, payload_buf);
	if (CONFIG_MQTT_PUB_QOS == MQTT_QOS_1_AT_LEAST_ONCE) {
		k_sem_reset(&mqtt_puback_sem);
		puback_result = 0;
	}

	err = mqtt_helper_publish(&param);
	if (err != 0) {
		LOG_ERR("mqtt_helper_publish failed: %d", err);
		return err;
	}

	if (CONFIG_MQTT_PUB_QOS == MQTT_QOS_0_AT_MOST_ONCE) {
		return 0;
	}

	err = k_sem_take(&mqtt_puback_sem, timeout);
	if (err != 0) {
		LOG_ERR("MQTT PUBACK timed out");
		return -ETIMEDOUT;
	}

	return puback_result;
}

int tracker_mqtt_disconnect(k_timeout_t timeout)
{
	int err;

	if (!atomic_get(&connect_attempted)) {
		return 0;
	}

	k_sem_reset(&mqtt_disconnected_sem);
	err = mqtt_helper_disconnect();
	if (err != 0) {
		LOG_ERR("mqtt_helper_disconnect failed: %d", err);
		return err;
	}

	err = k_sem_take(&mqtt_disconnected_sem, timeout);
	if (err != 0) {
		LOG_WRN("MQTT disconnect timed out");
		return -ETIMEDOUT;
	}

	return 0;
}
```

## src/tracker_mqtt.h
```c
/*
 * Copyright (c) 2026 Cellular Asset Tracker Project
 * SPDX-License-Identifier: Apache-2.0
 */

#ifndef TRACKER_MQTT_H_
#define TRACKER_MQTT_H_

#include <zephyr/kernel.h>

#include "tracker_cell.h"

int tracker_mqtt_init(void);
int tracker_mqtt_connect(k_timeout_t timeout);
int tracker_mqtt_publish_cell_report(const struct tracker_cell_report *report,
				     k_timeout_t timeout);
int tracker_mqtt_disconnect(k_timeout_t timeout);

#endif /* TRACKER_MQTT_H_ */
```
