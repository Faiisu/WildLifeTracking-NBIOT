## CMakeLists.txt
```
#
# Copyright (c) 2026 Cellular Asset Tracker Project
# SPDX-License-Identifier: Apache-2.0
#

cmake_minimum_required(VERSION 3.20.0)

# Load local broker endpoint/credentials overlay when present (ignored by Git).
set(COMPARE_MQTT_CREDENTIALS_FILE
  ${CMAKE_CURRENT_SOURCE_DIR}/config/mqtt-credentials.conf
)
if(EXISTS ${COMPARE_MQTT_CREDENTIALS_FILE})
  set(EXTRA_CONF_FILE ${COMPARE_MQTT_CREDENTIALS_FILE} ${EXTRA_CONF_FILE})
endif()

find_package(Zephyr REQUIRED HINTS $ENV{ZEPHYR_BASE})
project(lte_vs_gnss_compare)

# The broker CA is a local deployment asset (never commit to Git).
set(COMPARE_CERT_GEN_DIR ${CMAKE_CURRENT_BINARY_DIR}/certs)
zephyr_include_directories(${COMPARE_CERT_GEN_DIR})
if(EXISTS ${CMAKE_CURRENT_SOURCE_DIR}/credentials/ca-cert.pem)
  generate_inc_file_for_target(app credentials/ca-cert.pem
    ${COMPARE_CERT_GEN_DIR}/ca-cert.pem)
endif()

target_sources(app PRIVATE
  src/main.c
  src/tracker_mqtt.c
)

target_sources_ifdef(CONFIG_TRACKER_CIRCUIT_DOJO_GNSS_SETUP app PRIVATE
  src/circuitdojo_gnss.c
)
```

## Kconfig
```
#
# Copyright (c) 2026 Cellular Asset Tracker Project
# SPDX-License-Identifier: Apache-2.0
#

menu "LTE vs GNSS Two-Stage Comparison Configuration"

config COMPARE_LTE_TIMEOUT_SECONDS
	int "LTE registration timeout in seconds"
	default 30
	range 10 300
	help
	  Maximum time to wait for home or roaming LTE registration in Stage 1
	  and Stage 2 before falling back to SLEEP.

config COMPARE_CELL_MEAS_TIMEOUT_SECONDS
	int "Stage 1 LTE cell location timeout in seconds"
	default 30
	range 5 180
	help
	  Maximum time to wait for LTE serving/neighbor cell measurement in
	  Stage 1.

config COMPARE_GNSS_TIMEOUT_SECONDS
	int "Stage 2 GNSS fix timeout in seconds"
	default 300
	range 15 900
	help
	  Maximum time to wait for a valid GNSS PVT fix in Stage 2 before
	  turning GNSS off and entering SLEEP.

config COMPARE_GNSS_LOW_ACCURACY
	bool "Allow low-accuracy GNSS fixes for faster TTFF"
	default n
	help
	  Enables NRF_MODEM_GNSS_USE_CASE_LOW_ACCURACY in Stage 2.

config COMPARE_SLEEP_TIMEOUT_SECONDS
	int "Maximum sleep duration in seconds (0 = wait forever for MODE button)"
	default 0
	range 0 86400
	help
	  When 0 (default), the board stays in SLEEP until the MODE button
	  (sw0) is pressed to wake and enter the next stage. Set > 0 to also
	  auto-wake on a timer.

config COMPARE_BUTTON_DEBOUNCE_MS
	int "MODE button software debounce interval (ms)"
	default 250
	range 50 1000
	help
	  Minimum time between accepted MODE button presses to avoid a single
	  click triggering both abort-to-sleep and wake-from-sleep.

config COMPARE_STATUS_LED
	bool "Use board LED0 to indicate active Stage 1 / Stage 2"
	default y
	help
	  Slow blink (500 ms) during Stage 1 (LTE), fast blink (150 ms) during
	  Stage 2 (GNSS), and off during SLEEP. Disable via release.conf when
	  measuring microamp sleep current.

config TRACKER_MAX_NEIGHBOR_CELLS
	int "Maximum neighbor cells stored per Stage 1 report"
	default 6
	range 0 16
	help
	  Maximum number of neighbor cells retained in the Stage 1 JSON report.

config TRACKER_CIRCUIT_DOJO_GNSS_SETUP
	bool "Enable Circuit Dojo / SparkFun GNSS power-mode GPIO setup"
	default n
	help
	  Drives the GNSS power-mode GPIO pin low at startup for SparkFun Thing
	  Plus nRF9160 / Circuit Dojo Feather hardware.

config TRACKER_GNSS_POWER_MODE_PIN
	int "GNSS power-mode GPIO pin"
	default 13
	range 0 31
	depends on TRACKER_CIRCUIT_DOJO_GNSS_SETUP
	help
	  GPIO0 pin driven low at boot to enable GNSS antenna/LNA power.

config MQTT_BROKER_HOSTNAME
	string "MQTT Broker Hostname"
	default "test.mosquitto.org"
	help
	  Hostname or IP address of the target MQTT broker.

config MQTT_BROKER_PORT
	int "MQTT Broker Port"
	default 8883
	help
	  Port number of the target MQTT broker (1883 plaintext, 8883 TLS).

config MQTT_PUB_TOPIC
	string "MQTT Publish Topic"
	default "test/nrf91"
	help
	  MQTT topic used for both Stage 1 (LTE cell) and Stage 2 (GNSS) JSON
	  payloads.

config MQTT_PUB_QOS
	int "MQTT publish QoS"
	range 0 1
	default 1
	help
	  0 sends at most once; 1 sends at least once and waits for PUBACK.

config MQTT_CLIENT_ID
	string "MQTT Client ID (leave blank to use IMEI)"
	default "WLTK01"
	help
	  Custom MQTT client ID. If empty, nrf-<IMEI> is derived via AT+CGSN.

config MQTT_BROKER_USERNAME
	string "MQTT broker username"
	default ""
	help
	  Optional MQTT username. Keep real credentials in git-ignored
	  config/mqtt-credentials.conf.

config MQTT_BROKER_PASSWORD
	string "MQTT broker password"
	default ""
	help
	  Optional MQTT password (requires non-empty username). Keep real
	  credentials in git-ignored config/mqtt-credentials.conf.

endmenu

source "Kconfig.zephyr"
```

## sample.yaml
```
sample:
  description: Two-stage LTE Cell-ID vs GNSS power comparison firmware controlled by MODE button
  name: LTE vs GNSS Comparison Firmware

common:
  sysbuild: true
  build_only: true
  integration_platforms:
    - sparkfun_thing_plus/nrf9160/ns
  platform_allow:
    - circuitdojo_feather/nrf9160/ns
    - sparkfun_thing_plus/nrf9160/ns

tests:
  app.lte_vs_gnss_compare: {}
```

## prj.conf
```kconfig
#
# Copyright (c) 2026 Cellular Asset Tracker Project
# SPDX-License-Identifier: Apache-2.0
#

# Application memory and floating-point formatting (for GNSS JSON)
CONFIG_MAIN_STACK_SIZE=8192
CONFIG_HEAP_MEM_POOL_SIZE=8192
CONFIG_NEWLIB_LIBC=y
CONFIG_FPU=y
CONFIG_NEWLIB_LIBC_FLOAT_PRINTF=y
CONFIG_POLL=y

# RTT-only logging; keep UART/console disabled to avoid serial power draw
CONFIG_LOG=y
CONFIG_USE_SEGGER_RTT=y
CONFIG_LOG_BACKEND_RTT=y
CONFIG_LOG_BACKEND_RTT_MODE_DROP=y
CONFIG_LOG_BACKEND_UART=n
CONFIG_SERIAL=n
CONFIG_CONSOLE=n
CONFIG_UART_CONSOLE=n
CONFIG_UART_INTERRUPT_DRIVEN=n
CONFIG_TFM_LOG_LEVEL_SILENCE=y
CONFIG_TFM_SECURE_UART=n

# Modem with shared LTE-M / NB-IoT + GNSS support and Cell Measurement
CONFIG_NRF_MODEM_LIB=y
CONFIG_LTE_LINK_CONTROL=y
CONFIG_LTE_NETWORK_MODE_LTE_M_NBIOT_GPS=y
CONFIG_LTE_LC_NEIGHBOR_CELL_MEAS_MODULE=y
CONFIG_LTE_NEIGHBOR_CELLS_MAX=6
CONFIG_LTE_LC_EDRX_MODULE=n
CONFIG_LTE_LC_PSM_MODULE=n

# Networking offload required by nRF modem library
CONFIG_NETWORKING=y
CONFIG_NET_NATIVE=n
CONFIG_NET_SOCKETS=y
CONFIG_NET_SOCKETS_OFFLOAD=y

# MQTT Helper + TLS (matching gps_mqtt_tracker defaults)
CONFIG_MQTT_HELPER=y
CONFIG_MQTT_CLEAN_SESSION=y
CONFIG_MQTT_LIB_TLS=y
CONFIG_MBEDTLS=y
CONFIG_TLS_CREDENTIALS=y
CONFIG_MODEM_KEY_MGMT=y
CONFIG_MQTT_HELPER_SEC_TAG=24
CONFIG_MQTT_BROKER_PORT=8883
CONFIG_MQTT_HELPER_PORT=8883
CONFIG_MQTT_PUB_TOPIC="test/nrf91"
CONFIG_MQTT_PUB_QOS=1
CONFIG_MQTT_CLIENT_ID="WLTK01"

# Power hygiene: external flash DPD + LIS2DH12 powered down (ODR=0)
CONFIG_PM_DEVICE=y
CONFIG_FLASH=y
CONFIG_SPI_NOR=y
CONFIG_GPIO=y
CONFIG_I2C=y
CONFIG_SENSOR=y
CONFIG_LIS2DH=y
CONFIG_LIS2DH_TRIGGER_NONE=y
CONFIG_LIS2DH_OPER_MODE_LOW_POWER=y
CONFIG_LIS2DH_ACCEL_RANGE_2G=y
CONFIG_LIS2DH_ODR_RUNTIME=y

# Stage defaults
CONFIG_COMPARE_LTE_TIMEOUT_SECONDS=30
CONFIG_COMPARE_CELL_MEAS_TIMEOUT_SECONDS=30
CONFIG_COMPARE_GNSS_TIMEOUT_SECONDS=300
CONFIG_COMPARE_SLEEP_TIMEOUT_SECONDS=0
CONFIG_COMPARE_BUTTON_DEBOUNCE_MS=250
CONFIG_COMPARE_STATUS_LED=y
```

## release.conf
```kconfig
#
# Release / low-power measurement overlay.
# Disables logging, RTT, and LEDs for clean power profiling of Stage 1 vs Stage 2.
# Usage:
#   west build -p always -b sparkfun_thing_plus/nrf9160/ns \
#     myprojects/lte_vs_gnss_compare --sysbuild -- -DEXTRA_CONF_FILE=release.conf
#

CONFIG_LOG=n
CONFIG_USE_SEGGER_RTT=n
CONFIG_LOG_BACKEND_RTT=n
CONFIG_LOG_BACKEND_RTT_MODE_DROP=n
CONFIG_ASSERT=n
CONFIG_THREAD_NAME=n
CONFIG_COMPARE_STATUS_LED=n
```

## boards/circuitdojo_feather_nrf9160_ns.conf
```kconfig
# Circuit Dojo Feather nRF9160 GNSS antenna/power-mode setup.
CONFIG_TRACKER_CIRCUIT_DOJO_GNSS_SETUP=y
CONFIG_MODEM_ANTENNA=y
CONFIG_MODEM_ANTENNA_AT_COEX0="AT\%XCOEX0=1,1,1565,1586"
```

## src/main.c
```c
/*
 * Copyright (c) 2026 Cellular Asset Tracker Project
 * SPDX-License-Identifier: Apache-2.0
 */

#include <errno.h>
#include <stdbool.h>
#include <stdint.h>
#include <string.h>

#include <zephyr/device.h>
#include <zephyr/devicetree.h>
#include <zephyr/drivers/gpio.h>
#include <zephyr/drivers/sensor.h>
#include <zephyr/kernel.h>
#include <zephyr/logging/log.h>
#include <zephyr/pm/device.h>
#include <zephyr/sys/atomic.h>

#include <modem/lte_lc.h>
#include <modem/nrf_modem_lib.h>
#include <nrf_errno.h>
#include <nrf_modem_gnss.h>

#include "tracker_data.h"
#include "tracker_mqtt.h"

LOG_MODULE_REGISTER(lte_vs_gnss_compare, LOG_LEVEL_INF);

enum compare_stage {
	STAGE_1_LTE = 1,
	STAGE_2_GNSS = 2,
};

static K_SEM_DEFINE(mode_btn_sem, 0, 1);
static K_SEM_DEFINE(lte_connected_sem, 0, 1);
static K_SEM_DEFINE(cell_meas_sem, 0, 1);
static K_SEM_DEFINE(gnss_fix_sem, 0, 1);

static atomic_t lte_registered;
static atomic_t meas_active;
static atomic_t gnss_fix_wanted;

static struct tracker_cell_report latest_cell_meas;
static int cell_meas_result;

static struct tracker_gnss_fix latest_gnss_fix;
static bool mqtt_ready;

/* MODE button (sw0, P0.12) with software debounce */
static const struct gpio_dt_spec mode_btn = GPIO_DT_SPEC_GET(DT_ALIAS(sw0), gpios);
static struct gpio_callback mode_btn_cb_data;
static int64_t last_mode_btn_ms;

static void mode_btn_isr(const struct device *dev, struct gpio_callback *cb,
			 uint32_t pins)
{
	int64_t now = k_uptime_get();

	ARG_UNUSED(dev);
	ARG_UNUSED(cb);
	ARG_UNUSED(pins);

	if ((now - last_mode_btn_ms) < CONFIG_COMPARE_BUTTON_DEBOUNCE_MS) {
		return;
	}

	last_mode_btn_ms = now;
	k_sem_give(&mode_btn_sem);
}

static int mode_btn_init(void)
{
	int err;

	if (!gpio_is_ready_dt(&mode_btn)) {
		LOG_ERR("MODE button sw0 GPIO not ready");
		return -ENODEV;
	}

	err = gpio_pin_configure_dt(&mode_btn, GPIO_INPUT);
	if (err != 0) {
		LOG_ERR("Failed to configure sw0 as input: %d", err);
		return err;
	}

	err = gpio_pin_interrupt_configure_dt(&mode_btn, GPIO_INT_EDGE_TO_ACTIVE);
	if (err != 0) {
		LOG_ERR("Failed to configure sw0 interrupt: %d", err);
		return err;
	}

	gpio_init_callback(&mode_btn_cb_data, mode_btn_isr, BIT(mode_btn.pin));
	err = gpio_add_callback(mode_btn.port, &mode_btn_cb_data);
	if (err != 0) {
		LOG_ERR("Failed to add sw0 callback: %d", err);
		return err;
	}

	LOG_INF("MODE button sw0 (P0.%d) ready (debounce=%d ms)",
		mode_btn.pin, CONFIG_COMPARE_BUTTON_DEBOUNCE_MS);
	return 0;
}

/* Status LED blinker: slow (500 ms) for Stage 1, fast (150 ms) for Stage 2, off in SLEEP */
#if DT_NODE_HAS_STATUS(DT_ALIAS(led0), okay) && defined(CONFIG_COMPARE_STATUS_LED)
static const struct gpio_dt_spec status_led = GPIO_DT_SPEC_GET(DT_ALIAS(led0), gpios);
static bool status_led_ready;
static bool led_state_on;
static uint32_t led_interval_ms;
static atomic_t led_blinking;
static struct k_work_delayable led_blink_work;

static void led_blink_work_handler(struct k_work *work)
{
	ARG_UNUSED(work);

	if (!status_led_ready || !atomic_get(&led_blinking)) {
		return;
	}

	led_state_on = !led_state_on;
	(void)gpio_pin_set_dt(&status_led, led_state_on ? 1 : 0);
	(void)k_work_reschedule(&led_blink_work, K_MSEC(led_interval_ms));
}
#endif

static void status_led_init(void)
{
#if DT_NODE_HAS_STATUS(DT_ALIAS(led0), okay) && defined(CONFIG_COMPARE_STATUS_LED)
	if (!gpio_is_ready_dt(&status_led)) {
		LOG_WRN("Status LED GPIO not ready");
		return;
	}

	int err = gpio_pin_configure_dt(&status_led, GPIO_OUTPUT_INACTIVE);
	if (err != 0) {
		LOG_WRN("Failed to configure status LED: %d", err);
		return;
	}

	k_work_init_delayable(&led_blink_work, led_blink_work_handler);
	status_led_ready = true;
#endif
}

static void status_led_start(uint32_t interval_ms)
{
#if DT_NODE_HAS_STATUS(DT_ALIAS(led0), okay) && defined(CONFIG_COMPARE_STATUS_LED)
	if (!status_led_ready) {
		return;
	}

	led_interval_ms = interval_ms;
	atomic_set(&led_blinking, 1);
	led_state_on = true;
	(void)gpio_pin_set_dt(&status_led, 1);
	(void)k_work_reschedule(&led_blink_work, K_MSEC(led_interval_ms));
#else
	ARG_UNUSED(interval_ms);
#endif
}

static void status_led_stop(void)
{
#if DT_NODE_HAS_STATUS(DT_ALIAS(led0), okay) && defined(CONFIG_COMPARE_STATUS_LED)
	struct k_work_sync sync;

	if (!status_led_ready) {
		return;
	}

	atomic_clear(&led_blinking);
	(void)k_work_cancel_delayable_sync(&led_blink_work, &sync);
	led_state_on = false;
	(void)gpio_pin_set_dt(&status_led, 0);
#endif
}

static void power_down_unused_peripherals(void)
{
#if DT_NODE_HAS_STATUS(DT_NODELABEL(w25q32jv), okay) && \
	defined(CONFIG_PM_DEVICE) && defined(CONFIG_SPI_NOR)
	const struct device *flash_dev = DEVICE_DT_GET(DT_NODELABEL(w25q32jv));

	if (device_is_ready(flash_dev)) {
		int err = pm_device_action_run(flash_dev, PM_DEVICE_ACTION_SUSPEND);
		if (err == 0 || err == -EALREADY) {
			LOG_INF("External flash suspended (Deep Power-Down)");
		} else {
			LOG_WRN("Failed to suspend external flash: %d", err);
		}
	}
#endif

#if DT_NODE_HAS_STATUS(DT_ALIAS(accel0), okay) && defined(CONFIG_LIS2DH)
	const struct device *accel = DEVICE_DT_GET(DT_ALIAS(accel0));

	if (device_is_ready(accel)) {
		struct sensor_value odr = { .val1 = 0, .val2 = 0 };
		int err = sensor_attr_set(accel, SENSOR_CHAN_ACCEL_XYZ,
					  SENSOR_ATTR_SAMPLING_FREQUENCY, &odr);
		if (err == 0) {
			LOG_INF("LIS2DH12 powered down (ODR=0)");
		} else {
			LOG_WRN("Failed to power down LIS2DH12: %d", err);
		}
	}
#endif
}

/* Wait on target_sem or abort immediately if MODE button is pressed. */
static int wait_or_mode_abort(struct k_sem *target_sem, k_timeout_t timeout)
{
	struct k_poll_event events[2] = {
		K_POLL_EVENT_STATIC_INITIALIZER(K_POLL_TYPE_SEM_AVAILABLE,
						K_POLL_MODE_NOTIFY_ONLY,
						&mode_btn_sem, 0),
		K_POLL_EVENT_STATIC_INITIALIZER(K_POLL_TYPE_SEM_AVAILABLE,
						K_POLL_MODE_NOTIFY_ONLY,
						target_sem, 0),
	};
	int err = k_poll(events, ARRAY_SIZE(events), timeout);

	if (err == -EAGAIN) {
		return -ETIMEDOUT;
	}
	if (err != 0) {
		return err;
	}

	if (events[0].state == K_POLL_STATE_SEM_AVAILABLE) {
		(void)k_sem_take(&mode_btn_sem, K_NO_WAIT);
		return -ECANCELED;
	}

	if (events[1].state == K_POLL_STATE_SEM_AVAILABLE) {
		(void)k_sem_take(target_sem, K_NO_WAIT);
		return 0;
	}

	return -ETIMEDOUT;
}

static bool mode_abort_pending(void)
{
	return k_sem_take(&mode_btn_sem, K_NO_WAIT) == 0;
}

static int16_t convert_rsrp_dbm(int16_t rsrp_idx)
{
	if (rsrp_idx == LTE_LC_CELL_RSRP_INVALID) {
		return TRACKER_RSRP_DBM_INVALID;
	}
	return (rsrp_idx < 0) ? (rsrp_idx - 140) : (rsrp_idx - 141);
}

static int16_t convert_rsrq(int16_t rsrq_idx)
{
	if (rsrq_idx == LTE_LC_CELL_RSRQ_INVALID) {
		return TRACKER_RSRQ_INVALID;
	}
	return rsrq_idx;
}

static void handle_neighbor_cell_meas(const struct lte_lc_cells_info *cells)
{
	if (!atomic_cas(&meas_active, 1, 0)) {
		return;
	}

	memset(&latest_cell_meas, 0, sizeof(latest_cell_meas));
	if (cells->current_cell.id == LTE_LC_CELL_EUTRAN_ID_INVALID) {
		cell_meas_result = -ENODATA;
		LOG_WRN("Cell measurement completed without a valid serving cell");
		k_sem_give(&cell_meas_sem);
		return;
	}

	latest_cell_meas.uptime_ms = k_uptime_get();
	latest_cell_meas.meas_time_ms = cells->current_cell.measurement_time;
	latest_cell_meas.mcc = cells->current_cell.mcc;
	latest_cell_meas.mnc = cells->current_cell.mnc;
	latest_cell_meas.tac = cells->current_cell.tac;
	latest_cell_meas.cell_id = cells->current_cell.id;
	latest_cell_meas.earfcn = cells->current_cell.earfcn;
	latest_cell_meas.pci = cells->current_cell.phys_cell_id;
	latest_cell_meas.rsrp_dbm = convert_rsrp_dbm(cells->current_cell.rsrp);
	latest_cell_meas.rsrq = convert_rsrq(cells->current_cell.rsrq);

#if CONFIG_TRACKER_MAX_NEIGHBOR_CELLS > 0
	if (cells->neighbor_cells != NULL && cells->ncells_count > 0) {
		uint8_t copy_count = cells->ncells_count;

		if (copy_count > CONFIG_TRACKER_MAX_NEIGHBOR_CELLS) {
			copy_count = CONFIG_TRACKER_MAX_NEIGHBOR_CELLS;
		}
		latest_cell_meas.ncell_count = copy_count;
		for (uint8_t i = 0; i < copy_count; i++) {
			latest_cell_meas.ncells[i].earfcn = cells->neighbor_cells[i].earfcn;
			latest_cell_meas.ncells[i].pci = cells->neighbor_cells[i].phys_cell_id;
			latest_cell_meas.ncells[i].rsrp_dbm =
				convert_rsrp_dbm(cells->neighbor_cells[i].rsrp);
			latest_cell_meas.ncells[i].rsrq =
				convert_rsrq(cells->neighbor_cells[i].rsrq);
		}
	}
#endif

	cell_meas_result = 0;
	LOG_INF("[STAGE 1] Cell location: MCC=%d MNC=%d TAC=%u CID=%u PCI=%u RSRP=%d dBm (ncells=%u)",
		latest_cell_meas.mcc, latest_cell_meas.mnc, latest_cell_meas.tac,
		latest_cell_meas.cell_id, latest_cell_meas.pci, latest_cell_meas.rsrp_dbm,
		latest_cell_meas.ncell_count);
	k_sem_give(&cell_meas_sem);
}

static void lte_event_handler(const struct lte_lc_evt *const evt)
{
	switch (evt->type) {
	case LTE_LC_EVT_NW_REG_STATUS:
		if (evt->nw_reg_status == LTE_LC_NW_REG_REGISTERED_HOME ||
		    evt->nw_reg_status == LTE_LC_NW_REG_REGISTERED_ROAMING) {
			atomic_set(&lte_registered, 1);
			LOG_INF("LTE registered (%s)",
				evt->nw_reg_status == LTE_LC_NW_REG_REGISTERED_HOME ?
				"home" : "roaming");
			k_sem_give(&lte_connected_sem);
		} else {
			atomic_clear(&lte_registered);
		}
		break;

	case LTE_LC_EVT_NEIGHBOR_CELL_MEAS:
		handle_neighbor_cell_meas(&evt->cells_info);
		break;

	default:
		break;
	}
}

static void gnss_event_handler(int event)
{
	struct nrf_modem_gnss_pvt_data_frame pvt;
	int err;

	if (event != NRF_MODEM_GNSS_EVT_PVT) {
		return;
	}

	err = nrf_modem_gnss_read(&pvt, sizeof(pvt), NRF_MODEM_GNSS_DATA_PVT);
	if (err != 0) {
		LOG_ERR("nrf_modem_gnss_read failed: %d", err);
		return;
	}

	if ((pvt.flags & NRF_MODEM_GNSS_PVT_FLAG_FIX_VALID) != 0 &&
	    atomic_cas(&gnss_fix_wanted, 1, 0)) {
		latest_gnss_fix.latitude = pvt.latitude;
		latest_gnss_fix.longitude = pvt.longitude;
		latest_gnss_fix.altitude = pvt.altitude;
		latest_gnss_fix.accuracy = pvt.accuracy;
		latest_gnss_fix.datetime = pvt.datetime;
		LOG_INF("[STAGE 2] GNSS fix: lat=%.6f lon=%.6f alt=%.1f m acc=%.1f m",
			latest_gnss_fix.latitude, latest_gnss_fix.longitude,
			(double)latest_gnss_fix.altitude, (double)latest_gnss_fix.accuracy);
		k_sem_give(&gnss_fix_sem);
	}
}

static void radio_turn_off_lte(void)
{
	int err;

	atomic_clear(&lte_registered);
	err = lte_lc_func_mode_set(LTE_LC_FUNC_MODE_DEACTIVATE_LTE);
	if (err != 0) {
		LOG_WRN("Failed to deactivate LTE: %d", err);
	} else {
		LOG_INF("LTE turned OFF");
	}
}

static void radio_turn_off_gnss(void)
{
	int err;

	atomic_clear(&gnss_fix_wanted);
	err = nrf_modem_gnss_stop();
	if (err != 0 && err != -NRF_EPERM) {
		LOG_WRN("nrf_modem_gnss_stop returned: %d", err);
	}

	err = lte_lc_func_mode_set(LTE_LC_FUNC_MODE_DEACTIVATE_GNSS);
	if (err != 0) {
		LOG_WRN("Failed to deactivate GNSS: %d", err);
	} else {
		LOG_INF("GNSS turned OFF");
	}
}

static int radio_open_and_connect_lte(k_timeout_t timeout)
{
	int err;

	if (mode_abort_pending()) {
		return -ECANCELED;
	}

	k_sem_reset(&lte_connected_sem);
	LOG_INF("Opening LTE and connecting (timeout %d s)...",
		CONFIG_COMPARE_LTE_TIMEOUT_SECONDS);
	err = lte_lc_func_mode_set(LTE_LC_FUNC_MODE_NORMAL);
	if (err != 0) {
		LOG_ERR("Failed to open LTE: %d", err);
		return err;
	}

	err = wait_or_mode_abort(&lte_connected_sem, timeout);
	if (err == -ECANCELED) {
		LOG_WRN("LTE connect aborted by MODE button");
	} else if (err != 0) {
		LOG_WRN("LTE registration timed out");
	}

	return err;
}

static int stage1_get_cell_location(struct tracker_cell_report *out, k_timeout_t timeout)
{
	struct lte_lc_ncellmeas_params params = {
		.search_type = LTE_LC_NEIGHBOR_SEARCH_TYPE_DEFAULT,
	};
	int err;

	if (mode_abort_pending()) {
		return -ECANCELED;
	}

	k_sem_reset(&cell_meas_sem);
	cell_meas_result = -ENODATA;
	atomic_set(&meas_active, 1);

	LOG_INF("[STAGE 1] Getting LTE cell location...");
	err = lte_lc_neighbor_cell_measurement(&params);
	if (err != 0) {
		atomic_clear(&meas_active);
		LOG_ERR("lte_lc_neighbor_cell_measurement failed: %d", err);
		return err;
	}

	err = wait_or_mode_abort(&cell_meas_sem, timeout);
	if (err != 0) {
		if (atomic_cas(&meas_active, 1, 0)) {
			(void)lte_lc_neighbor_cell_measurement_cancel();
		}
		if (err == -ECANCELED) {
			LOG_WRN("[STAGE 1] Cell measurement aborted by MODE button");
		} else {
			LOG_WRN("[STAGE 1] Cell measurement timed out");
		}
		return err;
	}

	if (cell_meas_result != 0) {
		return cell_meas_result;
	}

	*out = latest_cell_meas;
	return 0;
}

static int stage2_open_and_get_gnss(struct tracker_gnss_fix *out, k_timeout_t timeout)
{
	uint8_t use_case = NRF_MODEM_GNSS_USE_CASE_MULTIPLE_HOT_START;
	int err;

	if (mode_abort_pending()) {
		return -ECANCELED;
	}

	/* Preserve GPS-first sequencing: LTE must be deactivated before GNSS. */
	radio_turn_off_lte();

	LOG_INF("[STAGE 2] Opening GNSS (timeout %d s)...",
		CONFIG_COMPARE_GNSS_TIMEOUT_SECONDS);
	err = lte_lc_func_mode_set(LTE_LC_FUNC_MODE_ACTIVATE_GNSS);
	if (err != 0) {
		LOG_ERR("Failed to activate GNSS: %d", err);
		return err;
	}

	if (IS_ENABLED(CONFIG_COMPARE_GNSS_LOW_ACCURACY)) {
		use_case |= NRF_MODEM_GNSS_USE_CASE_LOW_ACCURACY;
	}

	err = nrf_modem_gnss_event_handler_set(gnss_event_handler);
	if (err != 0) {
		LOG_ERR("nrf_modem_gnss_event_handler_set failed: %d", err);
		return err;
	}

	err = nrf_modem_gnss_use_case_set(use_case);
	if (err != 0) {
		LOG_ERR("nrf_modem_gnss_use_case_set failed: %d", err);
		return err;
	}

	/* Single-fix mode: fix_interval = 0, retry timeout configured by Kconfig. */
	err = nrf_modem_gnss_fix_interval_set(0);
	if (err != 0) {
		LOG_ERR("nrf_modem_gnss_fix_interval_set failed: %d", err);
		return err;
	}

	err = nrf_modem_gnss_fix_retry_set(CONFIG_COMPARE_GNSS_TIMEOUT_SECONDS);
	if (err != 0) {
		LOG_ERR("nrf_modem_gnss_fix_retry_set failed: %d", err);
		return err;
	}

	k_sem_reset(&gnss_fix_sem);
	atomic_set(&gnss_fix_wanted, 1);

	err = nrf_modem_gnss_start();
	if (err != 0) {
		atomic_clear(&gnss_fix_wanted);
		LOG_ERR("nrf_modem_gnss_start failed: %d", err);
		return err;
	}

	err = wait_or_mode_abort(&gnss_fix_sem, timeout);
	if (err == -ECANCELED) {
		LOG_WRN("[STAGE 2] GNSS search aborted by MODE button");
	} else if (err != 0) {
		LOG_WRN("[STAGE 2] GNSS fix timed out");
	} else {
		*out = latest_gnss_fix;
	}

	return err;
}

/*
 * Stage 1:
 * start -> open LTE -> connect LTE -> get location -> sending MQTT -> turn off LTE -> sleep
 */
static void run_stage1_lte(void)
{
	struct tracker_cell_report cell_report;
	int err;

	LOG_INF("================================================");
	LOG_INF("[STAGE 1: LTE] START (press MODE anytime -> SLEEP)");
	LOG_INF("================================================");
	status_led_start(500);

	err = radio_open_and_connect_lte(K_SECONDS(CONFIG_COMPARE_LTE_TIMEOUT_SECONDS));
	if (err != 0) {
		goto cleanup;
	}

	err = stage1_get_cell_location(&cell_report,
				       K_SECONDS(CONFIG_COMPARE_CELL_MEAS_TIMEOUT_SECONDS));
	if (err != 0) {
		goto cleanup;
	}

	if (mode_abort_pending()) {
		LOG_WRN("[STAGE 1] Aborted by MODE before MQTT");
		goto cleanup;
	}

	LOG_INF("[STAGE 1] Sending MQTT...");
	if (!mqtt_ready) {
		LOG_WRN("MQTT not initialized (check CA cert/credentials)");
	} else {
		err = tracker_mqtt_connect(K_SECONDS(15), &mode_btn_sem);
		if (err == 0) {
			err = tracker_mqtt_publish_telemetry(NULL, &cell_report,
							     K_SECONDS(15),
							     &mode_btn_sem);
			if (err != 0 && err != -ECANCELED) {
				LOG_ERR("[STAGE 1] MQTT publish failed: %d", err);
			}
		}
		(void)tracker_mqtt_disconnect(K_SECONDS(10));
	}

cleanup:
	status_led_stop();
	radio_turn_off_lte();
	LOG_INF("[STAGE 1: LTE] Done -> entering SLEEP");
}

/*
 * Stage 2:
 * start -> Open GNSS -> get location -> off GNSS -> connect LTE -> sending MQTT -> off LTE -> sleep
 */
static void run_stage2_gnss(void)
{
	struct tracker_gnss_fix gnss_fix;
	int err;

	LOG_INF("================================================");
	LOG_INF("[STAGE 2: GNSS] START (press MODE anytime -> SLEEP)");
	LOG_INF("================================================");
	status_led_start(150);

	err = stage2_open_and_get_gnss(&gnss_fix,
				       K_SECONDS(CONFIG_COMPARE_GNSS_TIMEOUT_SECONDS));
	/* Always turn GNSS off before LTE or SLEEP. */
	radio_turn_off_gnss();
	if (err != 0) {
		goto cleanup;
	}

	err = radio_open_and_connect_lte(K_SECONDS(CONFIG_COMPARE_LTE_TIMEOUT_SECONDS));
	if (err != 0) {
		goto cleanup;
	}

	if (mode_abort_pending()) {
		LOG_WRN("[STAGE 2] Aborted by MODE before MQTT");
		goto cleanup;
	}

	LOG_INF("[STAGE 2] Sending MQTT...");
	if (!mqtt_ready) {
		LOG_WRN("MQTT not initialized (check CA cert/credentials)");
	} else {
		err = tracker_mqtt_connect(K_SECONDS(15), &mode_btn_sem);
		if (err == 0) {
			err = tracker_mqtt_publish_telemetry(&gnss_fix, NULL,
							     K_SECONDS(15),
							     &mode_btn_sem);
			if (err != 0 && err != -ECANCELED) {
				LOG_ERR("[STAGE 2] MQTT publish failed: %d", err);
			}
		}
		(void)tracker_mqtt_disconnect(K_SECONDS(10));
	}

cleanup:
	status_led_stop();
	radio_turn_off_gnss();
	radio_turn_off_lte();
	LOG_INF("[STAGE 2: GNSS] Done -> entering SLEEP");
}

static void run_sleep_stage(enum compare_stage next_stage)
{
	k_timeout_t wait_time = (CONFIG_COMPARE_SLEEP_TIMEOUT_SECONDS > 0) ?
		K_SECONDS(CONFIG_COMPARE_SLEEP_TIMEOUT_SECONDS) : K_FOREVER;
	int err;

	status_led_stop();
	/* Clear any leftover button edge from aborting the previous stage. */
	k_sem_reset(&mode_btn_sem);

	LOG_INF("[SLEEP] Radio OFF (System ON Idle). Press MODE to wake -> Stage %d (%s)",
		(int)next_stage,
		(next_stage == STAGE_1_LTE) ? "LTE" : "GNSS");

	err = k_sem_take(&mode_btn_sem, wait_time);
	if (err == 0) {
		LOG_INF("[SLEEP] Woke up by MODE button -> Stage %d (%s)",
			(int)next_stage,
			(next_stage == STAGE_1_LTE) ? "LTE" : "GNSS");
	} else {
		LOG_INF("[SLEEP] Woke up by timer -> Stage %d (%s)",
			(int)next_stage,
			(next_stage == STAGE_1_LTE) ? "LTE" : "GNSS");
	}
}

int main(void)
{
	enum compare_stage current_stage = STAGE_1_LTE;
	int err;

	status_led_init();
	LOG_INF("=== LTE (Stage 1) vs GNSS (Stage 2) Comparison Firmware ===");

	power_down_unused_peripherals();

	err = mode_btn_init();
	if (err != 0) {
		LOG_ERR("MODE button init failed: %d", err);
		return 0;
	}

	err = nrf_modem_lib_init();
	if (err != 0) {
		LOG_ERR("nrf_modem_lib_init failed: %d", err);
		return 0;
	}
	lte_lc_register_handler(lte_event_handler);

	/* Start with both LTE and GNSS deactivated until Stage 1 opens LTE. */
	radio_turn_off_lte();
	radio_turn_off_gnss();

	err = tracker_mqtt_init();
	if (err != 0) {
		LOG_WRN("MQTT init failed (%d); MQTT sending will be skipped", err);
		mqtt_ready = false;
	} else {
		mqtt_ready = true;
	}

	while (true) {
		if (current_stage == STAGE_1_LTE) {
			run_stage1_lte();
			current_stage = STAGE_2_GNSS;
		} else {
			run_stage2_gnss();
			current_stage = STAGE_1_LTE;
		}

		run_sleep_stage(current_stage);
	}

	return 0;
}
```

## src/circuitdojo_gnss.c
```c
/*
 * Copyright (c) 2021 Circuit Dojo LLC
 * Copyright (c) 2026 Cellular Asset Tracker Project
 * SPDX-License-Identifier: Apache-2.0
 */

#include <errno.h>

#include <zephyr/device.h>
#include <zephyr/drivers/gpio.h>
#include <zephyr/init.h>
#include <zephyr/kernel.h>

static int circuit_dojo_gnss_setup(void)
{
	const struct device *gpio = DEVICE_DT_GET(DT_NODELABEL(gpio0));

	if (!device_is_ready(gpio)) {
		return -ENODEV;
	}

	return gpio_pin_configure(gpio, CONFIG_TRACKER_GNSS_POWER_MODE_PIN,
				  GPIO_OUTPUT_LOW);
}

SYS_INIT(circuit_dojo_gnss_setup, APPLICATION, CONFIG_APPLICATION_INIT_PRIORITY);
```

## src/tracker_data.h
```c
/*
 * Copyright (c) 2026 Cellular Asset Tracker Project
 * SPDX-License-Identifier: Apache-2.0
 */

#ifndef TRACKER_DATA_H_
#define TRACKER_DATA_H_

#include <stdint.h>
#include <nrf_modem_gnss.h>

#define TRACKER_RSRP_DBM_INVALID INT16_MIN
#define TRACKER_RSRQ_INVALID     INT16_MIN

struct tracker_neighbor_cell {
	uint32_t earfcn;
	uint16_t pci;
	int16_t rsrp_dbm;
	int16_t rsrq;
};

struct tracker_cell_report {
	int64_t uptime_ms;
	uint64_t meas_time_ms;
	int mcc;
	int mnc;
	uint32_t tac;
	uint32_t cell_id;
	uint32_t earfcn;
	uint16_t pci;
	int16_t rsrp_dbm;
	int16_t rsrq;
	uint8_t ncell_count;
#if CONFIG_TRACKER_MAX_NEIGHBOR_CELLS > 0
	struct tracker_neighbor_cell ncells[CONFIG_TRACKER_MAX_NEIGHBOR_CELLS];
#endif
};

struct tracker_gnss_fix {
	double latitude;
	double longitude;
	float altitude;
	float accuracy;
	struct nrf_modem_gnss_datetime datetime;
};

#endif /* TRACKER_DATA_H_ */
```

## src/tracker_mqtt.c
```c
/*
 * Copyright (c) 2026 Cellular Asset Tracker Project
 * SPDX-License-Identifier: Apache-2.0
 */

#include <errno.h>
#include <stdarg.h>
#include <stdio.h>
#include <string.h>

#include <zephyr/kernel.h>
#include <zephyr/logging/log.h>
#include <zephyr/sys/atomic.h>

#include <modem/lte_lc.h>
#include <modem/modem_key_mgmt.h>
#include <net/mqtt_helper.h>
#include <nrf_modem_at.h>

#include "tracker_mqtt.h"

LOG_MODULE_REGISTER(tracker_mqtt, LOG_LEVEL_INF);

#define IMEI_LEN             15
#define CGSN_RESPONSE_LENGTH (IMEI_LEN + 6 + 1)
#define CLIENT_ID_LEN        (sizeof("nrf-") + IMEI_LEN)
#define MQTT_PAYLOAD_MAX_LEN 1024

static K_SEM_DEFINE(mqtt_conn_sem, 0, 1);
static K_SEM_DEFINE(mqtt_puback_sem, 0, 1);
static K_SEM_DEFINE(mqtt_disconnected_sem, 0, 1);

static char client_id_buf[CLIENT_ID_LEN];
static char payload_buf[MQTT_PAYLOAD_MAX_LEN];

static enum mqtt_conn_return_code connack_result;
static int puback_result;
static uint16_t pending_publish_id;
static atomic_t connect_attempted;

static const unsigned char broker_ca_certificate[] = {
#if __has_include("ca-cert.pem")
#include "ca-cert.pem"
#else
	""
#endif
};

static int wait_sem_or_abort(struct k_sem *target_sem, struct k_sem *abort_sem,
			     k_timeout_t timeout)
{
	if (abort_sem == NULL) {
		return k_sem_take(target_sem, timeout);
	}

	struct k_poll_event events[2] = {
		K_POLL_EVENT_STATIC_INITIALIZER(K_POLL_TYPE_SEM_AVAILABLE,
						K_POLL_MODE_NOTIFY_ONLY,
						abort_sem, 0),
		K_POLL_EVENT_STATIC_INITIALIZER(K_POLL_TYPE_SEM_AVAILABLE,
						K_POLL_MODE_NOTIFY_ONLY,
						target_sem, 0),
	};
	int err = k_poll(events, ARRAY_SIZE(events), timeout);

	if (err == -EAGAIN) {
		return -ETIMEDOUT;
	}
	if (err != 0) {
		return err;
	}

	if (events[0].state == K_POLL_STATE_SEM_AVAILABLE) {
		(void)k_sem_take(abort_sem, K_NO_WAIT);
		return -ECANCELED;
	}

	if (events[1].state == K_POLL_STATE_SEM_AVAILABLE) {
		(void)k_sem_take(target_sem, K_NO_WAIT);
		return 0;
	}

	return -ETIMEDOUT;
}

static int append_fmt(char *buf, size_t cap, size_t *pos, const char *fmt, ...)
{
	va_list args;
	int written;

	if (*pos >= cap) {
		return -EMSGSIZE;
	}

	va_start(args, fmt);
	written = vsnprintf(buf + *pos, cap - *pos, fmt, args);
	va_end(args);

	if (written < 0 || (size_t)written >= (cap - *pos)) {
		return -EMSGSIZE;
	}

	*pos += (size_t)written;
	return 0;
}

static int append_optional_int16(char *buf, size_t cap, size_t *pos,
				 int16_t value, int16_t invalid_sentinel)
{
	if (value == invalid_sentinel) {
		return append_fmt(buf, cap, pos, "null");
	}
	return append_fmt(buf, cap, pos, "%d", value);
}

static int append_gnss_object(const struct tracker_gnss_fix *gnss,
			      char *buf, size_t cap, size_t *pos)
{
	if (gnss == NULL) {
		return append_fmt(buf, cap, pos, "null");
	}

	return append_fmt(buf, cap, pos,
			  "{\"lat\":%.6f,\"lon\":%.6f,\"alt\":%.1f,\"acc\":%.1f,"
			  "\"time\":\"%04u-%02u-%02uT%02u:%02u:%02uZ\"}",
			  gnss->latitude, gnss->longitude,
			  (double)gnss->altitude, (double)gnss->accuracy,
			  gnss->datetime.year, gnss->datetime.month, gnss->datetime.day,
			  gnss->datetime.hour, gnss->datetime.minute, gnss->datetime.seconds);
}

static int append_lte_object(const struct tracker_cell_report *lte,
			     char *buf, size_t cap, size_t *pos)
{
	int err;

	if (lte == NULL) {
		return append_fmt(buf, cap, pos, "null");
	}

	err = append_fmt(buf, cap, pos, "{\"mcc\":%d,\"mnc\":%d,\"tac\":",
			 lte->mcc, lte->mnc);
	if (err != 0) {
		return err;
	}

	if (lte->tac == LTE_LC_CELL_TAC_INVALID) {
		err = append_fmt(buf, cap, pos, "null");
	} else {
		err = append_fmt(buf, cap, pos, "%u", lte->tac);
	}
	if (err != 0) {
		return err;
	}

	err = append_fmt(buf, cap, pos,
			 ",\"cid\":%u,\"earfcn\":%u,\"pci\":%u,\"rsrp\":",
			 lte->cell_id, lte->earfcn, lte->pci);
	if (err != 0) {
		return err;
	}

	err = append_optional_int16(buf, cap, pos, lte->rsrp_dbm,
				    TRACKER_RSRP_DBM_INVALID);
	if (err != 0) {
		return err;
	}

	err = append_fmt(buf, cap, pos, ",\"rsrq\":");
	if (err != 0) {
		return err;
	}

	err = append_optional_int16(buf, cap, pos, lte->rsrq,
				    TRACKER_RSRQ_INVALID);
	if (err != 0) {
		return err;
	}

	err = append_fmt(buf, cap, pos, ",\"ncells\":[");
	if (err != 0) {
		return err;
	}

#if CONFIG_TRACKER_MAX_NEIGHBOR_CELLS > 0
	for (uint8_t i = 0; i < lte->ncell_count &&
	     i < CONFIG_TRACKER_MAX_NEIGHBOR_CELLS; i++) {
		const struct tracker_neighbor_cell *nc = &lte->ncells[i];

		err = append_fmt(buf, cap, pos,
				 "%s{\"earfcn\":%u,\"pci\":%u,\"rsrp\":",
				 (i > 0) ? "," : "", nc->earfcn, nc->pci);
		if (err != 0) {
			return err;
		}
		err = append_optional_int16(buf, cap, pos, nc->rsrp_dbm,
					    TRACKER_RSRP_DBM_INVALID);
		if (err != 0) {
			return err;
		}
		err = append_fmt(buf, cap, pos, ",\"rsrq\":");
		if (err != 0) {
			return err;
		}
		err = append_optional_int16(buf, cap, pos, nc->rsrq,
					    TRACKER_RSRQ_INVALID);
		if (err != 0) {
			return err;
		}
		err = append_fmt(buf, cap, pos, "}");
		if (err != 0) {
			return err;
		}
	}
#endif

	return append_fmt(buf, cap, pos, "]}");
}

static int format_unified_telemetry_json(const struct tracker_gnss_fix *gnss,
					 const struct tracker_cell_report *lte,
					 char *buf, size_t cap, size_t *out_len)
{
	const char *source = (gnss != NULL && lte != NULL) ? "hybrid" :
			     (gnss != NULL) ? "gnss" : "lte";
	int64_t uptime_ms = (lte != NULL) ? lte->uptime_ms : k_uptime_get();
	size_t pos = 0;
	int err;

	err = append_fmt(buf, cap, &pos,
			 "{\"device_id\":\"%s\",\"uptime_ms\":%lld,"
			 "\"source\":\"%s\",\"gnss\":",
			 client_id_buf, (long long)uptime_ms, source);
	if (err != 0) {
		return err;
	}

	err = append_gnss_object(gnss, buf, cap, &pos);
	if (err != 0) {
		return err;
	}

	err = append_fmt(buf, cap, &pos, ",\"lte\":");
	if (err != 0) {
		return err;
	}

	err = append_lte_object(lte, buf, cap, &pos);
	if (err != 0) {
		return err;
	}

	err = append_fmt(buf, cap, &pos, "}");
	if (err != 0) {
		return err;
	}

	*out_len = pos;
	return 0;
}

static int broker_ca_provision(void)
{
	bool exists;
	int err;
	int comparison;

	if (sizeof(broker_ca_certificate) <= 1) {
		LOG_ERR("TLS is enabled but credentials/ca-cert.pem is missing");
		return -ENOENT;
	}

	err = modem_key_mgmt_exists(CONFIG_MQTT_HELPER_SEC_TAG,
				    MODEM_KEY_MGMT_CRED_TYPE_CA_CHAIN, &exists);
	if (err != 0) {
		LOG_ERR("Failed to check MQTT broker CA: %d", err);
		return err;
	}

	if (exists) {
		comparison = modem_key_mgmt_cmp(CONFIG_MQTT_HELPER_SEC_TAG,
						MODEM_KEY_MGMT_CRED_TYPE_CA_CHAIN,
						broker_ca_certificate,
						sizeof(broker_ca_certificate) - 1);
		if (comparison == 0) {
			LOG_INF("MQTT broker CA already provisioned");
			return 0;
		}

		err = modem_key_mgmt_delete(CONFIG_MQTT_HELPER_SEC_TAG,
					    MODEM_KEY_MGMT_CRED_TYPE_CA_CHAIN);
		if (err != 0) {
			LOG_ERR("Failed to replace MQTT broker CA: %d", err);
			return err;
		}
	}

	err = modem_key_mgmt_write(CONFIG_MQTT_HELPER_SEC_TAG,
				   MODEM_KEY_MGMT_CRED_TYPE_CA_CHAIN,
				   broker_ca_certificate,
				   sizeof(broker_ca_certificate) - 1);
	if (err != 0) {
		LOG_ERR("Failed to provision MQTT broker CA: %d", err);
		return err;
	}

	LOG_INF("MQTT broker CA provisioned in sec tag %d", CONFIG_MQTT_HELPER_SEC_TAG);
	return 0;
}

static int client_id_get(char *buffer, size_t buffer_len)
{
	char imei_buf[CGSN_RESPONSE_LENGTH];
	int len;
	int err;

	if (strlen(CONFIG_MQTT_CLIENT_ID) > 0) {
		len = snprintf(buffer, buffer_len, "%s", CONFIG_MQTT_CLIENT_ID);
		if (len < 0 || (size_t)len >= buffer_len) {
			LOG_ERR("Configured MQTT client ID is too long");
			return -EMSGSIZE;
		}
		return 0;
	}

	err = nrf_modem_at_cmd(imei_buf, sizeof(imei_buf), "AT+CGSN");
	if (err != 0) {
		LOG_ERR("Failed to obtain IMEI via AT+CGSN: %d", err);
		return err;
	}

	imei_buf[IMEI_LEN] = '\0';
	len = snprintf(buffer, buffer_len, "nrf-%.*s", IMEI_LEN, imei_buf);
	if (len < 0 || (size_t)len >= buffer_len) {
		LOG_ERR("Generated MQTT client ID is too long");
		return -EMSGSIZE;
	}

	LOG_INF("MQTT client ID: %s", buffer);
	return 0;
}

static void on_mqtt_connack(enum mqtt_conn_return_code return_code, bool session_present)
{
	ARG_UNUSED(session_present);

	connack_result = return_code;
	if (return_code == MQTT_CONNECTION_ACCEPTED) {
		LOG_INF("MQTT connected to %s:%d", CONFIG_MQTT_BROKER_HOSTNAME,
			CONFIG_MQTT_BROKER_PORT);
	} else {
		LOG_ERR("MQTT broker rejected connection: %d", return_code);
	}

	k_sem_give(&mqtt_conn_sem);
}

static void on_mqtt_disconnect(int result)
{
	atomic_clear(&connect_attempted);
	if (result == 0) {
		LOG_INF("MQTT disconnected");
	} else {
		LOG_WRN("MQTT disconnected with result: %d", result);
	}
	k_sem_give(&mqtt_disconnected_sem);
}

static void on_mqtt_puback(uint16_t message_id, int result)
{
	if (message_id != pending_publish_id) {
		LOG_WRN("Unexpected MQTT PUBACK ID: %u", message_id);
		return;
	}

	puback_result = result;
	if (result != 0) {
		LOG_ERR("MQTT PUBACK failed for ID %u: %d", message_id, result);
	} else {
		LOG_INF("MQTT PUBACK received (ID: %u)", message_id);
	}
	k_sem_give(&mqtt_puback_sem);
}

int tracker_mqtt_init(void)
{
	struct mqtt_helper_cfg mqtt_cfg = {
		.cb = {
			.on_connack = on_mqtt_connack,
			.on_disconnect = on_mqtt_disconnect,
			.on_puback = on_mqtt_puback,
		},
	};
	int err;

	if (strlen(CONFIG_MQTT_BROKER_PASSWORD) > 0 &&
	    strlen(CONFIG_MQTT_BROKER_USERNAME) == 0) {
		LOG_ERR("MQTT password is configured without a username");
		return -EINVAL;
	}

	if (IS_ENABLED(CONFIG_MQTT_LIB_TLS)) {
		err = broker_ca_provision();
		if (err != 0) {
			return err;
		}
	}

	err = mqtt_helper_init(&mqtt_cfg);
	if (err != 0) {
		LOG_ERR("mqtt_helper_init failed: %d", err);
		return err;
	}

	return client_id_get(client_id_buf, sizeof(client_id_buf));
}

int tracker_mqtt_connect(k_timeout_t timeout, struct k_sem *abort_sem)
{
	struct mqtt_helper_conn_params conn_params = {
		.hostname.ptr = CONFIG_MQTT_BROKER_HOSTNAME,
		.hostname.size = strlen(CONFIG_MQTT_BROKER_HOSTNAME),
		.device_id.ptr = client_id_buf,
		.device_id.size = strlen(client_id_buf),
		.user_name.ptr = CONFIG_MQTT_BROKER_USERNAME,
		.user_name.size = strlen(CONFIG_MQTT_BROKER_USERNAME),
		.password.ptr = CONFIG_MQTT_BROKER_PASSWORD,
		.password.size = strlen(CONFIG_MQTT_BROKER_PASSWORD),
	};
	int err;

	LOG_INF("Connecting to MQTT broker (%s:%d)...", CONFIG_MQTT_BROKER_HOSTNAME,
		CONFIG_MQTT_BROKER_PORT);
	k_sem_reset(&mqtt_conn_sem);
	connack_result = MQTT_UNACCEPTABLE_PROTOCOL_VERSION;

	err = mqtt_helper_connect(&conn_params);
	if (err != 0) {
		LOG_ERR("mqtt_helper_connect failed: %d", err);
		return err;
	}
	atomic_set(&connect_attempted, 1);

	err = wait_sem_or_abort(&mqtt_conn_sem, abort_sem, timeout);
	if (err != 0) {
		if (err == -ECANCELED) {
			LOG_WRN("MQTT connect cancelled by MODE button");
		} else {
			LOG_ERR("MQTT CONNACK timed out");
		}
		return err;
	}
	if (connack_result != MQTT_CONNECTION_ACCEPTED) {
		return -ECONNREFUSED;
	}

	return 0;
}

int tracker_mqtt_publish_telemetry(const struct tracker_gnss_fix *gnss,
				   const struct tracker_cell_report *lte,
				   k_timeout_t timeout,
				   struct k_sem *abort_sem)
{
	struct mqtt_publish_param param = { 0 };
	size_t payload_len = 0;
	int err;

	if (gnss == NULL && lte == NULL) {
		return -EINVAL;
	}

	err = format_unified_telemetry_json(gnss, lte, payload_buf,
					    sizeof(payload_buf), &payload_len);
	if (err != 0) {
		LOG_ERR("Unified telemetry JSON formatting failed: %d", err);
		return err;
	}

	param.message.payload.data = (uint8_t *)payload_buf;
	param.message.payload.len = payload_len;
	param.message.topic.qos = (enum mqtt_qos)CONFIG_MQTT_PUB_QOS;
	param.message.topic.topic.utf8 = CONFIG_MQTT_PUB_TOPIC;
	param.message.topic.topic.size = strlen(CONFIG_MQTT_PUB_TOPIC);
	pending_publish_id = mqtt_helper_msg_id_get();
	param.message_id = pending_publish_id;

	LOG_INF("Publishing unified payload to '%s' (QoS %d, %zu bytes): %s",
		CONFIG_MQTT_PUB_TOPIC, CONFIG_MQTT_PUB_QOS, payload_len, payload_buf);
	if (CONFIG_MQTT_PUB_QOS == MQTT_QOS_1_AT_LEAST_ONCE) {
		k_sem_reset(&mqtt_puback_sem);
		puback_result = 0;
	}

	err = mqtt_helper_publish(&param);
	if (err != 0) {
		LOG_ERR("mqtt_helper_publish failed: %d", err);
		return err;
	}

	if (CONFIG_MQTT_PUB_QOS == MQTT_QOS_0_AT_MOST_ONCE) {
		return 0;
	}

	err = wait_sem_or_abort(&mqtt_puback_sem, abort_sem, timeout);
	if (err != 0) {
		if (err == -ECANCELED) {
			LOG_WRN("MQTT PUBACK wait cancelled by MODE button");
		} else {
			LOG_ERR("MQTT PUBACK timed out");
		}
		return err;
	}

	return puback_result;
}

int tracker_mqtt_disconnect(k_timeout_t timeout)
{
	int err;

	if (!atomic_get(&connect_attempted)) {
		return 0;
	}

	k_sem_reset(&mqtt_disconnected_sem);
	err = mqtt_helper_disconnect();
	if (err != 0) {
		LOG_ERR("mqtt_helper_disconnect failed: %d", err);
		return err;
	}

	err = k_sem_take(&mqtt_disconnected_sem, timeout);
	if (err != 0) {
		LOG_WRN("MQTT disconnect timed out");
		return -ETIMEDOUT;
	}

	return 0;
}
```

## src/tracker_mqtt.h
```c
/*
 * Copyright (c) 2026 Cellular Asset Tracker Project
 * SPDX-License-Identifier: Apache-2.0
 */

#ifndef TRACKER_MQTT_H_
#define TRACKER_MQTT_H_

#include <zephyr/kernel.h>

#include "tracker_data.h"

int tracker_mqtt_init(void);
int tracker_mqtt_connect(k_timeout_t timeout, struct k_sem *abort_sem);

/*
 * Publish unified telemetry JSON containing both "gnss" and "lte" objects.
 * Pass NULL for whichever subsystem was not acquired in the current cycle
 * (emitted as JSON null). At least one of gnss or lte must be non-NULL.
 */
int tracker_mqtt_publish_telemetry(const struct tracker_gnss_fix *gnss,
				   const struct tracker_cell_report *lte,
				   k_timeout_t timeout,
				   struct k_sem *abort_sem);

int tracker_mqtt_disconnect(k_timeout_t timeout);

#endif /* TRACKER_MQTT_H_ */
```
