## CMakeLists.txt
```
#
# Copyright (c) 2024 Nordic Semiconductor ASA
# SPDX-License-Identifier: LicenseRef-Nordic-5-Clause
#

cmake_minimum_required(VERSION 3.20.0)

# Keep the default application configuration grouped by subsystem. prj.conf
# remains the standard Zephyr entry point, while these fragments are merged in
# the listed order before any command-line overlay configuration.
set(TRACKER_CONF_FILES
  ${CMAKE_CURRENT_SOURCE_DIR}/config/system.conf
  ${CMAKE_CURRENT_SOURCE_DIR}/config/logging.conf
  ${CMAKE_CURRENT_SOURCE_DIR}/config/hardware.conf
  ${CMAKE_CURRENT_SOURCE_DIR}/config/networking.conf
  ${CMAKE_CURRENT_SOURCE_DIR}/config/modem.conf
  ${CMAKE_CURRENT_SOURCE_DIR}/config/mqtt.conf
  ${CMAKE_CURRENT_SOURCE_DIR}/config/tracker.conf
)

# Load the local broker endpoint/credentials overlay when present. The file
# is intentionally ignored by Git; use config/mqtt-credentials.conf.example
# as its template.
set(TRACKER_MQTT_CREDENTIALS_FILE
  ${CMAKE_CURRENT_SOURCE_DIR}/config/mqtt-credentials.conf
)
if(EXISTS ${TRACKER_MQTT_CREDENTIALS_FILE})
  list(APPEND TRACKER_CONF_FILES ${TRACKER_MQTT_CREDENTIALS_FILE})
endif()

set(EXTRA_CONF_FILE ${TRACKER_CONF_FILES} ${EXTRA_CONF_FILE})

find_package(Zephyr REQUIRED HINTS $ENV{ZEPHYR_BASE})
project(gps_mqtt_stateControl)

# The broker CA is a local deployment asset: provision it into the modem at
# startup, but never add it to Git. See credentials/README.md.
set(TRACKER_CERT_GEN_DIR ${CMAKE_CURRENT_BINARY_DIR}/certs)
zephyr_include_directories(${TRACKER_CERT_GEN_DIR})
if(EXISTS ${CMAKE_CURRENT_SOURCE_DIR}/credentials/ca-cert.pem)
  generate_inc_file_for_target(app credentials/ca-cert.pem
    ${TRACKER_CERT_GEN_DIR}/ca-cert.pem)
endif()

set(TRACKER_SHARED_SRC ${CMAKE_CURRENT_SOURCE_DIR}/../gps_mqtt_tracker/src)
zephyr_include_directories(${TRACKER_SHARED_SRC})

target_sources(app PRIVATE
  src/main.c
  src/tracker_status.c
  src/tracker_backlog.c
  src/tracker_gnss.c
  ${TRACKER_SHARED_SRC}/tracker_modem.c
  src/tracker_mqtt.c
  src/tracker_ui.c
)

if(CONFIG_TRACKER_CIRCUIT_DOJO_GNSS_SETUP)
  target_sources(app PRIVATE ${TRACKER_SHARED_SRC}/circuitdojo_gnss.c)
endif()
```

## Kconfig
```
# Reuse the tracker configuration definitions; this app selects its own defaults.
rsource "../gps_mqtt_tracker/Kconfig"
```

## sample.yaml
```
sample:
  description: Button-stepped GNSS to MQTT tracker
  name: GPS MQTT state control
common:
  sysbuild: true
  build_only: true
  integration_platforms:
    - sparkfun_thing_plus/nrf9160/ns
  platform_allow:
    - circuitdojo_feather/nrf9160/ns
    - sparkfun_thing_plus/nrf9160/ns
tests:
  app.gps_mqtt_state_control: {}
```

## prj.conf
```kconfig
# Subsystem defaults are loaded from config/ by CMakeLists.txt.
# Handle debounced button events directly, without a queue of late presses.
CONFIG_INPUT=y
CONFIG_INPUT_GPIO_KEYS=y
CONFIG_INPUT_MODE_SYNCHRONOUS=y
```

## boards/circuitdojo_feather_nrf9160_ns.conf
```kconfig
# Circuit Dojo nRF9160 Feather GNSS antenna and power-mode setup.
CONFIG_TRACKER_CIRCUIT_DOJO_GNSS_SETUP=y
CONFIG_MODEM_ANTENNA=y
CONFIG_MODEM_ANTENNA_AT_COEX0="AT\%XCOEX0=1,1,1565,1586"
```

## boards/sparkfun_thing_plus_nrf9160_ns.conf
```kconfig
# The SparkFun Thing Plus nRF9160 is the successor to the Circuit Dojo board.
CONFIG_TRACKER_CIRCUIT_DOJO_GNSS_SETUP=y
CONFIG_MODEM_ANTENNA=y
CONFIG_MODEM_ANTENNA_AT_COEX0="AT\%XCOEX0=1,1,1565,1586"
```

## src/main.c
```c
/*
 * Copyright (c) 2024 Nordic Semiconductor ASA
 * SPDX-License-Identifier: LicenseRef-Nordic-5-Clause
 */

#include <errno.h>
#include <zephyr/kernel.h>
#include <zephyr/device.h>
#include <zephyr/input/input.h>
#include <zephyr/sys/atomic.h>
#include <zephyr/logging/log.h>
#include <zephyr/logging/log_ctrl.h>
#include <modem/lte_lc.h>

#include "tracker_backlog.h"
#include "tracker_gnss.h"
#include "tracker_modem.h"
#include "tracker_mqtt.h"
#include "tracker_status.h"
#include "tracker_ui.h"

LOG_MODULE_REGISTER(gps_mqtt_state_control, LOG_LEVEL_INF);

enum tracker_state {
	TRACKER_STATE_WAIT_FOR_GNSS,
	TRACKER_STATE_CONNECT_LTE,
	TRACKER_STATE_CONNECT_MQTT,
	TRACKER_STATE_PUBLISH_BACKLOG,
	TRACKER_STATE_DISCONNECT_MQTT,
	TRACKER_STATE_ENABLE_PSM,
	TRACKER_STATE_DISABLE_PSM,
	TRACKER_STATE_WAIT_FOR_LOW_POWER,
	TRACKER_STATE_LOW_POWER,
	TRACKER_STATE_ENTER_LOW_POWER,
};

#define BUTTON_NODE DT_ALIAS(sw0)
#if !DT_NODE_HAS_STATUS(BUTTON_NODE, okay)
#error "GPS MQTT state control requires a sw0 button alias"
#endif
#define BUTTON_DEVICE DEVICE_DT_GET(DT_PARENT(BUTTON_NODE))

static K_SEM_DEFINE(step_requested, 0, 1);
static K_SEM_DEFINE(psm_sleep_entered, 0, 1);
static atomic_t modem_in_psm;
static atomic_t lte_online;
static atomic_t waiting_for_button;
static bool gnss_needs_stop;

static void psm_event(const struct lte_lc_evt *const evt)
{
	if (evt->type == LTE_LC_EVT_NW_REG_STATUS) {
		bool connected = evt->nw_reg_status == LTE_LC_NW_REG_REGISTERED_HOME ||
			evt->nw_reg_status == LTE_LC_NW_REG_REGISTERED_ROAMING;

		atomic_set(&lte_online, connected);
		if (connected) {
			LOG_INF("LTE connected");
		}
	} else if (evt->type == LTE_LC_EVT_PSM_UPDATE && atomic_get(&lte_online)) {
		LOG_INF("LTE connected - [PSM %s]",
			evt->psm_cfg.tau >= 0 && evt->psm_cfg.active_time >= 0 ?
			"enabled" : "disabled");
	} else if (evt->type == LTE_LC_EVT_MODEM_SLEEP_ENTER &&
	    evt->modem_sleep.type == LTE_LC_MODEM_SLEEP_PSM) {
		atomic_set(&modem_in_psm, 1);
		k_sem_give(&psm_sleep_entered);
	} else if (evt->type == LTE_LC_EVT_MODEM_SLEEP_EXIT &&
		   evt->modem_sleep.type == LTE_LC_MODEM_SLEEP_PSM) {
		atomic_clear(&modem_in_psm);
	}
}

static void button_event(struct input_event *evt, void *user_data)
{
	ARG_UNUSED(user_data);
	if (evt->sync && evt->type == INPUT_EV_KEY &&
	    evt->code == DT_PROP(BUTTON_NODE, zephyr_code) && evt->value == 1 &&
	    atomic_cas(&waiting_for_button, 1, 0)) {
		k_sem_give(&step_requested);
	}
}

INPUT_CALLBACK_DEFINE(BUTTON_DEVICE, button_event, NULL);

static const char *state_name(enum tracker_state state)
{
	switch (state) {
	case TRACKER_STATE_WAIT_FOR_GNSS: return "WAIT_FOR_GNSS";
	case TRACKER_STATE_CONNECT_LTE: return "CONNECT_LTE";
	case TRACKER_STATE_CONNECT_MQTT: return "CONNECT_MQTT";
	case TRACKER_STATE_PUBLISH_BACKLOG: return "PUBLISH_BACKLOG";
	case TRACKER_STATE_DISCONNECT_MQTT: return "DISCONNECT_MQTT";
	case TRACKER_STATE_ENABLE_PSM: return "ENABLE_PSM";
	case TRACKER_STATE_DISABLE_PSM: return "DISABLE_PSM";
	case TRACKER_STATE_WAIT_FOR_LOW_POWER: return "WAIT_FOR_LOW_POWER";
	case TRACKER_STATE_LOW_POWER: return "LOW_POWER";
	case TRACKER_STATE_ENTER_LOW_POWER: return "ENTER_LOW_POWER";
	}
	return "UNKNOWN";
}

static void location_fix_from_pvt(struct tracker_location_fix *fix,
	const struct nrf_modem_gnss_pvt_data_frame *pvt)
{
	fix->has_fix = true;
	fix->latitude = pvt->latitude;
	fix->longitude = pvt->longitude;
	fix->altitude = pvt->altitude;
	fix->accuracy = pvt->accuracy;
	fix->datetime = pvt->datetime;
}

static int tracker_init(void)
{
	int err;

	const char *quiet_modules[] = {"tracker_modem", "tracker_backlog"};

	for (size_t i = 0; i < ARRAY_SIZE(quiet_modules); i++) {
		int source_id = log_source_id_get(quiet_modules[i]);

		if (source_id < 0 || log_filter_set(NULL, Z_LOG_LOCAL_DOMAIN_ID,
			source_id, LOG_LEVEL_WRN) != LOG_LEVEL_WRN) {
			LOG_WRN("Could not reduce log verbosity for %s", quiet_modules[i]);
		}
	}
	tracker_status_set("SYSTEM INIT");
	err = tracker_ui_init();
	if (err != 0) {
		LOG_WRN("Tracker UI initialization failed: %d", err);
	}

	LOG_INF("===============================================");
	LOG_INF("GPS MQTT Button State Control Started");
	LOG_INF("Version: %d.%d.%d", CONFIG_TRACKER_VERSION_MAJOR,
		CONFIG_TRACKER_VERSION_MINOR, CONFIG_TRACKER_VERSION_PATCH);
	LOG_INF("===============================================");

	/* The modem must be initialized before MQTT, AT, LTE, or GNSS APIs. */
	err = tracker_modem_init();
	if (err != 0) {
		return err;
	}

	lte_lc_register_handler(psm_event);

	/* Keep PSM disabled until the operator executes ENABLE_PSM. */
	tracker_status_set("PSM REQUEST DISABLE");
	err = lte_lc_psm_req(false);
	if (err != 0) {
		LOG_ERR("Failed to disable the initial PSM request: %d", err);
		return err;
	}

	err = tracker_mqtt_init();
	if (err != 0) {
		return err;
	}

	return 0;
}

static enum tracker_state run_state(enum tracker_state state)
{
	struct nrf_modem_gnss_pvt_data_frame location;
	int err;

	switch (state) {
	case TRACKER_STATE_WAIT_FOR_GNSS: {
		int stop_err;

		tracker_ui_set_state(TRACKER_UI_GNSS);
		/* LTE may have woken from PSM during a long manual pause. */
		err = tracker_modem_return_to_gnss();
		if (err != 0) {
			state = TRACKER_STATE_ENTER_LOW_POWER;
			break;
		}
		gnss_needs_stop = true;
		err = tracker_gnss_start();
		if (err == 0) {
			k_sem_reset(&step_requested);
			atomic_set(&waiting_for_button, 1);
			err = tracker_gnss_collect_until_stop(&location, &step_requested);
			atomic_clear(&waiting_for_button);
			/* A session-ending press must never advance the next state too. */
			k_sem_reset(&step_requested);
		}
		if (err == 0 || err == -ENODATA || err == -ETIMEDOUT) {
			struct tracker_location_fix fix = {0};

			if (err == 0) {
				location_fix_from_pvt(&fix, &location);
			}
			/* Retain both valid fixes and no-fix reports until delivered. */
			tracker_backlog_add(&fix);
			err = 0;
		}
		/* Stop periodic acquisition while the operator pauses between states. */
		stop_err = nrf_modem_gnss_stop();
		if (stop_err != 0) {
			LOG_ERR("Failed to stop GNSS: %d", stop_err);
			if (err == 0) {
				err = stop_err;
			}
		}
		if (stop_err == 0) {
			gnss_needs_stop = false;
		}
		state = (err == 0) ? TRACKER_STATE_CONNECT_LTE :
			TRACKER_STATE_ENTER_LOW_POWER;
		break;
	}

	case TRACKER_STATE_CONNECT_LTE:
		tracker_ui_set_state(TRACKER_UI_LTE);
		LOG_INF("LTE connecting...");
		err = tracker_modem_prepare_upload(K_SECONDS(60));
		state = (err == 0) ? TRACKER_STATE_CONNECT_MQTT :
			TRACKER_STATE_ENTER_LOW_POWER;
		break;

	case TRACKER_STATE_CONNECT_MQTT:
		tracker_ui_set_state(TRACKER_UI_LTE_CONNECTED);
		err = tracker_mqtt_connect(K_SECONDS(15));
		state = (err == 0) ? TRACKER_STATE_PUBLISH_BACKLOG :
			TRACKER_STATE_DISCONNECT_MQTT;
		break;

	case TRACKER_STATE_PUBLISH_BACKLOG: {
		struct tracker_location_fix fix;
		size_t delivered = 0;

		while (tracker_backlog_peek_oldest(&fix)) {
			err = tracker_mqtt_publish_location(&fix, K_SECONDS(15));
			if (err != 0) {
				LOG_ERR("Location delivery failed: %d", err);
				break;
			}
			/*
			 * Only remove after tracker_mqtt_publish_location()
			 * confirms the broker's PUBACK (QoS 1) -- an
			 * unacknowledged publish must stay in the backlog.
			 */
			tracker_backlog_remove_oldest();
			delivered++;
		}
		if (delivered > 0) {
			LOG_DBG("Delivered %zu buffered location(s)", delivered);
		}
		state = TRACKER_STATE_DISCONNECT_MQTT;
		break;
	}

	case TRACKER_STATE_DISCONNECT_MQTT:
		err = tracker_mqtt_disconnect(K_SECONDS(10));
		if (err != 0) {
			LOG_WRN("MQTT disconnect did not complete cleanly; press again to retry: %d", err);
			break;
		}
		state = TRACKER_STATE_ENABLE_PSM;
		break;

	case TRACKER_STATE_ENABLE_PSM:
		tracker_ui_set_state(TRACKER_UI_LTE);
		/* Negotiate the new PSM request on a fresh LTE registration. */
		err = tracker_modem_return_to_gnss();
		k_sem_reset(&psm_sleep_entered);
		atomic_clear(&modem_in_psm);
		if (err == 0) {
			tracker_status_set("PSM REQUEST ENABLE");
			err = lte_lc_psm_req(true);
		}
		if (err == 0) {
			LOG_INF("LTE connecting...");
			err = tracker_modem_prepare_upload(K_SECONDS(60));
		}
		if (err == 0) {
			tracker_ui_set_state(TRACKER_UI_IDLE);
			tracker_status_set("MODEM PSM WAIT");
			err = k_sem_take(&psm_sleep_entered,
				K_SECONDS(CONFIG_TRACKER_PSM_ENTRY_TIMEOUT_SECONDS));
			if (atomic_get(&modem_in_psm)) {
				LOG_INF("PSM sleeping");
				err = 0;
			} else {
				tracker_status_set("PSM ENTRY UNCONFIRMED");
				LOG_WRN("PSM entry not confirmed; deactivating LTE as fallback");
				err = tracker_modem_return_to_gnss();
			}
		}
		if (err != 0) {
			LOG_ERR("PSM enable sequence failed: %d", err);
		}
		/* Request acceptance alone does not confirm that the modem entered PSM. */
		state = TRACKER_STATE_DISABLE_PSM;
		break;

	case TRACKER_STATE_DISABLE_PSM:
		tracker_ui_set_state(TRACKER_UI_IDLE);
		/* Leave PSM and release LTE radio control before the next GNSS step. */
		err = tracker_modem_return_to_gnss();
		if (err == 0) {
			atomic_clear(&modem_in_psm);
			tracker_status_set("PSM REQUEST DISABLE");
			err = lte_lc_psm_req(false);
		}
		if (err != 0) {
			LOG_ERR("Failed to disable PSM; press again to retry: %d", err);
			break;
		}
		atomic_clear(&lte_online);
		LOG_INF("LTE disconnected - [PSM disabled]");
		state = TRACKER_STATE_WAIT_FOR_LOW_POWER;
		break;

	case TRACKER_STATE_WAIT_FOR_LOW_POWER:
		state = TRACKER_STATE_LOW_POWER;
		break;

	case TRACKER_STATE_LOW_POWER:
		/* The main thread blocks on the button semaphore while in this mode. */
		state = TRACKER_STATE_WAIT_FOR_GNSS;
		break;

	case TRACKER_STATE_ENTER_LOW_POWER:
		tracker_status_set("LOW POWER PREPARE");
		tracker_ui_set_state(TRACKER_UI_IDLE);
		if (gnss_needs_stop) {
			err = nrf_modem_gnss_stop();
			if (err != 0) {
				LOG_ERR("Failed to stop GNSS; press again to retry: %d", err);
				break;
			}
			gnss_needs_stop = false;
		}
		err = tracker_modem_enter_low_power(
			K_SECONDS(CONFIG_TRACKER_PSM_ENTRY_TIMEOUT_SECONDS));
		if (err != 0) {
			LOG_ERR("Failed to enter a GNSS-safe low-power state: %d", err);
			break;
		}
		state = TRACKER_STATE_DISABLE_PSM;
		break;
	}
	return state;
}

int main(void)
{
	enum tracker_state state = TRACKER_STATE_WAIT_FOR_GNSS;
	int err;

	if (!device_is_ready(BUTTON_DEVICE)) {
		LOG_ERR("User button device is not ready");
		return 0;
	}
	err = tracker_init();
	if (err != 0) {
		tracker_status_set("SYSTEM ERROR");
		LOG_ERR("Tracker initialization failed: %d", err);
		return 0;
	}

	while (true) {
		tracker_ui_set_state(TRACKER_UI_IDLE);
		if (state == TRACKER_STATE_LOW_POWER) {
			LOG_INF("LOW_POWER: LTE off, GNSS stopped; press MODE to return to GPS");
		} else {
			LOG_INF("READY: %s; press the user button to execute", state_name(state));
		}
		atomic_set(&waiting_for_button, 1);
		err = k_sem_take(&step_requested, K_FOREVER);
		if (err != 0) {
			atomic_clear(&waiting_for_button);
			LOG_ERR("Button wait failed: %d", err);
			return 0;
		}
		LOG_INF("RUN: %s", state_name(state));
		state = run_state(state);
	}

	return 0;
}
```

## src/tracker_backlog.c
```c
/*
 * Copyright (c) 2024 Nordic Semiconductor ASA
 * SPDX-License-Identifier: LicenseRef-Nordic-5-Clause
 */

#include <string.h>
#include <zephyr/kernel.h>
#include <zephyr/logging/log.h>

#include "tracker_backlog.h"
#include "tracker_status.h"

LOG_MODULE_REGISTER(tracker_backlog, LOG_LEVEL_INF);

/*
 * Adaptive stride sampling: see docs/adr/0005-adaptive-stride-backlog-retention.md
 * for the full comparison against the two alternatives that were simulated
 * and rejected (a flat active/anchor decimation cascade, and logarithmic
 * stride buckets alone).
 *
 * A single global stride keeps only every Nth acquired fix. When the
 * fixed-capacity buffer fills, the stride doubles and the existing buffer
 * is refiltered to the new, coarser stride, freeing room to keep accepting
 * new fixes. This keeps the retained set evenly spaced across the entire
 * outage seen so far -- reach scales with elapsed time -- rather than
 * converging to a small, fixed recent-only window the way a decimation
 * cascade does.
 */
struct backlog_slot {
	struct tracker_location_fix fix;
	uint32_t seq;
};

static struct backlog_slot entries[CONFIG_TRACKER_BACKLOG_CAPACITY];
static size_t count;
static uint32_t next_seq = 1;
static uint32_t stride = 1;

void tracker_backlog_add(const struct tracker_location_fix *fix)
{
	uint32_t seq;

	if (count == 0) {
		/* Backlog was fully drained: a new outage episode starts back
		 * at full resolution rather than inheriting a stride grown
		 * during some earlier, unrelated outage.
		 */
		stride = 1;
	}

	seq = next_seq++;
	if (seq % stride != 0) {
		/* Doesn't qualify at the current stride; a later fix will
		 * eventually land on a multiple of it.
		 */
		return;
	}

	if (count == CONFIG_TRACKER_BACKLOG_CAPACITY) {
		size_t write = 0;

		stride *= 2;
		for (size_t i = 0; i < count; i++) {
			if (entries[i].seq % stride == 0) {
				entries[write++] = entries[i];
			}
		}
		count = write;

		if (seq % stride != 0) {
			tracker_status_set("BACKLOG STRIDE DOUBLED");
			LOG_INF("Backlog full; stride now %u, this fix waits for the next multiple",
				stride);
			return;
		}
	}

	entries[count].fix = *fix;
	entries[count].seq = seq;
	count++;

	tracker_status_set("BACKLOG FIX STORED");
	LOG_INF("Buffered fix for later delivery (%zu/%d, stride %u)",
		count, CONFIG_TRACKER_BACKLOG_CAPACITY, stride);
}

size_t tracker_backlog_count(void)
{
	return count;
}

bool tracker_backlog_peek_oldest(struct tracker_location_fix *out)
{
	if (count == 0) {
		return false;
	}

	*out = entries[0].fix;
	return true;
}

void tracker_backlog_remove_oldest(void)
{
	if (count == 0) {
		return;
	}

	memmove(&entries[0], &entries[1], (count - 1) * sizeof(entries[0]));
	count--;
}
```

## src/tracker_backlog.h
```c
/* SPDX-License-Identifier: LicenseRef-Nordic-5-Clause */

#ifndef TRACKER_BACKLOG_H_
#define TRACKER_BACKLOG_H_

#include <stdbool.h>
#include <stddef.h>
#include <nrf_modem_gnss.h>

/*
 * Only the fields tracker_mqtt_publish_location() needs to publish --
 * deliberately not the full struct nrf_modem_gnss_pvt_data_frame, which
 * carries a per-satellite array the backlog has no use for and cannot
 * afford to store CONFIG_TRACKER_BACKLOG_CAPACITY copies of.
 */
struct tracker_location_fix {
	bool has_fix;
	double latitude;
	double longitude;
	float altitude;
	float accuracy;
	struct nrf_modem_gnss_datetime datetime;
};

/*
 * Add a fix to the backlog, to be published once connectivity returns.
 * Not synchronized: call only from the tracker's single application thread.
 */
void tracker_backlog_add(const struct tracker_location_fix *fix);

/* Number of fixes currently held in the backlog. */
size_t tracker_backlog_count(void);

/*
 * Read the oldest backlog entry without removing it.
 * Returns false (and leaves *out untouched) if the backlog is empty.
 */
bool tracker_backlog_peek_oldest(struct tracker_location_fix *out);

/*
 * Remove the oldest backlog entry. Call only after
 * tracker_backlog_peek_oldest() and confirmation (e.g. a PUBACK) that it
 * was successfully delivered.
 */
void tracker_backlog_remove_oldest(void);

#endif /* TRACKER_BACKLOG_H_ */
```

## src/tracker_gnss.c
```c
/*
 * Copyright (c) 2024 Nordic Semiconductor ASA
 * SPDX-License-Identifier: LicenseRef-Nordic-5-Clause
 */

#include <errno.h>
#include <zephyr/kernel.h>
#include <zephyr/logging/log.h>
#include <nrf_modem_gnss.h>

#include "tracker_gnss.h"
#include "tracker_status.h"

LOG_MODULE_REGISTER(tracker_gnss, LOG_LEVEL_INF);

K_MSGQ_DEFINE(gnss_pvt_queue, sizeof(struct nrf_modem_gnss_pvt_data_frame), 2, 4);
#if defined(CONFIG_TRACKER_GNSS_DIAGNOSTICS)
K_MSGQ_DEFINE(gnss_nmea_queue, sizeof(struct nrf_modem_gnss_nmea_data_frame), 20, 4);

static void print_satellite_stats(const struct nrf_modem_gnss_pvt_data_frame *pvt)
{
	uint8_t tracked = 0;
	uint8_t in_fix = 0;
	uint8_t unhealthy = 0;

	for (int i = 0; i < NRF_MODEM_GNSS_MAX_SATELLITES; i++) {
		if (pvt->sv[i].sv == 0) {
			continue;
		}

		tracked++;
		if ((pvt->sv[i].flags & NRF_MODEM_GNSS_SV_FLAG_USED_IN_FIX) != 0) {
			in_fix++;
		}
		if ((pvt->sv[i].flags & NRF_MODEM_GNSS_SV_FLAG_UNHEALTHY) != 0) {
			unhealthy++;
		}
	}

	LOG_RAW("Tracking: %2d Using: %2d Unhealthy: %d\n", tracked, in_fix, unhealthy);
}

static void print_gnss_flags(const struct nrf_modem_gnss_pvt_data_frame *pvt)
{
	if ((pvt->flags & NRF_MODEM_GNSS_PVT_FLAG_DEADLINE_MISSED) != 0) {
		LOG_RAW("GNSS operation blocked by LTE\n");
	}
	if ((pvt->flags & NRF_MODEM_GNSS_PVT_FLAG_NOT_ENOUGH_WINDOW_TIME) != 0) {
		LOG_RAW("Insufficient GNSS time windows\n");
	}
	if ((pvt->flags & NRF_MODEM_GNSS_PVT_FLAG_SLEEP_BETWEEN_PVT) != 0) {
		LOG_RAW("Sleep period(s) between PVT notifications\n");
	}
	if ((pvt->flags & NRF_MODEM_GNSS_PVT_FLAG_SCHED_DOWNLOAD) != 0) {
		LOG_RAW("Scheduled navigation data download\n");
	}
}

static void print_fix_data(const struct nrf_modem_gnss_pvt_data_frame *pvt)
{
	LOG_RAW("Latitude:          %.06f\n", pvt->latitude);
	LOG_RAW("Longitude:         %.06f\n", pvt->longitude);
	LOG_RAW("Accuracy:          %.01f m\n", (double)pvt->accuracy);
	LOG_RAW("Altitude:          %.01f m\n", (double)pvt->altitude);
	LOG_RAW("Altitude accuracy: %.01f m\n", (double)pvt->altitude_accuracy);
	LOG_RAW("Speed:             %.01f m/s\n", (double)pvt->speed);
	LOG_RAW("Speed accuracy:    %.01f m/s\n", (double)pvt->speed_accuracy);
	LOG_RAW("V. speed:          %.01f m/s\n", (double)pvt->vertical_speed);
	LOG_RAW("V. speed accuracy: %.01f m/s\n", (double)pvt->vertical_speed_accuracy);
	LOG_RAW("Heading:           %.01f deg\n", (double)pvt->heading);
	LOG_RAW("Heading accuracy:  %.01f deg\n", (double)pvt->heading_accuracy);
	LOG_RAW("Date:              %04u-%02u-%02u\n", pvt->datetime.year,
		pvt->datetime.month, pvt->datetime.day);
	LOG_RAW("Time (UTC):        %02u:%02u:%02u.%03u\n", pvt->datetime.hour,
		pvt->datetime.minute, pvt->datetime.seconds, pvt->datetime.ms);
	LOG_RAW("PDOP:              %.01f\n", (double)pvt->pdop);
	LOG_RAW("HDOP:              %.01f\n", (double)pvt->hdop);
	LOG_RAW("VDOP:              %.01f\n", (double)pvt->vdop);
	LOG_RAW("TDOP:              %.01f\n", (double)pvt->tdop);
}

static void print_gnss_status(const struct nrf_modem_gnss_pvt_data_frame *pvt)
{
	static const char update_indicator[] = {'\\', '|', '/', '-'};
	static int64_t fix_timestamp;
	static uint8_t indicator_count;
	struct nrf_modem_gnss_nmea_data_frame nmea;

	if (fix_timestamp == 0) {
		fix_timestamp = k_uptime_get();
	}

	LOG_RAW("\033[1;1H");
	LOG_RAW("\033[2J");
	print_satellite_stats(pvt);
	print_gnss_flags(pvt);
	LOG_RAW("-----------------------------------\n");

	if ((pvt->flags & NRF_MODEM_GNSS_PVT_FLAG_FIX_VALID) != 0) {
		fix_timestamp = k_uptime_get();
		print_fix_data(pvt);
	} else {
		LOG_RAW("Seconds since last fix: %u\n",
			(uint32_t)((k_uptime_get() - fix_timestamp) / 1000));
		indicator_count++;
		LOG_RAW("Searching [%c]\n", update_indicator[indicator_count % 4]);
	}

	LOG_RAW("\nNMEA strings:\n\n");
	while (k_msgq_get(&gnss_nmea_queue, &nmea, K_NO_WAIT) == 0) {
		LOG_RAW("%s", nmea.nmea_str);
	}
}
#endif

static void gnss_event_handler(int event)
{
	struct nrf_modem_gnss_pvt_data_frame pvt;
	int err;

	switch (event) {
	case NRF_MODEM_GNSS_EVT_PVT:
		err = nrf_modem_gnss_read(&pvt, sizeof(pvt), NRF_MODEM_GNSS_DATA_PVT);
		if (err != 0) {
			LOG_ERR("Failed to read GNSS PVT data: %d", err);
			break;
		}

		err = k_msgq_put(&gnss_pvt_queue, &pvt, K_NO_WAIT);
		if (err != 0) {
			LOG_WRN("GNSS PVT queue full; dropping one status frame");
		}
		break;

	case NRF_MODEM_GNSS_EVT_FIX:
		tracker_status_set("GNSS FIX EVENT");
		LOG_INF("GNSS fix event detected");
		break;

#if defined(CONFIG_TRACKER_GNSS_DIAGNOSTICS)
	case NRF_MODEM_GNSS_EVT_NMEA: {
		struct nrf_modem_gnss_nmea_data_frame nmea;

		err = nrf_modem_gnss_read(&nmea, sizeof(nmea), NRF_MODEM_GNSS_DATA_NMEA);
		if (err != 0) {
			LOG_ERR("Failed to read GNSS NMEA data: %d", err);
			break;
		}

		if (k_msgq_put(&gnss_nmea_queue, &nmea, K_NO_WAIT) != 0) {
			LOG_DBG("GNSS NMEA queue full; dropping one sentence");
		}
		break;
	}
#endif

	case NRF_MODEM_GNSS_EVT_PERIODIC_WAKEUP:
		tracker_status_set("GNSS PERIODIC WAKEUP");
		LOG_INF("GNSS woke up for periodic fix cycle");
		break;
	case NRF_MODEM_GNSS_EVT_BLOCKED:
		tracker_status_set("GNSS BLOCKED");
		LOG_WRN("GNSS blocked by LTE activity");
		break;
	case NRF_MODEM_GNSS_EVT_UNBLOCKED:
		tracker_status_set("GNSS UNBLOCKED");
		LOG_INF("GNSS unblocked; radio time is available again");
		break;
	case NRF_MODEM_GNSS_EVT_SLEEP_AFTER_FIX:
		tracker_status_set("GNSS SLEEP AFTER FIX");
		LOG_INF("GNSS sleeping after a valid fix");
		break;
	case NRF_MODEM_GNSS_EVT_SLEEP_AFTER_TIMEOUT:
		tracker_status_set("GNSS SLEEP AFTER TIMEOUT");
		LOG_WRN("GNSS fix timeout reached without valid fix");
		break;
	case NRF_MODEM_GNSS_EVT_REF_ALT_EXPIRED:
		tracker_status_set("GNSS REFERENCE ALTITUDE EXPIRED");
		LOG_WRN("GNSS reference altitude expired");
		break;
	default:
		tracker_status_set("GNSS EVENT UNHANDLED");
		LOG_INF("Unhandled GNSS event: %d", event);
		break;
	}
}

int tracker_gnss_start(void)
{
	uint16_t nmea_mask = 0;
	uint8_t use_case = NRF_MODEM_GNSS_USE_CASE_MULTIPLE_HOT_START;
	int err;

	tracker_status_set("GNSS INIT");

#if defined(CONFIG_TRACKER_GNSS_DIAGNOSTICS)
	nmea_mask = NRF_MODEM_GNSS_NMEA_RMC_MASK |
		NRF_MODEM_GNSS_NMEA_GGA_MASK | NRF_MODEM_GNSS_NMEA_GLL_MASK |
		NRF_MODEM_GNSS_NMEA_GSA_MASK | NRF_MODEM_GNSS_NMEA_GSV_MASK;
#endif

#if defined(CONFIG_GNSS_HIGH_ACCURACY_TIMING_SOURCE)
	tracker_status_set("GNSS TIMING SOURCE CONFIG");
	err = nrf_modem_gnss_timing_source_set(NRF_MODEM_GNSS_TIMING_SOURCE_TCXO);
	if (err != 0) {
		LOG_ERR("Failed to set TCXO timing source: %d", err);
		return err;
	}
#endif

#if defined(CONFIG_GNSS_LOW_ACCURACY)
	use_case |= NRF_MODEM_GNSS_USE_CASE_LOW_ACCURACY;
#endif

	tracker_status_set("GNSS USE CASE CONFIG");
	err = nrf_modem_gnss_use_case_set(use_case);
	if (err != 0) {
		LOG_ERR("Failed to set GNSS use case: %d", err);
		return err;
	}

	tracker_status_set("GNSS EVENT HANDLER CONFIG");
	err = nrf_modem_gnss_event_handler_set(gnss_event_handler);
	if (err != 0) {
		LOG_ERR("Failed to set GNSS event handler: %d", err);
		return err;
	}

	tracker_status_set("GNSS NMEA CONFIG");
	err = nrf_modem_gnss_nmea_mask_set(nmea_mask);
	if (err != 0) {
		LOG_ERR("Failed to configure GNSS NMEA output: %d", err);
		return err;
	}

	tracker_status_set("GNSS FIX INTERVAL CONFIG");
	err = nrf_modem_gnss_fix_interval_set(1);
	if (err != 0) {
		LOG_ERR("Failed to set GNSS fix interval: %d", err);
		return err;
	}

	tracker_status_set("GNSS FIX TIMEOUT CONFIG");
	err = nrf_modem_gnss_fix_retry_set(CONFIG_TRACKER_PERIODIC_TIMEOUT);
	if (err != 0) {
		LOG_ERR("Failed to set GNSS fix retry timeout: %d", err);
		return err;
	}

	tracker_status_set("GNSS START");
	err = nrf_modem_gnss_start();
	if (err != 0) {
		LOG_ERR("Failed to start GNSS module: %d", err);
		return err;
	}

	tracker_status_set("GNSS PRIORITY MODE CONFIG");
	err = nrf_modem_gnss_prio_mode_enable();
	if (err != 0) {
		LOG_ERR("Failed to enable GNSS priority mode: %d", err);
		return err;
	}

	LOG_INF("GNSS session started (continuous, timeout: %ds)",
		CONFIG_TRACKER_PERIODIC_TIMEOUT);
	return 0;
}

int tracker_gnss_collect_until_stop(struct nrf_modem_gnss_pvt_data_frame *pvt,
	struct k_sem *stop_requested)
{
	struct nrf_modem_gnss_pvt_data_frame frame;
	bool have_fix = false;
	k_timepoint_t deadline = sys_timepoint_calc(CONFIG_TRACKER_PERIODIC_TIMEOUT == 0 ?
		K_FOREVER : K_SECONDS(CONFIG_TRACKER_PERIODIC_TIMEOUT));

	if (pvt == NULL || stop_requested == NULL) {
		return -EINVAL;
	}
	k_msgq_purge(&gnss_pvt_queue);
	tracker_status_set("GNSS FINDING");
	LOG_INF("Waiting for GNSS fix... Press MODE to finish the session");

	while (true) {
		bool timed_out = sys_timepoint_expired(deadline);

		if (k_sem_take(stop_requested, K_NO_WAIT) == 0 || timed_out) {
			if (have_fix) {
				tracker_status_set("GNSS FIX ACQUIRED");
				LOG_INF("GNSS session finished; latest valid fix selected");
				return 0;
			}
			tracker_status_set(timed_out ? "GNSS FIX TIMEOUT" : "GNSS SESSION STOPPED");
			LOG_WRN("GNSS session finished without a valid fix; a null location will be sent");
			return timed_out ? -ETIMEDOUT : -ENODATA;
		}
		/* Bound button response time even when no PVT events arrive. */
		int err = k_msgq_get(&gnss_pvt_queue, &frame, K_MSEC(100));

		if (err == -EAGAIN || err == -ENOMSG) {
			continue;
		}
		if (err != 0) {
			LOG_ERR("GNSS session queue read failed: %d", err);
			return err;
		}
#if defined(CONFIG_TRACKER_GNSS_DIAGNOSTICS)
		print_gnss_status(&frame);
#endif
		if ((frame.flags & NRF_MODEM_GNSS_PVT_FLAG_FIX_VALID) != 0) {
			*pvt = frame;
			have_fix = true;
		}
	}
}
```

## src/tracker_gnss.h
```c
/* SPDX-License-Identifier: LicenseRef-Nordic-5-Clause */
#ifndef STATE_CONTROL_GNSS_H_
#define STATE_CONTROL_GNSS_H_
#include <zephyr/kernel.h>
#include <nrf_modem_gnss.h>
int tracker_gnss_start(void);
int tracker_gnss_collect_until_stop(struct nrf_modem_gnss_pvt_data_frame *pvt,
	struct k_sem *stop_requested);
#endif
```

## src/tracker_mqtt.c
```c
/*
 * Copyright (c) 2024 Nordic Semiconductor ASA
 * SPDX-License-Identifier: LicenseRef-Nordic-5-Clause
 */

#include <errno.h>
#include <stdio.h>
#include <string.h>
#include <zephyr/kernel.h>
#include <zephyr/logging/log.h>
#include <zephyr/sys/atomic.h>
#include <nrf_modem_at.h>
#include <modem/modem_key_mgmt.h>
#include <net/mqtt_helper.h>

#include "tracker_mqtt.h"
#include "tracker_status.h"

LOG_MODULE_REGISTER(tracker_mqtt, LOG_LEVEL_INF);

#define IMEI_LEN 15
#define CGSN_RESPONSE_LENGTH (IMEI_LEN + 6 + 1)
#define CLIENT_ID_LEN (sizeof("nrf-") + IMEI_LEN)
#define MQTT_PAYLOAD_MAX_LEN 256

static K_SEM_DEFINE(mqtt_conn_sem, 0, 1);
static K_SEM_DEFINE(mqtt_puback_sem, 0, 1);
static K_SEM_DEFINE(mqtt_disconnected_sem, 0, 1);

static char client_id_buf[CLIENT_ID_LEN];

/*
 * connack_result and puback_result are written by the MQTT helper's RX
 * callbacks (on_mqtt_connack/on_mqtt_puback, invoked from the helper's own
 * mqtt_helper_thread) and read by the tracker thread after a matching
 * k_sem_take. This is safe without atomics only because each value is
 * fully written before its paired k_sem_give, and only read after the
 * corresponding k_sem_take returns: the semaphore operations provide the
 * happens-before ordering. Keep that write-then-give / take-then-read
 * pairing intact if this code is ever restructured.
 *
 * pending_publish_id runs the other direction: it's written by the tracker
 * thread (tracker_mqtt_publish_location(), before calling
 * mqtt_helper_publish()) and read by on_mqtt_puback() on mqtt_helper_thread
 * when a PUBACK arrives. There is no semaphore between that write and read;
 * the ordering instead relies on mqtt_helper_publish() calling mqtt_publish()
 * synchronously in the tracker thread (so the write is complete before the
 * PUBLISH packet is even sent) plus network causality (the broker cannot
 * PUBACK a message ID it hasn't received yet). Don't make mqtt_helper_publish()
 * asynchronous relative to this write without adding real synchronization.
 */
static enum mqtt_conn_return_code connack_result;
static int puback_result;
static uint16_t pending_publish_id;
static atomic_t connect_attempted;

static const unsigned char broker_ca_certificate[] = {
#if __has_include("ca-cert.pem")
#include "ca-cert.pem"
#else
""
#endif
};

static int broker_ca_provision(void)
{
	bool exists;
	int err;
	int comparison;

	if (sizeof(broker_ca_certificate) <= 1) {
		LOG_ERR("TLS is enabled but credentials/ca-cert.pem is missing");
		return -ENOENT;
	}

	tracker_status_set("MQTT TLS CA CHECK");
	err = modem_key_mgmt_exists(CONFIG_MQTT_HELPER_SEC_TAG,
		MODEM_KEY_MGMT_CRED_TYPE_CA_CHAIN, &exists);
	if (err != 0) {
		LOG_ERR("Failed to check MQTT broker CA: %d", err);
		return err;
	}

	if (exists) {
		comparison = modem_key_mgmt_cmp(CONFIG_MQTT_HELPER_SEC_TAG,
			MODEM_KEY_MGMT_CRED_TYPE_CA_CHAIN, broker_ca_certificate,
			sizeof(broker_ca_certificate) - 1);
		if (comparison == 0) {
			tracker_status_set("MQTT TLS CA READY");
			LOG_DBG("MQTT broker CA is already provisioned");
			return 0;
		}

		tracker_status_set("MQTT TLS CA DELETE");
		err = modem_key_mgmt_delete(CONFIG_MQTT_HELPER_SEC_TAG,
			MODEM_KEY_MGMT_CRED_TYPE_CA_CHAIN);
		if (err != 0) {
			LOG_ERR("Failed to replace MQTT broker CA: %d", err);
			return err;
		}
	}

	tracker_status_set("MQTT TLS CA WRITE");
	err = modem_key_mgmt_write(CONFIG_MQTT_HELPER_SEC_TAG,
		MODEM_KEY_MGMT_CRED_TYPE_CA_CHAIN, broker_ca_certificate,
		sizeof(broker_ca_certificate) - 1);
	if (err != 0) {
		LOG_ERR("Failed to provision MQTT broker CA: %d", err);
		return err;
	}

	tracker_status_set("MQTT TLS CA READY");
	LOG_DBG("MQTT broker CA provisioned in sec tag %d", CONFIG_MQTT_HELPER_SEC_TAG);
	return 0;
}

static int client_id_get(char *buffer, size_t buffer_len)
{
	char imei_buf[CGSN_RESPONSE_LENGTH];
	int len;
	int err;

	if (strlen(CONFIG_MQTT_CLIENT_ID) > 0) {
		tracker_status_set("MQTT CLIENT ID CONFIG");
		len = snprintf(buffer, buffer_len, "%s", CONFIG_MQTT_CLIENT_ID);
		if (len < 0 || (size_t)len >= buffer_len) {
			LOG_ERR("Configured MQTT client ID is too long");
			return -EMSGSIZE;
		}
		return 0;
	}

	tracker_status_set("MODEM IMEI READ");
	err = nrf_modem_at_cmd(imei_buf, sizeof(imei_buf), "AT+CGSN");
	if (err != 0) {
		LOG_ERR("Failed to obtain IMEI with AT+CGSN: %d", err);
		return err;
	}

	imei_buf[IMEI_LEN] = '\0';
	len = snprintf(buffer, buffer_len, "nrf-%.*s", IMEI_LEN, imei_buf);
	if (len < 0 || (size_t)len >= buffer_len) {
		LOG_ERR("Generated MQTT client ID is too long");
		return -EMSGSIZE;
	}

	LOG_DBG("Generated MQTT client ID: %s", buffer);
	return 0;
}

static void on_mqtt_connack(enum mqtt_conn_return_code return_code, bool session_present)
{
	ARG_UNUSED(session_present);

	connack_result = return_code;
	if (return_code == MQTT_CONNECTION_ACCEPTED) {
		tracker_status_set("MQTT CONNECTED");
		LOG_INF("MQTT connected");
	} else {
		tracker_status_set("MQTT CONNECTION REJECTED");
		LOG_ERR("MQTT broker rejected connection: %d", return_code);
	}

	k_sem_give(&mqtt_conn_sem);
}

static void on_mqtt_disconnect(int result)
{
	atomic_clear(&connect_attempted);
	tracker_status_set("MQTT DISCONNECTED");
	if (result == 0) {
		LOG_INF("MQTT disconnected");
	} else {
		LOG_WRN("MQTT client disconnected with result: %d", result);
	}
	k_sem_give(&mqtt_disconnected_sem);
}

static void on_mqtt_puback(uint16_t message_id, int result)
{
	if (message_id != pending_publish_id) {
		LOG_WRN("Unexpected MQTT PUBACK ID: %u", message_id);
		return;
	}

	puback_result = result;
	if (result != 0) {
		tracker_status_set("MQTT PUBLISH ACK ERROR");
		LOG_ERR("MQTT PUBACK failed for ID %u: %d", message_id, result);
	} else {
		tracker_status_set("MQTT PUBLISH ACKNOWLEDGED");
		LOG_DBG("MQTT broker acknowledged location payload (ID: %u)", message_id);
	}
	k_sem_give(&mqtt_puback_sem);
}

int tracker_mqtt_init(void)
{
	struct mqtt_helper_cfg mqtt_cfg = {
		.cb = {
			.on_connack = on_mqtt_connack,
			.on_disconnect = on_mqtt_disconnect,
			.on_puback = on_mqtt_puback,
		},
	};
	int err;

	tracker_status_set("MQTT INIT");

	if (strlen(CONFIG_MQTT_BROKER_PASSWORD) > 0 &&
	    strlen(CONFIG_MQTT_BROKER_USERNAME) == 0) {
		LOG_ERR("MQTT password is configured without a username");
		return -EINVAL;
	}

	if (IS_ENABLED(CONFIG_MQTT_LIB_TLS)) {
		err = broker_ca_provision();
		if (err != 0) {
			return err;
		}
	}

	tracker_status_set("MQTT HELPER CONFIG");
	err = mqtt_helper_init(&mqtt_cfg);
	if (err != 0) {
		LOG_ERR("Failed to initialize MQTT helper: %d", err);
		return err;
	}

	err = client_id_get(client_id_buf, sizeof(client_id_buf));
	if (err == 0) {
		tracker_status_set("MQTT READY");
	}

	return err;
}

int tracker_mqtt_connect(k_timeout_t timeout)
{
	struct mqtt_helper_conn_params conn_params = {
		.hostname.ptr = CONFIG_MQTT_BROKER_HOSTNAME,
		.hostname.size = strlen(CONFIG_MQTT_BROKER_HOSTNAME),
		.device_id.ptr = client_id_buf,
		.device_id.size = strlen(client_id_buf),
		.user_name.ptr = CONFIG_MQTT_BROKER_USERNAME,
		.user_name.size = strlen(CONFIG_MQTT_BROKER_USERNAME),
		.password.ptr = CONFIG_MQTT_BROKER_PASSWORD,
		.password.size = strlen(CONFIG_MQTT_BROKER_PASSWORD),
	};
	int err;

	tracker_status_set("MQTT CONNECTION");
	LOG_INF("MQTT connecting...");
	if (conn_params.user_name.size > 0) {
		LOG_DBG("MQTT broker authentication enabled");
	}
	k_sem_reset(&mqtt_conn_sem);
	connack_result = MQTT_UNACCEPTABLE_PROTOCOL_VERSION;
	err = mqtt_helper_connect(&conn_params);
	if (err != 0) {
		LOG_ERR("MQTT connection attempt failed: %d", err);
		return err;
	}
	atomic_set(&connect_attempted, 1);

	err = k_sem_take(&mqtt_conn_sem, timeout);
	if (err != 0) {
		tracker_status_set("MQTT CONNECTION TIMEOUT");
		LOG_ERR("MQTT CONNACK timed out");
		return -ETIMEDOUT;
	}
	if (connack_result != MQTT_CONNECTION_ACCEPTED) {
		return -ECONNREFUSED;
	}

	return 0;
}

int tracker_mqtt_publish_location(
	const struct tracker_location_fix *fix, k_timeout_t timeout)
{
	char payload[MQTT_PAYLOAD_MAX_LEN];
	struct mqtt_publish_param param = {0};
	int payload_len;
	int err;

	if (fix == NULL) {
		return -EINVAL;
	}

	if (fix->has_fix) {
		payload_len = snprintf(payload, sizeof(payload),
			"{\"lat\":%.06f,\"lon\":%.06f,\"alt\":%.01f,\"acc\":%.01f,"
			"\"time\":\"%04u-%02u-%02uT%02u:%02u:%02uZ\"}",
			fix->latitude, fix->longitude, (double)fix->altitude,
			(double)fix->accuracy, fix->datetime.year, fix->datetime.month,
			fix->datetime.day, fix->datetime.hour, fix->datetime.minute,
			fix->datetime.seconds);
	} else {
		payload_len = snprintf(payload, sizeof(payload),
			"{\"lat\":null,\"lon\":null,\"alt\":null,\"acc\":null,\"time\":null}");
	}
	if (payload_len < 0 || (size_t)payload_len >= sizeof(payload)) {
		LOG_ERR("Location payload formatting failed or was truncated");
		return -EMSGSIZE;
	}

	param.message.payload.data = (uint8_t *)payload;
	param.message.payload.len = payload_len;
	param.message.topic.qos = (enum mqtt_qos)CONFIG_MQTT_PUB_QOS;
	param.message.topic.topic.utf8 = CONFIG_MQTT_PUB_TOPIC;
	param.message.topic.topic.size = strlen(CONFIG_MQTT_PUB_TOPIC);
	pending_publish_id = mqtt_helper_msg_id_get();
	param.message_id = pending_publish_id;

	tracker_status_set("MQTT PUBLISH");
	LOG_INF("MQTT sending...");
	if (CONFIG_MQTT_PUB_QOS == MQTT_QOS_1_AT_LEAST_ONCE) {
		k_sem_reset(&mqtt_puback_sem);
		puback_result = 0;
	}
	err = mqtt_helper_publish(&param);
	if (err != 0) {
		LOG_ERR("Failed to publish MQTT message: %d", err);
		return err;
	}

	if (CONFIG_MQTT_PUB_QOS == MQTT_QOS_0_AT_MOST_ONCE) {
		tracker_status_set("MQTT PUBLISH COMPLETE");
		LOG_INF("MQTT sent (QoS 0; no broker acknowledgement)\n%.*s", payload_len, payload);
		return 0;
	}

	err = k_sem_take(&mqtt_puback_sem, timeout);
	if (err != 0) {
		tracker_status_set("MQTT PUBLISH ACK TIMEOUT");
		LOG_ERR("MQTT PUBACK timed out");
		return -ETIMEDOUT;
	}

	if (puback_result == 0) {
		LOG_INF("MQTT sent\n%.*s", payload_len, payload);
	}
	return puback_result;
}

int tracker_mqtt_disconnect(k_timeout_t timeout)
{
	int err;

	if (!atomic_get(&connect_attempted)) {
		tracker_status_set("MQTT DISCONNECTED");
		return 0;
	}

	tracker_status_set("MQTT DISCONNECT");
	k_sem_reset(&mqtt_disconnected_sem);
	err = mqtt_helper_disconnect();
	if (err != 0) {
		LOG_ERR("Failed to disconnect MQTT: %d", err);
		return err;
	}

	err = k_sem_take(&mqtt_disconnected_sem, timeout);
	if (err != 0) {
		LOG_WRN("MQTT disconnect timed out");
		return -ETIMEDOUT;
	}

	return 0;
}
```

## src/tracker_status.c
```c
/* SPDX-License-Identifier: LicenseRef-Nordic-5-Clause */

#include <string.h>
#include <zephyr/logging/log.h>
#include "tracker_status.h"

LOG_MODULE_REGISTER(tracker_status, LOG_LEVEL_INF);

void tracker_status_set(const char *label)
{
	/* Preserve GNSS diagnostics while avoiding duplicate subsystem status lines. */
	if (strncmp(label, "GNSS ", 5) == 0) {
		LOG_INF("STATUS: %s", label);
	}
}
```

## src/tracker_ui.c
```c
/*
 * Copyright (c) 2024 Nordic Semiconductor ASA
 * SPDX-License-Identifier: LicenseRef-Nordic-5-Clause
 */

#include <errno.h>
#include <zephyr/kernel.h>
#include <zephyr/logging/log.h>
#include <zephyr/sys/atomic.h>
#if defined(CONFIG_STARTUP_LED)
#include <zephyr/drivers/gpio.h>
#endif
#if IS_ENABLED(CONFIG_ENABLE_LEDS)
#include <dk_buttons_and_leds.h>
#endif

#include "tracker_ui.h"

LOG_MODULE_REGISTER(tracker_ui, LOG_LEVEL_INF);

#if defined(CONFIG_STARTUP_LED)
#define STARTUP_LED_NODE DT_ALIAS(led0)

#if !DT_NODE_HAS_STATUS(STARTUP_LED_NODE, okay)
#error "CONFIG_STARTUP_LED requires a ready led0 devicetree alias"
#endif

static const struct gpio_dt_spec startup_led = GPIO_DT_SPEC_GET(STARTUP_LED_NODE, gpios);
static struct k_work_delayable working_led_work;
static bool working_led_state;
static bool working_led_ready;
static atomic_t requested_state = ATOMIC_INIT(TRACKER_UI_IDLE);
static enum tracker_ui_state displayed_state = TRACKER_UI_IDLE;
static unsigned int completed_blinks;

static void working_led_blink_handler(struct k_work *work)
{
	int err;
	int delay_ms = CONFIG_WORKING_LED_BLINK_INTERVAL_MS;
	enum tracker_ui_state state = atomic_get(&requested_state);
	unsigned int blink_count = 0;

	ARG_UNUSED(work);
	switch (state) {
	case TRACKER_UI_GNSS:
		blink_count = 2;
		break;
	case TRACKER_UI_LTE:
		blink_count = 3;
		break;
	case TRACKER_UI_LTE_CONNECTED:
		blink_count = 4;
		break;
	case TRACKER_UI_IDLE:
		/* One pulse keeps the manual wait visibly alive. */
		blink_count = 1;
		break;
	}

	if (state != displayed_state) {
		displayed_state = state;
		completed_blinks = 0;
		/* Start each new state after a full dark gap. */
		working_led_state = false;
		delay_ms = CONFIG_WORKING_LED_GROUP_PAUSE_MS;
	} else if (blink_count == 0) {
		working_led_state = false;
		delay_ms = CONFIG_WORKING_LED_GROUP_PAUSE_MS;
	} else {
		working_led_state = !working_led_state;
		if (!working_led_state && ++completed_blinks == blink_count) {
			completed_blinks = 0;
			delay_ms = CONFIG_WORKING_LED_GROUP_PAUSE_MS;
		}
	}
	err = gpio_pin_set_dt(&startup_led, working_led_state);
	if (err != 0) {
		LOG_ERR("Failed to update working LED: %d", err);
		return;
	}

	err = k_work_reschedule(&working_led_work,
		K_MSEC(delay_ms));
	if (err < 0) {
		LOG_ERR("Failed to reschedule working LED: %d", err);
	}
}

static int working_led_start(void)
{
	int err;

	if (!gpio_is_ready_dt(&startup_led)) {
		return -ENODEV;
	}

	err = gpio_pin_configure_dt(&startup_led, GPIO_OUTPUT_INACTIVE);
	if (err != 0) {
		return err;
	}

	working_led_state = false;
	k_work_init_delayable(&working_led_work, working_led_blink_handler);
	err = k_work_schedule(&working_led_work,
		K_MSEC(CONFIG_WORKING_LED_BLINK_INTERVAL_MS));
	working_led_ready = err >= 0;
	return err < 0 ? err : 0;
}
#endif

int tracker_ui_init(void)
{
#if defined(CONFIG_STARTUP_LED) || defined(CONFIG_ENABLE_LEDS)
	int err;
#endif

#if defined(CONFIG_STARTUP_LED)
	err = working_led_start();
	if (err != 0) {
		return err;
	}
	LOG_INF("Status LED pulse interval: %d ms",
		CONFIG_WORKING_LED_BLINK_INTERVAL_MS);
#endif

#if IS_ENABLED(CONFIG_ENABLE_LEDS)
	err = dk_leds_init();
	if (err != 0) {
		LOG_ERR("Failed to initialize status LEDs: %d", err);
		return err;
	}
#endif

	return 0;
}

void tracker_ui_set_state(enum tracker_ui_state state)
{
#if defined(CONFIG_STARTUP_LED)
	if ((enum tracker_ui_state)atomic_set(&requested_state, state) != state && working_led_ready) {
		int err = k_work_reschedule(&working_led_work, K_NO_WAIT);

		if (err < 0) {
			LOG_ERR("Failed to schedule status LED: %d", err);
		}
	}
#endif
#if IS_ENABLED(CONFIG_ENABLE_LEDS)
	(void)dk_set_leds(0);
	switch (state) {
	case TRACKER_UI_GNSS:
		(void)dk_set_led_on(DK_LED2);
		break;
	case TRACKER_UI_LTE:
		(void)dk_set_led_on(DK_LED1);
		break;
	case TRACKER_UI_LTE_CONNECTED:
		(void)dk_set_led_on(DK_LED4);
		break;
	case TRACKER_UI_IDLE:
		break;
	}
#else
	ARG_UNUSED(state);
#endif
}
```
