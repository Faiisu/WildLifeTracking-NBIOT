## CMakeLists.txt
```
#
# Copyright (c) 2024 Nordic Semiconductor ASA
# SPDX-License-Identifier: LicenseRef-Nordic-5-Clause
#

cmake_minimum_required(VERSION 3.20.0)

# Keep the default application configuration grouped by subsystem. prj.conf
# remains the standard Zephyr entry point, while these fragments are merged in
# the listed order before any command-line overlay configuration.
set(TRACKER_CONF_FILES
  ${CMAKE_CURRENT_SOURCE_DIR}/config/system.conf
  ${CMAKE_CURRENT_SOURCE_DIR}/config/logging.conf
  ${CMAKE_CURRENT_SOURCE_DIR}/config/hardware.conf
  ${CMAKE_CURRENT_SOURCE_DIR}/config/networking.conf
  ${CMAKE_CURRENT_SOURCE_DIR}/config/modem.conf
  ${CMAKE_CURRENT_SOURCE_DIR}/config/mqtt.conf
  ${CMAKE_CURRENT_SOURCE_DIR}/config/tracker.conf
)

# Load the local broker endpoint/credentials overlay when present. The file
# is intentionally ignored by Git; use config/mqtt-credentials.conf.example
# as its template.
set(TRACKER_MQTT_CREDENTIALS_FILE
  ${CMAKE_CURRENT_SOURCE_DIR}/config/mqtt-credentials.conf
)
if(EXISTS ${TRACKER_MQTT_CREDENTIALS_FILE})
  list(APPEND TRACKER_CONF_FILES ${TRACKER_MQTT_CREDENTIALS_FILE})
endif()

set(EXTRA_CONF_FILE ${TRACKER_CONF_FILES} ${EXTRA_CONF_FILE})

find_package(Zephyr REQUIRED HINTS $ENV{ZEPHYR_BASE})
project(gps_mqtt_tracker)

# The broker CA is a local deployment asset: provision it into the modem at
# startup, but never add it to Git. See credentials/README.md.
set(TRACKER_CERT_GEN_DIR ${CMAKE_CURRENT_BINARY_DIR}/certs)
zephyr_include_directories(${TRACKER_CERT_GEN_DIR})
if(EXISTS ${CMAKE_CURRENT_SOURCE_DIR}/credentials/ca-cert.pem)
  generate_inc_file_for_target(app credentials/ca-cert.pem
    ${TRACKER_CERT_GEN_DIR}/ca-cert.pem)
endif()

target_sources(app PRIVATE
  src/main.c
  src/tracker_status.c
  src/tracker_backlog.c
  src/tracker_gnss.c
  src/tracker_modem.c
  src/tracker_mqtt.c
  src/tracker_ui.c
)

if(CONFIG_TRACKER_CIRCUIT_DOJO_GNSS_SETUP)
  target_sources(app PRIVATE src/circuitdojo_gnss.c)
endif()
```

## Kconfig
```
#
# Copyright (c) 2024 Nordic Semiconductor ASA
# SPDX-License-Identifier: LicenseRef-Nordic-5-Clause
#

menu "GPS MQTT Asset Tracker Configuration"

config TRACKER_VERSION_MAJOR
	int "Major version number"
	default 1

config TRACKER_VERSION_MINOR
	int "Minor version number"
	default 0

config TRACKER_VERSION_PATCH
	int "Patch version number"
	default 0

config MQTT_BROKER_HOSTNAME
	string "MQTT Broker Hostname"
	default "test.mosquitto.org"
	help
	  Hostname or IP address of the target MQTT broker.

config MQTT_BROKER_PORT
	int "MQTT Broker Port"
	default 1883
	help
	  Port number of the target MQTT broker (1883 for unencrypted, 8883 for TLS).

config MQTT_PUB_TOPIC
	string "MQTT Publish Topic"
	default "nrf91/tracker/gps"
	help
	  MQTT Topic to publish GPS location fixes.

config MQTT_PUB_QOS
	int "MQTT publish QoS"
	range 0 1
	default 1
	help
	  MQTT delivery level for location publishes: 0 sends at most once and
	  does not wait for a broker acknowledgement; 1 sends at least once and
	  waits for PUBACK. QoS 2 is not supported by this tracker flow.

config MQTT_CLIENT_ID
	string "MQTT Client ID (Leave blank to use IMEI)"
	default ""
	help
	  Custom Client ID for MQTT connection. If left empty, nrf-<IMEI> will be generated automatically.

config MQTT_BROKER_USERNAME
	string "MQTT broker username"
	default ""
	help
	  Optional username for MQTT broker authentication. Keep production
	  credentials in the ignored config/mqtt-credentials.conf overlay instead
	  of a tracked configuration file.

config MQTT_BROKER_PASSWORD
	string "MQTT broker password"
	default ""
	help
	  Optional password for MQTT broker authentication. A non-empty password
	  requires CONFIG_MQTT_BROKER_USERNAME to also be non-empty. Keep production
	  credentials in the ignored config/mqtt-credentials.conf overlay.

config TRACKER_PERIODIC_INTERVAL
	int "Periodic GPS Fix Interval (seconds)"
	range 10 65535
	default 120
	help
	  Time interval in seconds between periodic GNSS location fixes.

config TRACKER_PERIODIC_TIMEOUT
	int "Periodic GPS Fix Timeout (seconds)"
	range 0 65535
	default 300
	help
	  Time limit in seconds to search for a GNSS fix before sleeping. Set 0 for infinite search.

config TRACKER_PSM_PERIODIC_TAU_SECONDS
	int "Requested PSM periodic TAU (seconds)"
	range 0 1152000
	default 28800
	help
	  Requested interval between periodic tracking area updates while the
	  modem is in Power Saving Mode. The network may grant a different value.

config TRACKER_PSM_ACTIVE_TIME_SECONDS
	int "Requested PSM active time (seconds)"
	range 0 11160
	default 0
	help
	  Requested paging time after LTE activity before entering PSM. Use zero
	  for an uplink-only tracker that does not need to receive downlink data.

config TRACKER_PSM_ENTRY_TIMEOUT_SECONDS
	int "PSM entry timeout (seconds)"
	range 1 600
	default 60
	help
	  Maximum time to wait after an upload for confirmation that the modem
	  entered PSM. If it expires, LTE is deactivated so GNSS can continue.

config TRACKER_BACKLOG_CAPACITY
	int "Un-sent location backlog capacity"
	range 1 500
	default 40
	help
	  Maximum number of GPS fixes retained in RAM while LTE registration,
	  MQTT connect, or publish is failing. Each entry is a compact
	  struct tracker_location_fix (lat/lon/alt/acc/timestamp only, not
	  the full GNSS PVT frame), stored in a static array -- not the heap.
	  Lost on reboot or power loss; there is no flash persistence. Once
	  full, adaptive stride sampling keeps the retained set evenly spread
	  across the whole outage instead of just its most recent portion --
	  see docs/adr/0005-adaptive-stride-backlog-retention.md and
	  tracker_backlog.c.

config TRACKER_GNSS_DIAGNOSTICS
	bool "Enable detailed GNSS and NMEA diagnostics"
	default n
	help
	  Print satellite statistics, PVT search status, and NMEA sentences.
	  Disable this in battery-powered deployments to reduce application-core
	  wakeups, log traffic, and memory use.

config GNSS_LOW_ACCURACY
	bool "Allow Low Accuracy GNSS Fixes"
	default y
	help
	  Enables low accuracy mode to obtain faster satellite fixes (useful indoors or in urban canyons).

config GNSS_HIGH_ACCURACY_TIMING_SOURCE
	bool "Use TCXO Crystal Oscillator Timing Source"
	default n
	help
	  Use high accuracy TCXO crystal oscillator instead of RTC for GNSS timing.

config TRACKER_CIRCUIT_DOJO_GNSS_SETUP
	bool "Enable Circuit Dojo nRF9160 GNSS hardware setup"
	default y if BOARD_CIRCUITDOJO_FEATHER_NRF9160_NS
	default y if BOARD_SPARKFUN_THING_PLUS_NRF9160_NS
	depends on GPIO
	help
	  Drive the Circuit Dojo GNSS sample's power-mode GPIO low during
	  application startup. The matching board configuration also enables
	  the modem antenna library and its GNSS COEX0 routing command.

config TRACKER_GNSS_POWER_MODE_PIN
	int "Circuit Dojo GNSS power-mode GPIO pin"
	default 13
	range 0 31
	depends on TRACKER_CIRCUIT_DOJO_GNSS_SETUP
	help
	  GPIO0 pin used by the Circuit Dojo GNSS sample. Keep the default for
	  the nRF9160 Feather and SparkFun Thing Plus nRF9160 hardware.

config STARTUP_LED
	bool "Show tracker states with board LED blink groups"
	default y if BOARD_CIRCUITDOJO_FEATHER_NRF9160_NS
	default y if BOARD_SPARKFUN_THING_PLUS_NRF9160_NS
	depends on GPIO
	help
	  Blink the devicetree led0 LED in groups: two for GNSS finding, three
	  for LTE finding, and four for LTE registered during MQTT upload.
	  The LED is off during initialization and low-power preparation.

config WORKING_LED_BLINK_INTERVAL_MS
	int "Status LED pulse interval (milliseconds)"
	range 100 60000
	default 200
	depends on STARTUP_LED
	help
	  On time of each blink and off time between blinks within a group.

config WORKING_LED_GROUP_PAUSE_MS
	int "Status LED pause between groups (milliseconds)"
	range 100 60000
	default 1000
	depends on STARTUP_LED
	help
	  Dark time after the last blink in each group and before a new state.

config ENABLE_LEDS
	bool "Enable status LEDs"
	default n
	select DK_LIBRARY
	help
	  Enable LED visual status indicators for LTE, GNSS, and MQTT states.

endmenu

menu "Zephyr Kernel"
source "Kconfig.zephyr"
endmenu
```

## sample.yaml
```
sample:
  description: GPS-first nRF9160 tracker that publishes GNSS fixes over MQTT
  name: GPS MQTT tracker

common:
  sysbuild: true
  build_only: true
  integration_platforms:
    - sparkfun_thing_plus/nrf9160/ns
  platform_allow:
    - circuitdojo_feather/nrf9160/ns
    - sparkfun_thing_plus/nrf9160/ns

tests:
  app.gps_mqtt_tracker: {}
```

## prj.conf
```kconfig
#
# Copyright (c) 2024 Nordic Semiconductor ASA
# SPDX-License-Identifier: LicenseRef-Nordic-5-Clause
#

# The default configuration is split by subsystem under config/ and loaded by
# CMakeLists.txt through EXTRA_CONF_FILE. Keep this file as the standard Zephyr
# project configuration entry point.
#
# Edit the matching fragment instead of adding unrelated settings here:
#   config/system.conf      C library, floating point, stack, and heap
#   config/logging.conf     RTT logging and serial/console policy
#   config/hardware.conf    GPIO and LED behavior
#   config/networking.conf  Zephyr networking and socket offload
#   config/modem.conf       modem, LTE, GNSS radio mode, and power modules
#   config/mqtt.conf        MQTT library and broker destination
#   config/tracker.conf     GNSS schedule, PSM timing, and diagnostics
```

## src/main.c
```c
/*
 * Copyright (c) 2024 Nordic Semiconductor ASA
 * SPDX-License-Identifier: LicenseRef-Nordic-5-Clause
 */

#include <zephyr/kernel.h>
#include <zephyr/logging/log.h>

#include "tracker_backlog.h"
#include "tracker_gnss.h"
#include "tracker_modem.h"
#include "tracker_mqtt.h"
#include "tracker_status.h"
#include "tracker_ui.h"

LOG_MODULE_REGISTER(gps_mqtt_tracker, LOG_LEVEL_INF);

enum tracker_state {
	TRACKER_STATE_WAIT_FOR_GNSS,
	TRACKER_STATE_CONNECT_LTE,
	TRACKER_STATE_CONNECT_MQTT,
	TRACKER_STATE_PUBLISH_BACKLOG,
	TRACKER_STATE_DISCONNECT_MQTT,
	TRACKER_STATE_ENTER_LOW_POWER,
};

static void location_fix_from_pvt(struct tracker_location_fix *fix,
	const struct nrf_modem_gnss_pvt_data_frame *pvt)
{
	fix->latitude = pvt->latitude;
	fix->longitude = pvt->longitude;
	fix->altitude = pvt->altitude;
	fix->accuracy = pvt->accuracy;
	fix->datetime = pvt->datetime;
}

static int tracker_init(void)
{
	int err;

	tracker_status_set("SYSTEM INIT");
	err = tracker_ui_init();
	if (err != 0) {
		LOG_WRN("Tracker UI initialization failed: %d", err);
	}

	LOG_INF("===============================================");
	LOG_INF("GPS MQTT Asset Tracker Application Started");
	LOG_INF("Version: %d.%d.%d", CONFIG_TRACKER_VERSION_MAJOR,
		CONFIG_TRACKER_VERSION_MINOR, CONFIG_TRACKER_VERSION_PATCH);
	LOG_INF("===============================================");

	/* The modem must be initialized before MQTT, AT, LTE, or GNSS APIs. */
	err = tracker_modem_init();
	if (err != 0) {
		return err;
	}

	err = tracker_mqtt_init();
	if (err != 0) {
		return err;
	}

	return tracker_gnss_start();
}

int main(void)
{
	struct nrf_modem_gnss_pvt_data_frame location;
	enum tracker_state state = TRACKER_STATE_WAIT_FOR_GNSS;
	int err;

	err = tracker_init();
	if (err != 0) {
		tracker_status_set("SYSTEM ERROR");
		LOG_ERR("Tracker initialization failed: %d", err);
		return 0;
	}

	while (true) {
		switch (state) {
		case TRACKER_STATE_WAIT_FOR_GNSS:
			tracker_ui_set_state(TRACKER_UI_GNSS);
			err = tracker_gnss_wait_for_fix(&location);
			if (err == 0) {
				struct tracker_location_fix fix;

				location_fix_from_pvt(&fix, &location);
				/*
				 * Buffer the fix immediately, before attempting any
				 * upload. If LTE/MQTT/publish fails below, the fix
				 * simply stays in the backlog for a later cycle
				 * instead of being lost -- see ticket 09.
				 */
				tracker_backlog_add(&fix);
			}
			state = (err == 0) ? TRACKER_STATE_CONNECT_LTE :
				TRACKER_STATE_ENTER_LOW_POWER;
			break;

		case TRACKER_STATE_CONNECT_LTE:
			tracker_ui_set_state(TRACKER_UI_LTE);
			err = tracker_modem_prepare_upload(K_SECONDS(60));
			state = (err == 0) ? TRACKER_STATE_CONNECT_MQTT :
				TRACKER_STATE_ENTER_LOW_POWER;
			break;

		case TRACKER_STATE_CONNECT_MQTT:
			tracker_ui_set_state(TRACKER_UI_LTE_CONNECTED);
			err = tracker_mqtt_connect(K_SECONDS(15));
			state = (err == 0) ? TRACKER_STATE_PUBLISH_BACKLOG :
				TRACKER_STATE_DISCONNECT_MQTT;
			break;

		case TRACKER_STATE_PUBLISH_BACKLOG: {
			struct tracker_location_fix fix;
			size_t delivered = 0;

			while (tracker_backlog_peek_oldest(&fix)) {
				err = tracker_mqtt_publish_location(&fix, K_SECONDS(15));
				if (err != 0) {
					LOG_ERR("Location delivery failed: %d", err);
					break;
				}
				/*
				 * Only remove after tracker_mqtt_publish_location()
				 * confirms the broker's PUBACK (QoS 1) -- an
				 * unacknowledged publish must stay in the backlog.
				 */
				tracker_backlog_remove_oldest();
				delivered++;
			}
			if (delivered > 0) {
				LOG_INF("Delivered %zu buffered location(s)", delivered);
			}
			state = TRACKER_STATE_DISCONNECT_MQTT;
			break;
		}

		case TRACKER_STATE_DISCONNECT_MQTT:
			err = tracker_mqtt_disconnect(K_SECONDS(10));
			if (err != 0) {
				LOG_WRN("MQTT disconnect did not complete cleanly: %d", err);
			}
			state = TRACKER_STATE_ENTER_LOW_POWER;
			break;

		case TRACKER_STATE_ENTER_LOW_POWER:
			tracker_status_set("LOW POWER PREPARE");
			tracker_ui_set_state(TRACKER_UI_IDLE);
			err = tracker_modem_enter_low_power(
				K_SECONDS(CONFIG_TRACKER_PSM_ENTRY_TIMEOUT_SECONDS));
			if (err != 0) {
				LOG_ERR("Failed to enter a GNSS-safe low-power state: %d", err);
			}
			state = TRACKER_STATE_WAIT_FOR_GNSS;
			break;
		}
	}

	return 0;
}
```

## src/circuitdojo_gnss.c
```c
/*
 * Copyright (c) 2021 Circuit Dojo LLC
 * Copyright (c) 2026 GPS MQTT tracker contributors
 *
 * SPDX-License-Identifier: Apache-2.0
 */

#include <errno.h>

#include <zephyr/device.h>
#include <zephyr/drivers/gpio.h>
#include <zephyr/init.h>
#include <zephyr/kernel.h>

static int circuit_dojo_gnss_setup(void)
{
	const struct device *gpio = DEVICE_DT_GET(DT_NODELABEL(gpio0));

	if (!device_is_ready(gpio)) {
		return -ENODEV;
	}

	return gpio_pin_configure(gpio, CONFIG_TRACKER_GNSS_POWER_MODE_PIN,
				  GPIO_OUTPUT_LOW);
}

SYS_INIT(circuit_dojo_gnss_setup, APPLICATION, CONFIG_APPLICATION_INIT_PRIORITY);
```

## src/tracker_backlog.h
```c
/* SPDX-License-Identifier: LicenseRef-Nordic-5-Clause */

#ifndef TRACKER_BACKLOG_H_
#define TRACKER_BACKLOG_H_

#include <stdbool.h>
#include <stddef.h>
#include <nrf_modem_gnss.h>

/*
 * Only the fields tracker_mqtt_publish_location() needs to publish --
 * deliberately not the full struct nrf_modem_gnss_pvt_data_frame, which
 * carries a per-satellite array the backlog has no use for and cannot
 * afford to store CONFIG_TRACKER_BACKLOG_CAPACITY copies of.
 */
struct tracker_location_fix {
	double latitude;
	double longitude;
	float altitude;
	float accuracy;
	struct nrf_modem_gnss_datetime datetime;
};

/*
 * Add a fix to the backlog, to be published once connectivity returns.
 * Not synchronized: call only from the tracker's single application thread.
 */
void tracker_backlog_add(const struct tracker_location_fix *fix);

/* Number of fixes currently held in the backlog. */
size_t tracker_backlog_count(void);

/*
 * Read the oldest backlog entry without removing it.
 * Returns false (and leaves *out untouched) if the backlog is empty.
 */
bool tracker_backlog_peek_oldest(struct tracker_location_fix *out);

/*
 * Remove the oldest backlog entry. Call only after
 * tracker_backlog_peek_oldest() and confirmation (e.g. a PUBACK) that it
 * was successfully delivered.
 */
void tracker_backlog_remove_oldest(void);

#endif /* TRACKER_BACKLOG_H_ */
```

## src/tracker_gnss.c
```c
/*
 * Copyright (c) 2024 Nordic Semiconductor ASA
 * SPDX-License-Identifier: LicenseRef-Nordic-5-Clause
 */

#include <errno.h>
#include <zephyr/kernel.h>
#include <zephyr/logging/log.h>
#include <nrf_modem_gnss.h>

#include "tracker_gnss.h"
#include "tracker_status.h"

LOG_MODULE_REGISTER(tracker_gnss, LOG_LEVEL_INF);

K_MSGQ_DEFINE(gnss_pvt_queue, sizeof(struct nrf_modem_gnss_pvt_data_frame), 2, 4);
#if defined(CONFIG_TRACKER_GNSS_DIAGNOSTICS)
K_MSGQ_DEFINE(gnss_nmea_queue, sizeof(struct nrf_modem_gnss_nmea_data_frame), 20, 4);

static void print_satellite_stats(const struct nrf_modem_gnss_pvt_data_frame *pvt)
{
	uint8_t tracked = 0;
	uint8_t in_fix = 0;
	uint8_t unhealthy = 0;

	for (int i = 0; i < NRF_MODEM_GNSS_MAX_SATELLITES; i++) {
		if (pvt->sv[i].sv == 0) {
			continue;
		}

		tracked++;
		if ((pvt->sv[i].flags & NRF_MODEM_GNSS_SV_FLAG_USED_IN_FIX) != 0) {
			in_fix++;
		}
		if ((pvt->sv[i].flags & NRF_MODEM_GNSS_SV_FLAG_UNHEALTHY) != 0) {
			unhealthy++;
		}
	}

	LOG_RAW("Tracking: %2d Using: %2d Unhealthy: %d\n", tracked, in_fix, unhealthy);
}

static void print_gnss_flags(const struct nrf_modem_gnss_pvt_data_frame *pvt)
{
	if ((pvt->flags & NRF_MODEM_GNSS_PVT_FLAG_DEADLINE_MISSED) != 0) {
		LOG_RAW("GNSS operation blocked by LTE\n");
	}
	if ((pvt->flags & NRF_MODEM_GNSS_PVT_FLAG_NOT_ENOUGH_WINDOW_TIME) != 0) {
		LOG_RAW("Insufficient GNSS time windows\n");
	}
	if ((pvt->flags & NRF_MODEM_GNSS_PVT_FLAG_SLEEP_BETWEEN_PVT) != 0) {
		LOG_RAW("Sleep period(s) between PVT notifications\n");
	}
	if ((pvt->flags & NRF_MODEM_GNSS_PVT_FLAG_SCHED_DOWNLOAD) != 0) {
		LOG_RAW("Scheduled navigation data download\n");
	}
}

static void print_fix_data(const struct nrf_modem_gnss_pvt_data_frame *pvt)
{
	LOG_RAW("Latitude:          %.06f\n", pvt->latitude);
	LOG_RAW("Longitude:         %.06f\n", pvt->longitude);
	LOG_RAW("Accuracy:          %.01f m\n", (double)pvt->accuracy);
	LOG_RAW("Altitude:          %.01f m\n", (double)pvt->altitude);
	LOG_RAW("Altitude accuracy: %.01f m\n", (double)pvt->altitude_accuracy);
	LOG_RAW("Speed:             %.01f m/s\n", (double)pvt->speed);
	LOG_RAW("Speed accuracy:    %.01f m/s\n", (double)pvt->speed_accuracy);
	LOG_RAW("V. speed:          %.01f m/s\n", (double)pvt->vertical_speed);
	LOG_RAW("V. speed accuracy: %.01f m/s\n", (double)pvt->vertical_speed_accuracy);
	LOG_RAW("Heading:           %.01f deg\n", (double)pvt->heading);
	LOG_RAW("Heading accuracy:  %.01f deg\n", (double)pvt->heading_accuracy);
	LOG_RAW("Date:              %04u-%02u-%02u\n", pvt->datetime.year,
		pvt->datetime.month, pvt->datetime.day);
	LOG_RAW("Time (UTC):        %02u:%02u:%02u.%03u\n", pvt->datetime.hour,
		pvt->datetime.minute, pvt->datetime.seconds, pvt->datetime.ms);
	LOG_RAW("PDOP:              %.01f\n", (double)pvt->pdop);
	LOG_RAW("HDOP:              %.01f\n", (double)pvt->hdop);
	LOG_RAW("VDOP:              %.01f\n", (double)pvt->vdop);
	LOG_RAW("TDOP:              %.01f\n", (double)pvt->tdop);
}

static void print_gnss_status(const struct nrf_modem_gnss_pvt_data_frame *pvt)
{
	static const char update_indicator[] = {'\\', '|', '/', '-'};
	static int64_t fix_timestamp;
	static uint8_t indicator_count;
	struct nrf_modem_gnss_nmea_data_frame nmea;

	if (fix_timestamp == 0) {
		fix_timestamp = k_uptime_get();
	}

	LOG_RAW("\033[1;1H");
	LOG_RAW("\033[2J");
	print_satellite_stats(pvt);
	print_gnss_flags(pvt);
	LOG_RAW("-----------------------------------\n");

	if ((pvt->flags & NRF_MODEM_GNSS_PVT_FLAG_FIX_VALID) != 0) {
		fix_timestamp = k_uptime_get();
		print_fix_data(pvt);
	} else {
		LOG_RAW("Seconds since last fix: %u\n",
			(uint32_t)((k_uptime_get() - fix_timestamp) / 1000));
		indicator_count++;
		LOG_RAW("Searching [%c]\n", update_indicator[indicator_count % 4]);
	}

	LOG_RAW("\nNMEA strings:\n\n");
	while (k_msgq_get(&gnss_nmea_queue, &nmea, K_NO_WAIT) == 0) {
		LOG_RAW("%s", nmea.nmea_str);
	}
}
#endif

static void gnss_event_handler(int event)
{
	struct nrf_modem_gnss_pvt_data_frame pvt;
	int err;

	switch (event) {
	case NRF_MODEM_GNSS_EVT_PVT:
		err = nrf_modem_gnss_read(&pvt, sizeof(pvt), NRF_MODEM_GNSS_DATA_PVT);
		if (err != 0) {
			LOG_ERR("Failed to read GNSS PVT data: %d", err);
			break;
		}

		err = k_msgq_put(&gnss_pvt_queue, &pvt, K_NO_WAIT);
		if (err != 0) {
			LOG_WRN("GNSS PVT queue full; dropping one status frame");
		}
		break;

	case NRF_MODEM_GNSS_EVT_FIX:
		tracker_status_set("GNSS FIX EVENT");
		LOG_INF("GNSS fix event detected");
		break;

#if defined(CONFIG_TRACKER_GNSS_DIAGNOSTICS)
	case NRF_MODEM_GNSS_EVT_NMEA: {
		struct nrf_modem_gnss_nmea_data_frame nmea;

		err = nrf_modem_gnss_read(&nmea, sizeof(nmea), NRF_MODEM_GNSS_DATA_NMEA);
		if (err != 0) {
			LOG_ERR("Failed to read GNSS NMEA data: %d", err);
			break;
		}

		if (k_msgq_put(&gnss_nmea_queue, &nmea, K_NO_WAIT) != 0) {
			LOG_DBG("GNSS NMEA queue full; dropping one sentence");
		}
		break;
	}
#endif

	case NRF_MODEM_GNSS_EVT_PERIODIC_WAKEUP:
		tracker_status_set("GNSS PERIODIC WAKEUP");
		LOG_INF("GNSS woke up for periodic fix cycle");
		break;
	case NRF_MODEM_GNSS_EVT_BLOCKED:
		tracker_status_set("GNSS BLOCKED");
		LOG_WRN("GNSS blocked by LTE activity");
		break;
	case NRF_MODEM_GNSS_EVT_UNBLOCKED:
		tracker_status_set("GNSS UNBLOCKED");
		LOG_INF("GNSS unblocked; radio time is available again");
		break;
	case NRF_MODEM_GNSS_EVT_SLEEP_AFTER_FIX:
		tracker_status_set("GNSS SLEEP AFTER FIX");
		LOG_INF("GNSS sleeping after a valid fix");
		break;
	case NRF_MODEM_GNSS_EVT_SLEEP_AFTER_TIMEOUT:
		tracker_status_set("GNSS SLEEP AFTER TIMEOUT");
		LOG_WRN("GNSS fix timeout reached without valid fix");
		break;
	case NRF_MODEM_GNSS_EVT_REF_ALT_EXPIRED:
		tracker_status_set("GNSS REFERENCE ALTITUDE EXPIRED");
		LOG_WRN("GNSS reference altitude expired");
		break;
	default:
		tracker_status_set("GNSS EVENT UNHANDLED");
		LOG_INF("Unhandled GNSS event: %d", event);
		break;
	}
}

int tracker_gnss_start(void)
{
	uint16_t nmea_mask = 0;
	uint8_t use_case = NRF_MODEM_GNSS_USE_CASE_MULTIPLE_HOT_START;
	int err;

	tracker_status_set("GNSS INIT");

#if defined(CONFIG_TRACKER_GNSS_DIAGNOSTICS)
	nmea_mask = NRF_MODEM_GNSS_NMEA_RMC_MASK |
		NRF_MODEM_GNSS_NMEA_GGA_MASK | NRF_MODEM_GNSS_NMEA_GLL_MASK |
		NRF_MODEM_GNSS_NMEA_GSA_MASK | NRF_MODEM_GNSS_NMEA_GSV_MASK;
#endif

#if defined(CONFIG_GNSS_HIGH_ACCURACY_TIMING_SOURCE)
	tracker_status_set("GNSS TIMING SOURCE CONFIG");
	err = nrf_modem_gnss_timing_source_set(NRF_MODEM_GNSS_TIMING_SOURCE_TCXO);
	if (err != 0) {
		LOG_ERR("Failed to set TCXO timing source: %d", err);
		return err;
	}
#endif

#if defined(CONFIG_GNSS_LOW_ACCURACY)
	use_case |= NRF_MODEM_GNSS_USE_CASE_LOW_ACCURACY;
#endif

	tracker_status_set("GNSS USE CASE CONFIG");
	err = nrf_modem_gnss_use_case_set(use_case);
	if (err != 0) {
		LOG_ERR("Failed to set GNSS use case: %d", err);
		return err;
	}

	tracker_status_set("GNSS EVENT HANDLER CONFIG");
	err = nrf_modem_gnss_event_handler_set(gnss_event_handler);
	if (err != 0) {
		LOG_ERR("Failed to set GNSS event handler: %d", err);
		return err;
	}

	tracker_status_set("GNSS NMEA CONFIG");
	err = nrf_modem_gnss_nmea_mask_set(nmea_mask);
	if (err != 0) {
		LOG_ERR("Failed to configure GNSS NMEA output: %d", err);
		return err;
	}

	tracker_status_set("GNSS FIX INTERVAL CONFIG");
	err = nrf_modem_gnss_fix_interval_set(CONFIG_TRACKER_PERIODIC_INTERVAL);
	if (err != 0) {
		LOG_ERR("Failed to set GNSS fix interval: %d", err);
		return err;
	}

	tracker_status_set("GNSS FIX TIMEOUT CONFIG");
	err = nrf_modem_gnss_fix_retry_set(CONFIG_TRACKER_PERIODIC_TIMEOUT);
	if (err != 0) {
		LOG_ERR("Failed to set GNSS fix retry timeout: %d", err);
		return err;
	}

	tracker_status_set("GNSS START");
	err = nrf_modem_gnss_start();
	if (err != 0) {
		LOG_ERR("Failed to start GNSS module: %d", err);
		return err;
	}

	tracker_status_set("GNSS PRIORITY MODE CONFIG");
	err = nrf_modem_gnss_prio_mode_enable();
	if (err != 0) {
		LOG_ERR("Failed to enable GNSS priority mode: %d", err);
		return err;
	}

	LOG_INF("GNSS started (interval: %ds, timeout: %ds)",
		CONFIG_TRACKER_PERIODIC_INTERVAL, CONFIG_TRACKER_PERIODIC_TIMEOUT);
	return 0;
}

int tracker_gnss_wait_for_fix(struct nrf_modem_gnss_pvt_data_frame *pvt)
{
	int err;

	if (pvt == NULL) {
		return -EINVAL;
	}

	tracker_status_set("GNSS FINDING");
	LOG_INF("Waiting for GNSS fix...");

	/*
	 * Discard any PVT frames queued while nobody was reading (e.g. during
	 * the LTE/MQTT upload that follows the previous fix). Without this,
	 * the first k_msgq_get below can return a fix that is already
	 * minutes stale, triggering an immediate, unnecessary upload cycle.
	 */
	k_msgq_purge(&gnss_pvt_queue);

	do {
		err = k_msgq_get(&gnss_pvt_queue, pvt, K_FOREVER);
		if (err != 0) {
			LOG_ERR("Failed to receive GNSS PVT status: %d", err);
			return err;
		}
#if defined(CONFIG_TRACKER_GNSS_DIAGNOSTICS)
		print_gnss_status(pvt);
#endif
	} while ((pvt->flags & NRF_MODEM_GNSS_PVT_FLAG_FIX_VALID) == 0);

	tracker_status_set("GNSS FIX ACQUIRED");

	return 0;
}
```

## src/tracker_gnss.h
```c
/* SPDX-License-Identifier: LicenseRef-Nordic-5-Clause */

#ifndef TRACKER_GNSS_H_
#define TRACKER_GNSS_H_

#include <nrf_modem_gnss.h>

int tracker_gnss_start(void);
int tracker_gnss_wait_for_fix(struct nrf_modem_gnss_pvt_data_frame *pvt);

#endif /* TRACKER_GNSS_H_ */
```

## src/tracker_modem.c
```c
/*
 * Copyright (c) 2024 Nordic Semiconductor ASA
 * SPDX-License-Identifier: LicenseRef-Nordic-5-Clause
 */

#include <errno.h>
#include <zephyr/kernel.h>
#include <zephyr/logging/log.h>
#include <zephyr/sys/atomic.h>
#include <modem/lte_lc.h>
#include <modem/nrf_modem_lib.h>

#include "tracker_modem.h"

LOG_MODULE_REGISTER(tracker_modem, LOG_LEVEL_INF);

static K_SEM_DEFINE(lte_connected, 0, 1);
static K_SEM_DEFINE(psm_entered, 0, 1);
static atomic_t lte_registered;
static atomic_t psm_granted;
static atomic_t modem_in_psm;

static void lte_event_handler(const struct lte_lc_evt *const evt)
{
	switch (evt->type) {
	case LTE_LC_EVT_NW_REG_STATUS:
		if (evt->nw_reg_status == LTE_LC_NW_REG_REGISTERED_HOME ||
		    evt->nw_reg_status == LTE_LC_NW_REG_REGISTERED_ROAMING) {
			atomic_set(&lte_registered, 1);
			LOG_INF("LTE registered (%s)",
				evt->nw_reg_status == LTE_LC_NW_REG_REGISTERED_HOME ?
				"home network" : "roaming");
			k_sem_give(&lte_connected);
		} else {
			atomic_clear(&lte_registered);
		}
		break;
	case LTE_LC_EVT_PSM_UPDATE:
		LOG_INF("PSM parameters granted: TAU=%d s, active time=%d s",
			evt->psm_cfg.tau, evt->psm_cfg.active_time);
		if (evt->psm_cfg.tau >= 0 && evt->psm_cfg.active_time >= 0) {
			atomic_set(&psm_granted, 1);
		} else {
			atomic_clear(&psm_granted);
			LOG_WRN("Network did not grant PSM");
		}
		break;
	case LTE_LC_EVT_RRC_UPDATE:
		LOG_INF("RRC mode: %s", evt->rrc_mode == LTE_LC_RRC_MODE_CONNECTED ?
			"connected" : "idle");
		break;
	case LTE_LC_EVT_MODEM_SLEEP_ENTER:
		if (evt->modem_sleep.type == LTE_LC_MODEM_SLEEP_PSM) {
			atomic_set(&modem_in_psm, 1);
			LOG_INF("Modem entered PSM for %lld ms", evt->modem_sleep.time);
			k_sem_give(&psm_entered);
		}
		break;
	case LTE_LC_EVT_MODEM_SLEEP_EXIT:
		if (evt->modem_sleep.type == LTE_LC_MODEM_SLEEP_PSM) {
			atomic_clear(&modem_in_psm);
			LOG_INF("Modem exited PSM");
		}
		break;
	default:
		break;
	}
}

int tracker_modem_init(void)
{
	int err;

	LOG_INF("Initializing nRF modem library...");
	err = nrf_modem_lib_init();
	if (err != 0) {
		LOG_ERR("Failed to initialize nRF modem library: %d", err);
		return err;
	}

	lte_lc_register_handler(lte_event_handler);

	err = lte_lc_psm_param_set_seconds(CONFIG_TRACKER_PSM_PERIODIC_TAU_SECONDS,
		CONFIG_TRACKER_PSM_ACTIVE_TIME_SECONDS);
	if (err != 0) {
		LOG_ERR("Failed to configure PSM parameters: %d", err);
		return err;
	}

	err = lte_lc_psm_req(true);
	if (err != 0) {
		LOG_WRN("Failed to request PSM: %d", err);
	}

	err = tracker_modem_return_to_gnss();
	if (err != 0) {
		return err;
	}

	err = lte_lc_func_mode_set(LTE_LC_FUNC_MODE_ACTIVATE_GNSS);
	if (err != 0) {
		LOG_ERR("Failed to activate GNSS: %d", err);
	}

	return err;
}

int tracker_modem_prepare_upload(k_timeout_t timeout)
{
	int err;

	if (atomic_get(&lte_registered)) {
		LOG_INF("LTE registration retained; preparing uplink from low-power mode");
		return 0;
	}

	LOG_INF("Activating LTE for location upload...");
	k_sem_reset(&lte_connected);
	err = lte_lc_func_mode_set(LTE_LC_FUNC_MODE_NORMAL);
	if (err != 0) {
		LOG_ERR("Failed to activate LTE: %d", err);
		return err;
	}

	err = k_sem_take(&lte_connected, timeout);
	if (err != 0) {
		LOG_ERR("LTE registration timed out");
		return -ETIMEDOUT;
	}

	return 0;
}

int tracker_modem_enter_low_power(k_timeout_t timeout)
{
	int err;

	if (!atomic_get(&lte_registered) || !atomic_get(&psm_granted)) {
		LOG_WRN("PSM is unavailable; deactivating LTE for the next GNSS cycle");
		return tracker_modem_return_to_gnss();
	}

	k_sem_reset(&psm_entered);
	if (atomic_get(&modem_in_psm)) {
		return 0;
	}

	LOG_INF("Waiting for modem to enter PSM...");
	err = k_sem_take(&psm_entered, timeout);
	if (err == 0 || atomic_get(&modem_in_psm)) {
		return 0;
	}

	LOG_WRN("PSM entry timed out; deactivating LTE for the next GNSS cycle");
	return tracker_modem_return_to_gnss();
}

int tracker_modem_return_to_gnss(void)
{
	int err;

	LOG_INF("Deactivating LTE to return radio control to GNSS...");
	atomic_clear(&lte_registered);
	atomic_clear(&psm_granted);
	atomic_clear(&modem_in_psm);
	err = lte_lc_func_mode_set(LTE_LC_FUNC_MODE_DEACTIVATE_LTE);
	if (err != 0) {
		LOG_ERR("Failed to deactivate LTE: %d", err);
		return err;
	}

	return 0;
}
```

## src/tracker_modem.h
```c
/* SPDX-License-Identifier: LicenseRef-Nordic-5-Clause */

#ifndef TRACKER_MODEM_H_
#define TRACKER_MODEM_H_

#include <zephyr/kernel.h>

int tracker_modem_init(void);
int tracker_modem_prepare_upload(k_timeout_t timeout);
int tracker_modem_enter_low_power(k_timeout_t timeout);
int tracker_modem_return_to_gnss(void);

#endif /* TRACKER_MODEM_H_ */
```

## src/tracker_mqtt.c
```c
/*
 * Copyright (c) 2024 Nordic Semiconductor ASA
 * SPDX-License-Identifier: LicenseRef-Nordic-5-Clause
 */

#include <errno.h>
#include <stdio.h>
#include <string.h>
#include <zephyr/kernel.h>
#include <zephyr/logging/log.h>
#include <zephyr/sys/atomic.h>
#include <nrf_modem_at.h>
#include <modem/modem_key_mgmt.h>
#include <net/mqtt_helper.h>

#include "tracker_mqtt.h"
#include "tracker_status.h"

LOG_MODULE_REGISTER(tracker_mqtt, LOG_LEVEL_INF);

#define IMEI_LEN 15
#define CGSN_RESPONSE_LENGTH (IMEI_LEN + 6 + 1)
#define CLIENT_ID_LEN (sizeof("nrf-") + IMEI_LEN)
#define MQTT_PAYLOAD_MAX_LEN 256

static K_SEM_DEFINE(mqtt_conn_sem, 0, 1);
static K_SEM_DEFINE(mqtt_puback_sem, 0, 1);
static K_SEM_DEFINE(mqtt_disconnected_sem, 0, 1);

static char client_id_buf[CLIENT_ID_LEN];

/*
 * connack_result and puback_result are written by the MQTT helper's RX
 * callbacks (on_mqtt_connack/on_mqtt_puback, invoked from the helper's own
 * mqtt_helper_thread) and read by the tracker thread after a matching
 * k_sem_take. This is safe without atomics only because each value is
 * fully written before its paired k_sem_give, and only read after the
 * corresponding k_sem_take returns: the semaphore operations provide the
 * happens-before ordering. Keep that write-then-give / take-then-read
 * pairing intact if this code is ever restructured.
 *
 * pending_publish_id runs the other direction: it's written by the tracker
 * thread (tracker_mqtt_publish_location(), before calling
 * mqtt_helper_publish()) and read by on_mqtt_puback() on mqtt_helper_thread
 * when a PUBACK arrives. There is no semaphore between that write and read;
 * the ordering instead relies on mqtt_helper_publish() calling mqtt_publish()
 * synchronously in the tracker thread (so the write is complete before the
 * PUBLISH packet is even sent) plus network causality (the broker cannot
 * PUBACK a message ID it hasn't received yet). Don't make mqtt_helper_publish()
 * asynchronous relative to this write without adding real synchronization.
 */
static enum mqtt_conn_return_code connack_result;
static int puback_result;
static uint16_t pending_publish_id;
static atomic_t connect_attempted;

static const unsigned char broker_ca_certificate[] = {
#if __has_include("ca-cert.pem")
#include "ca-cert.pem"
#else
""
#endif
};

static int broker_ca_provision(void)
{
	bool exists;
	int err;
	int comparison;

	if (sizeof(broker_ca_certificate) <= 1) {
		LOG_ERR("TLS is enabled but credentials/ca-cert.pem is missing");
		return -ENOENT;
	}

	tracker_status_set("MQTT TLS CA CHECK");
	err = modem_key_mgmt_exists(CONFIG_MQTT_HELPER_SEC_TAG,
		MODEM_KEY_MGMT_CRED_TYPE_CA_CHAIN, &exists);
	if (err != 0) {
		LOG_ERR("Failed to check MQTT broker CA: %d", err);
		return err;
	}

	if (exists) {
		comparison = modem_key_mgmt_cmp(CONFIG_MQTT_HELPER_SEC_TAG,
			MODEM_KEY_MGMT_CRED_TYPE_CA_CHAIN, broker_ca_certificate,
			sizeof(broker_ca_certificate) - 1);
		if (comparison == 0) {
			tracker_status_set("MQTT TLS CA READY");
			LOG_INF("MQTT broker CA is already provisioned");
			return 0;
		}

		tracker_status_set("MQTT TLS CA DELETE");
		err = modem_key_mgmt_delete(CONFIG_MQTT_HELPER_SEC_TAG,
			MODEM_KEY_MGMT_CRED_TYPE_CA_CHAIN);
		if (err != 0) {
			LOG_ERR("Failed to replace MQTT broker CA: %d", err);
			return err;
		}
	}

	tracker_status_set("MQTT TLS CA WRITE");
	err = modem_key_mgmt_write(CONFIG_MQTT_HELPER_SEC_TAG,
		MODEM_KEY_MGMT_CRED_TYPE_CA_CHAIN, broker_ca_certificate,
		sizeof(broker_ca_certificate) - 1);
	if (err != 0) {
		LOG_ERR("Failed to provision MQTT broker CA: %d", err);
		return err;
	}

	tracker_status_set("MQTT TLS CA READY");
	LOG_INF("MQTT broker CA provisioned in sec tag %d", CONFIG_MQTT_HELPER_SEC_TAG);
	return 0;
}

static int client_id_get(char *buffer, size_t buffer_len)
{
	char imei_buf[CGSN_RESPONSE_LENGTH];
	int len;
	int err;

	if (strlen(CONFIG_MQTT_CLIENT_ID) > 0) {
		tracker_status_set("MQTT CLIENT ID CONFIG");
		len = snprintf(buffer, buffer_len, "%s", CONFIG_MQTT_CLIENT_ID);
		if (len < 0 || (size_t)len >= buffer_len) {
			LOG_ERR("Configured MQTT client ID is too long");
			return -EMSGSIZE;
		}
		return 0;
	}

	tracker_status_set("MODEM IMEI READ");
	err = nrf_modem_at_cmd(imei_buf, sizeof(imei_buf), "AT+CGSN");
	if (err != 0) {
		LOG_ERR("Failed to obtain IMEI with AT+CGSN: %d", err);
		return err;
	}

	imei_buf[IMEI_LEN] = '\0';
	len = snprintf(buffer, buffer_len, "nrf-%.*s", IMEI_LEN, imei_buf);
	if (len < 0 || (size_t)len >= buffer_len) {
		LOG_ERR("Generated MQTT client ID is too long");
		return -EMSGSIZE;
	}

	LOG_INF("Generated MQTT client ID: %s", buffer);
	return 0;
}

static void on_mqtt_connack(enum mqtt_conn_return_code return_code, bool session_present)
{
	ARG_UNUSED(session_present);

	connack_result = return_code;
	if (return_code == MQTT_CONNECTION_ACCEPTED) {
		tracker_status_set("MQTT CONNECTED");
		LOG_INF("Connected to MQTT broker: %s:%d", CONFIG_MQTT_BROKER_HOSTNAME,
			CONFIG_MQTT_BROKER_PORT);
	} else {
		tracker_status_set("MQTT CONNECTION REJECTED");
		LOG_ERR("MQTT broker rejected connection: %d", return_code);
	}

	k_sem_give(&mqtt_conn_sem);
}

static void on_mqtt_disconnect(int result)
{
	atomic_clear(&connect_attempted);
	tracker_status_set("MQTT DISCONNECTED");
	if (result == 0) {
		LOG_INF("MQTT client disconnected");
	} else {
		LOG_WRN("MQTT client disconnected with result: %d", result);
	}
	k_sem_give(&mqtt_disconnected_sem);
}

static void on_mqtt_puback(uint16_t message_id, int result)
{
	if (message_id != pending_publish_id) {
		LOG_WRN("Unexpected MQTT PUBACK ID: %u", message_id);
		return;
	}

	puback_result = result;
	if (result != 0) {
		tracker_status_set("MQTT PUBLISH ACK ERROR");
		LOG_ERR("MQTT PUBACK failed for ID %u: %d", message_id, result);
	} else {
		tracker_status_set("MQTT PUBLISH ACKNOWLEDGED");
		LOG_INF("MQTT broker acknowledged location payload (ID: %u)", message_id);
	}
	k_sem_give(&mqtt_puback_sem);
}

int tracker_mqtt_init(void)
{
	struct mqtt_helper_cfg mqtt_cfg = {
		.cb = {
			.on_connack = on_mqtt_connack,
			.on_disconnect = on_mqtt_disconnect,
			.on_puback = on_mqtt_puback,
		},
	};
	int err;

	tracker_status_set("MQTT INIT");

	if (strlen(CONFIG_MQTT_BROKER_PASSWORD) > 0 &&
	    strlen(CONFIG_MQTT_BROKER_USERNAME) == 0) {
		LOG_ERR("MQTT password is configured without a username");
		return -EINVAL;
	}

	if (IS_ENABLED(CONFIG_MQTT_LIB_TLS)) {
		err = broker_ca_provision();
		if (err != 0) {
			return err;
		}
	}

	tracker_status_set("MQTT HELPER CONFIG");
	err = mqtt_helper_init(&mqtt_cfg);
	if (err != 0) {
		LOG_ERR("Failed to initialize MQTT helper: %d", err);
		return err;
	}

	err = client_id_get(client_id_buf, sizeof(client_id_buf));
	if (err == 0) {
		tracker_status_set("MQTT READY");
	}

	return err;
}

int tracker_mqtt_connect(k_timeout_t timeout)
{
	struct mqtt_helper_conn_params conn_params = {
		.hostname.ptr = CONFIG_MQTT_BROKER_HOSTNAME,
		.hostname.size = strlen(CONFIG_MQTT_BROKER_HOSTNAME),
		.device_id.ptr = client_id_buf,
		.device_id.size = strlen(client_id_buf),
		.user_name.ptr = CONFIG_MQTT_BROKER_USERNAME,
		.user_name.size = strlen(CONFIG_MQTT_BROKER_USERNAME),
		.password.ptr = CONFIG_MQTT_BROKER_PASSWORD,
		.password.size = strlen(CONFIG_MQTT_BROKER_PASSWORD),
	};
	int err;

	tracker_status_set("MQTT CONNECTION");
	LOG_INF("Connecting to MQTT broker (%s:%d)...", CONFIG_MQTT_BROKER_HOSTNAME,
		CONFIG_MQTT_BROKER_PORT);
	if (conn_params.user_name.size > 0) {
		LOG_INF("MQTT broker authentication enabled");
	}
	k_sem_reset(&mqtt_conn_sem);
	connack_result = MQTT_UNACCEPTABLE_PROTOCOL_VERSION;
	err = mqtt_helper_connect(&conn_params);
	if (err != 0) {
		LOG_ERR("MQTT connection attempt failed: %d", err);
		return err;
	}
	atomic_set(&connect_attempted, 1);

	err = k_sem_take(&mqtt_conn_sem, timeout);
	if (err != 0) {
		tracker_status_set("MQTT CONNECTION TIMEOUT");
		LOG_ERR("MQTT CONNACK timed out");
		return -ETIMEDOUT;
	}
	if (connack_result != MQTT_CONNECTION_ACCEPTED) {
		return -ECONNREFUSED;
	}

	return 0;
}

int tracker_mqtt_publish_location(
	const struct nrf_modem_gnss_pvt_data_frame *pvt, k_timeout_t timeout)
{
	char payload[MQTT_PAYLOAD_MAX_LEN];
	struct mqtt_publish_param param = {0};
	int payload_len;
	int err;

	if (pvt == NULL) {
		return -EINVAL;
	}

	payload_len = snprintf(payload, sizeof(payload),
		"{\"lat\":%.06f,\"lon\":%.06f,\"alt\":%.01f,\"acc\":%.01f,"
		"\"time\":\"%04u-%02u-%02uT%02u:%02u:%02uZ\"}",
		pvt->latitude, pvt->longitude, (double)pvt->altitude,
		(double)pvt->accuracy, pvt->datetime.year, pvt->datetime.month,
		pvt->datetime.day, pvt->datetime.hour, pvt->datetime.minute,
		pvt->datetime.seconds);
	if (payload_len < 0 || (size_t)payload_len >= sizeof(payload)) {
		LOG_ERR("Location payload formatting failed or was truncated");
		return -EMSGSIZE;
	}

	param.message.payload.data = (uint8_t *)payload;
	param.message.payload.len = payload_len;
	param.message.topic.qos = (enum mqtt_qos)CONFIG_MQTT_PUB_QOS;
	param.message.topic.topic.utf8 = CONFIG_MQTT_PUB_TOPIC;
	param.message.topic.topic.size = strlen(CONFIG_MQTT_PUB_TOPIC);
	pending_publish_id = mqtt_helper_msg_id_get();
	param.message_id = pending_publish_id;

	tracker_status_set("MQTT PUBLISH");
	LOG_INF("Publishing location to '%s' with QoS %d: %s", CONFIG_MQTT_PUB_TOPIC,
		CONFIG_MQTT_PUB_QOS, payload);
	if (CONFIG_MQTT_PUB_QOS == MQTT_QOS_1_AT_LEAST_ONCE) {
		k_sem_reset(&mqtt_puback_sem);
		puback_result = 0;
	}
	err = mqtt_helper_publish(&param);
	if (err != 0) {
		LOG_ERR("Failed to publish MQTT message: %d", err);
		return err;
	}

	if (CONFIG_MQTT_PUB_QOS == MQTT_QOS_0_AT_MOST_ONCE) {
		tracker_status_set("MQTT PUBLISH COMPLETE");
		return 0;
	}

	err = k_sem_take(&mqtt_puback_sem, timeout);
	if (err != 0) {
		tracker_status_set("MQTT PUBLISH ACK TIMEOUT");
		LOG_ERR("MQTT PUBACK timed out");
		return -ETIMEDOUT;
	}

	return puback_result;
}

int tracker_mqtt_disconnect(k_timeout_t timeout)
{
	int err;

	if (!atomic_get(&connect_attempted)) {
		tracker_status_set("MQTT DISCONNECTED");
		return 0;
	}

	tracker_status_set("MQTT DISCONNECT");
	k_sem_reset(&mqtt_disconnected_sem);
	err = mqtt_helper_disconnect();
	if (err != 0) {
		LOG_ERR("Failed to disconnect MQTT: %d", err);
		return err;
	}

	err = k_sem_take(&mqtt_disconnected_sem, timeout);
	if (err != 0) {
		LOG_WRN("MQTT disconnect timed out");
		return -ETIMEDOUT;
	}

	return 0;
}
```

## src/tracker_mqtt.h
```c
/* SPDX-License-Identifier: LicenseRef-Nordic-5-Clause */

#ifndef TRACKER_MQTT_H_
#define TRACKER_MQTT_H_

#include <zephyr/kernel.h>

#include "tracker_backlog.h"

int tracker_mqtt_init(void);
int tracker_mqtt_connect(k_timeout_t timeout);
int tracker_mqtt_publish_location(
	const struct tracker_location_fix *fix, k_timeout_t timeout);
int tracker_mqtt_disconnect(k_timeout_t timeout);

#endif /* TRACKER_MQTT_H_ */
```

## src/tracker_status.c
```c
/*
 * Copyright (c) 2024 Nordic Semiconductor ASA
 * SPDX-License-Identifier: LicenseRef-Nordic-5-Clause
 */

#include <zephyr/logging/log.h>

#include "tracker_status.h"

LOG_MODULE_REGISTER(tracker_status, LOG_LEVEL_INF);

void tracker_status_set(const char *label)
{
	LOG_INF("STATUS: %s", label);
}
```

## src/tracker_status.h
```c
/* SPDX-License-Identifier: LicenseRef-Nordic-5-Clause */

#ifndef TRACKER_STATUS_H_
#define TRACKER_STATUS_H_

/*
 * Emit a fixed transition marker for power-trace correlation. Keep label text
 * constant: put measurements and other variable data in a separate log line.
 */
void tracker_status_set(const char *label);

#endif /* TRACKER_STATUS_H_ */
```

## src/tracker_ui.c
```c
/*
 * Copyright (c) 2024 Nordic Semiconductor ASA
 * SPDX-License-Identifier: LicenseRef-Nordic-5-Clause
 */

#include <errno.h>
#include <zephyr/kernel.h>
#include <zephyr/logging/log.h>
#include <zephyr/sys/atomic.h>
#if defined(CONFIG_STARTUP_LED)
#include <zephyr/drivers/gpio.h>
#endif
#if IS_ENABLED(CONFIG_ENABLE_LEDS)
#include <dk_buttons_and_leds.h>
#endif

#include "tracker_ui.h"

LOG_MODULE_REGISTER(tracker_ui, LOG_LEVEL_INF);

#if defined(CONFIG_STARTUP_LED)
#define STARTUP_LED_NODE DT_ALIAS(led0)

#if !DT_NODE_HAS_STATUS(STARTUP_LED_NODE, okay)
#error "CONFIG_STARTUP_LED requires a ready led0 devicetree alias"
#endif

static const struct gpio_dt_spec startup_led = GPIO_DT_SPEC_GET(STARTUP_LED_NODE, gpios);
static struct k_work_delayable working_led_work;
static bool working_led_state;
static bool working_led_ready;
static atomic_t requested_state = ATOMIC_INIT(TRACKER_UI_IDLE);
static enum tracker_ui_state displayed_state = TRACKER_UI_IDLE;
static unsigned int completed_blinks;

static void working_led_blink_handler(struct k_work *work)
{
	int err;
	int delay_ms = CONFIG_WORKING_LED_BLINK_INTERVAL_MS;
	enum tracker_ui_state state = atomic_get(&requested_state);
	unsigned int blink_count = 0;

	ARG_UNUSED(work);
	switch (state) {
	case TRACKER_UI_GNSS:
		blink_count = 2;
		break;
	case TRACKER_UI_LTE:
		blink_count = 3;
		break;
	case TRACKER_UI_LTE_CONNECTED:
		blink_count = 4;
		break;
	case TRACKER_UI_IDLE:
		break;
	}

	if (state != displayed_state) {
		displayed_state = state;
		completed_blinks = 0;
		/* Start each new state after a full dark gap. */
		working_led_state = false;
		delay_ms = CONFIG_WORKING_LED_GROUP_PAUSE_MS;
	} else if (blink_count == 0) {
		working_led_state = false;
		delay_ms = CONFIG_WORKING_LED_GROUP_PAUSE_MS;
	} else {
		working_led_state = !working_led_state;
		if (!working_led_state && ++completed_blinks == blink_count) {
			completed_blinks = 0;
			delay_ms = CONFIG_WORKING_LED_GROUP_PAUSE_MS;
		}
	}
	err = gpio_pin_set_dt(&startup_led, working_led_state);
	if (err != 0) {
		LOG_ERR("Failed to update working LED: %d", err);
		return;
	}

	err = k_work_reschedule(&working_led_work,
		K_MSEC(delay_ms));
	if (err < 0) {
		LOG_ERR("Failed to reschedule working LED: %d", err);
	}
}

static int working_led_start(void)
{
	int err;

	if (!gpio_is_ready_dt(&startup_led)) {
		return -ENODEV;
	}

	err = gpio_pin_configure_dt(&startup_led, GPIO_OUTPUT_INACTIVE);
	if (err != 0) {
		return err;
	}

	working_led_state = false;
	k_work_init_delayable(&working_led_work, working_led_blink_handler);
	err = k_work_schedule(&working_led_work,
		K_MSEC(CONFIG_WORKING_LED_BLINK_INTERVAL_MS));
	working_led_ready = err >= 0;
	return err < 0 ? err : 0;
}
#endif

int tracker_ui_init(void)
{
#if defined(CONFIG_STARTUP_LED) || defined(CONFIG_ENABLE_LEDS)
	int err;
#endif

#if defined(CONFIG_STARTUP_LED)
	err = working_led_start();
	if (err != 0) {
		return err;
	}
	LOG_INF("Status LED pulse interval: %d ms",
		CONFIG_WORKING_LED_BLINK_INTERVAL_MS);
#endif

#if IS_ENABLED(CONFIG_ENABLE_LEDS)
	err = dk_leds_init();
	if (err != 0) {
		LOG_ERR("Failed to initialize status LEDs: %d", err);
		return err;
	}
#endif

	return 0;
}

void tracker_ui_set_state(enum tracker_ui_state state)
{
#if defined(CONFIG_STARTUP_LED)
	if ((enum tracker_ui_state)atomic_set(&requested_state, state) != state && working_led_ready) {
		int err = k_work_reschedule(&working_led_work, K_NO_WAIT);

		if (err < 0) {
			LOG_ERR("Failed to schedule status LED: %d", err);
		}
	}
#endif
#if IS_ENABLED(CONFIG_ENABLE_LEDS)
	(void)dk_set_leds(0);
	switch (state) {
	case TRACKER_UI_GNSS:
		(void)dk_set_led_on(DK_LED2);
		break;
	case TRACKER_UI_LTE:
		(void)dk_set_led_on(DK_LED1);
		break;
	case TRACKER_UI_LTE_CONNECTED:
		(void)dk_set_led_on(DK_LED4);
		break;
	case TRACKER_UI_IDLE:
		break;
	}
#else
	ARG_UNUSED(state);
#endif
}
```

## src/tracker_ui.h
```c
/* SPDX-License-Identifier: LicenseRef-Nordic-5-Clause */

#ifndef TRACKER_UI_H_
#define TRACKER_UI_H_

enum tracker_ui_state {
	TRACKER_UI_GNSS,
	TRACKER_UI_LTE,
	TRACKER_UI_MQTT,
};

int tracker_ui_init(void);
void tracker_ui_set_state(enum tracker_ui_state state);

#endif /* TRACKER_UI_H_ */
```
