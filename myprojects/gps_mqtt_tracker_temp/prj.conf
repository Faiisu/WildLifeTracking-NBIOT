## CMakeLists.txt
```
# SPDX-License-Identifier: LicenseRef-Nordic-5-Clause
cmake_minimum_required(VERSION 3.20.0)
find_package(Zephyr REQUIRED HINTS $ENV{ZEPHYR_BASE})
project(gps_mqtt_tracker_temp)

target_sources(app PRIVATE src/main.c)
if(CONFIG_TRACKER_CIRCUIT_DOJO_GNSS_SETUP)
  target_sources(app PRIVATE src/circuitdojo_gnss.c)
endif()
```

## Kconfig
```
# SPDX-License-Identifier: LicenseRef-Nordic-5-Clause
menu "GNSS baseline board setup"
config GNSS_HEARTBEAT_LED
    bool "Blink the board LED while the kernel is running"
    depends on TRACKER_CIRCUIT_DOJO_GNSS_SETUP
    default n
    help
      Toggle the devicetree led0 LED independently of GNSS fix status.

config GNSS_HEARTBEAT_INTERVAL_MS
    int "Heartbeat LED toggle interval (milliseconds)"
    depends on GNSS_HEARTBEAT_LED
    range 100 60000
    default 1000
    help
      Duration of each on and off phase of the board heartbeat LED.

config TRACKER_CIRCUIT_DOJO_GNSS_SETUP
    bool "Enable board power-mode GPIO setup"
    depends on GPIO
    default n
    help
      Apply the same power-mode GPIO setup as samples/gps at startup.

config TRACKER_GNSS_POWER_MODE_PIN
    int "Board power-mode GPIO0 pin"
    depends on TRACKER_CIRCUIT_DOJO_GNSS_SETUP
    range 0 31
    default 13
    help
      GPIO0 pin driven low by the Circuit Dojo and SparkFun GPS sample.
endmenu

# Reuse the GNSS sample options and Zephyr configuration from the pinned SDK.
source "$(ZEPHYR_NRF_MODULE_DIR)/samples/cellular/gnss/Kconfig"
```

## sample.yaml
```
sample:
  description: Continuous GNSS baseline with PVT and NMEA output over RTT
  name: GNSS RTT baseline
common:
  sysbuild: true
  build_only: true
  integration_platforms:
    - sparkfun_thing_plus/nrf9160/ns
  platform_allow:
    - sparkfun_thing_plus/nrf9160/ns
    - circuitdojo_feather/nrf9160/ns
tests:
  app.gps_mqtt_tracker_temp: {}
```

## prj.conf
```kconfig
# GNSS-only baseline matching samples/gps defaults on NCS v3.3.0.
CONFIG_TFM_PROFILE_TYPE_MINIMAL=y
CONFIG_NRF_MODEM_LIB=y
CONFIG_LTE_LINK_CONTROL=y
CONFIG_LTE_NETWORK_MODE_LTE_M_GPS=y
CONFIG_GNSS_SAMPLE_MODE_CONTINUOUS=y
CONFIG_GNSS_SAMPLE_POWER_SAVING_DISABLED=y
CONFIG_GNSS_SAMPLE_ASSISTANCE_NONE=y
CONFIG_GNSS_SAMPLE_LOW_ACCURACY=n
CONFIG_GNSS_SAMPLE_NMEA_ONLY=n

# Preserve floating-point PVT output and GNSS sample memory requirements.
CONFIG_NEWLIB_LIBC=y
CONFIG_NEWLIB_LIBC_FLOAT_PRINTF=y
CONFIG_FPU=y
CONFIG_HEAP_MEM_POOL_SIZE=2048
CONFIG_MAIN_STACK_SIZE=4096
CONFIG_SYSTEM_WORKQUEUE_STACK_SIZE=1536
CONFIG_GPIO=y
CONFIG_POLL=y
CONFIG_GNSS_HEARTBEAT_LED=y
CONFIG_GNSS_HEARTBEAT_INTERVAL_MS=1000

# Both printf console output and logging use RTT, channel 0.
CONFIG_USE_SEGGER_RTT=y
CONFIG_SEGGER_RTT_BUFFER_SIZE_UP=8192
CONFIG_SEGGER_RTT_MODE_NO_BLOCK_SKIP=y
CONFIG_CONSOLE=y
CONFIG_RTT_CONSOLE=y
CONFIG_STDOUT_CONSOLE=y
CONFIG_LOG=y
CONFIG_LOG_MODE_IMMEDIATE=y
CONFIG_LOG_PRINTK=y
CONFIG_LOG_BACKEND_RTT=y
CONFIG_LOG_BACKEND_RTT_MODE_DROP=y
CONFIG_LOG_BACKEND_UART=n
CONFIG_SERIAL=n
CONFIG_UART_CONSOLE=n
CONFIG_AT_HOST_LIBRARY=n
CONFIG_TFM_LOG_LEVEL_SILENCE=y
CONFIG_TFM_SECURE_UART=n
```

## src/main.c
```c
/*
 * Copyright (c) 2019 Nordic Semiconductor ASA
 *
 * SPDX-License-Identifier: LicenseRef-Nordic-5-Clause
 */

#include <stdio.h>
#include <stdlib.h>
#include <string.h>
#include <math.h>
#include <zephyr/kernel.h>
#include <zephyr/logging/log.h>
#include <nrf_modem_at.h>
#include <nrf_modem_gnss.h>
#include <modem/lte_lc.h>
#include <modem/nrf_modem_lib.h>
#include <date_time.h>

LOG_MODULE_REGISTER(gnss_sample, CONFIG_GNSS_SAMPLE_LOG_LEVEL);

#define PI 3.14159265358979323846
#define EARTH_RADIUS_METERS (6371.0 * 1000.0)

#if !defined(CONFIG_GNSS_SAMPLE_ASSISTANCE_NONE) || defined(CONFIG_GNSS_SAMPLE_MODE_TTFF_TEST)
static struct k_work_q gnss_work_q;

#define GNSS_WORKQ_THREAD_STACK_SIZE 2304
#define GNSS_WORKQ_THREAD_PRIORITY   5

K_THREAD_STACK_DEFINE(gnss_workq_stack_area, GNSS_WORKQ_THREAD_STACK_SIZE);
#endif /* !CONFIG_GNSS_SAMPLE_ASSISTANCE_NONE || CONFIG_GNSS_SAMPLE_MODE_TTFF_TEST */

#if !defined(CONFIG_GNSS_SAMPLE_ASSISTANCE_NONE)
#include "assistance.h"

static struct nrf_modem_gnss_agnss_data_frame last_agnss;
static struct k_work agnss_data_get_work;
static volatile bool requesting_assistance;
#endif /* !CONFIG_GNSS_SAMPLE_ASSISTANCE_NONE */

#if defined(CONFIG_GNSS_SAMPLE_MODE_TTFF_TEST)
static struct k_work_delayable ttff_test_got_fix_work;
static struct k_work_delayable ttff_test_prepare_work;
static struct k_work ttff_test_start_work;
static double time_to_fix;
#endif

static const char update_indicator[] = {'\\', '|', '/', '-'};

static struct nrf_modem_gnss_pvt_data_frame last_pvt;
static uint64_t fix_timestamp;
static uint32_t time_blocked;

/* Reference position. */
static bool ref_used;
static double ref_latitude;
static double ref_longitude;

K_MSGQ_DEFINE(nmea_queue, sizeof(struct nrf_modem_gnss_nmea_data_frame *), 10, 4);
static K_SEM_DEFINE(pvt_data_sem, 0, 1);
static K_SEM_DEFINE(time_sem, 0, 1);

static struct k_poll_event events[2] = {
	K_POLL_EVENT_STATIC_INITIALIZER(K_POLL_TYPE_SEM_AVAILABLE,
					K_POLL_MODE_NOTIFY_ONLY,
					&pvt_data_sem, 0),
	K_POLL_EVENT_STATIC_INITIALIZER(K_POLL_TYPE_MSGQ_DATA_AVAILABLE,
					K_POLL_MODE_NOTIFY_ONLY,
					&nmea_queue, 0),
};

BUILD_ASSERT(IS_ENABLED(CONFIG_LTE_NETWORK_MODE_LTE_M_GPS) ||
	     IS_ENABLED(CONFIG_LTE_NETWORK_MODE_NBIOT_GPS) ||
	     IS_ENABLED(CONFIG_LTE_NETWORK_MODE_LTE_M_NBIOT_GPS),
	     "CONFIG_LTE_NETWORK_MODE_LTE_M_GPS, "
	     "CONFIG_LTE_NETWORK_MODE_NBIOT_GPS or "
	     "CONFIG_LTE_NETWORK_MODE_LTE_M_NBIOT_GPS must be enabled");

BUILD_ASSERT((sizeof(CONFIG_GNSS_SAMPLE_REFERENCE_LATITUDE) == 1 &&
	      sizeof(CONFIG_GNSS_SAMPLE_REFERENCE_LONGITUDE) == 1) ||
	     (sizeof(CONFIG_GNSS_SAMPLE_REFERENCE_LATITUDE) > 1 &&
	      sizeof(CONFIG_GNSS_SAMPLE_REFERENCE_LONGITUDE) > 1),
	     "CONFIG_GNSS_SAMPLE_REFERENCE_LATITUDE and "
	     "CONFIG_GNSS_SAMPLE_REFERENCE_LONGITUDE must be both either set or empty");

/* Returns the distance between two coordinates in meters. The distance is calculated using the
 * haversine formula.
 */
static double distance_calculate(double lat1, double lon1,
				 double lat2, double lon2)
{
	double d_lat_rad = (lat2 - lat1) * PI / 180.0;
	double d_lon_rad = (lon2 - lon1) * PI / 180.0;

	double lat1_rad = lat1 * PI / 180.0;
	double lat2_rad = lat2 * PI / 180.0;

	double a = pow(sin(d_lat_rad / 2), 2) +
		   pow(sin(d_lon_rad / 2), 2) *
		   cos(lat1_rad) * cos(lat2_rad);

	double c = 2 * asin(sqrt(a));

	return EARTH_RADIUS_METERS * c;
}

static void print_distance_from_reference(struct nrf_modem_gnss_pvt_data_frame *pvt_data)
{
	if (!ref_used) {
		return;
	}

	double distance = distance_calculate(pvt_data->latitude, pvt_data->longitude,
					     ref_latitude, ref_longitude);

	if (IS_ENABLED(CONFIG_GNSS_SAMPLE_MODE_TTFF_TEST)) {
		LOG_INF("Distance from reference: %.01f", distance);
	} else {
		printf("\nDistance from reference: %.01f\n", distance);
	}
}

static void gnss_event_handler(int event)
{
	int retval;
	struct nrf_modem_gnss_nmea_data_frame *nmea_data;

	switch (event) {
	case NRF_MODEM_GNSS_EVT_PVT:
		retval = nrf_modem_gnss_read(&last_pvt, sizeof(last_pvt), NRF_MODEM_GNSS_DATA_PVT);
		if (retval == 0) {
			k_sem_give(&pvt_data_sem);
		}
		break;

#if defined(CONFIG_GNSS_SAMPLE_MODE_TTFF_TEST)
	case NRF_MODEM_GNSS_EVT_FIX:
		/* Time to fix is calculated here, but it's printed from a delayed work to avoid
		 * messing up the NMEA output.
		 */
		time_to_fix = (k_uptime_get() - fix_timestamp) / 1000.0;
		k_work_schedule_for_queue(&gnss_work_q, &ttff_test_got_fix_work, K_MSEC(100));
		k_work_schedule_for_queue(&gnss_work_q, &ttff_test_prepare_work,
					  K_SECONDS(CONFIG_GNSS_SAMPLE_MODE_TTFF_TEST_INTERVAL));
		break;
#endif /* CONFIG_GNSS_SAMPLE_MODE_TTFF_TEST */

	case NRF_MODEM_GNSS_EVT_NMEA:
		nmea_data = k_malloc(sizeof(struct nrf_modem_gnss_nmea_data_frame));
		if (nmea_data == NULL) {
			LOG_ERR("Failed to allocate memory for NMEA");
			break;
		}

		retval = nrf_modem_gnss_read(nmea_data,
					     sizeof(struct nrf_modem_gnss_nmea_data_frame),
					     NRF_MODEM_GNSS_DATA_NMEA);
		if (retval == 0) {
			retval = k_msgq_put(&nmea_queue, &nmea_data, K_NO_WAIT);
		}

		if (retval != 0) {
			k_free(nmea_data);
		}
		break;

	case NRF_MODEM_GNSS_EVT_AGNSS_REQ:
#if !defined(CONFIG_GNSS_SAMPLE_ASSISTANCE_NONE) && \
	!defined(CONFIG_GNSS_SAMPLE_MODE_TTFF_TEST_COLD_START)
		retval = nrf_modem_gnss_read(&last_agnss,
					     sizeof(last_agnss),
					     NRF_MODEM_GNSS_DATA_AGNSS_REQ);
		if (retval == 0) {
			k_work_submit_to_queue(&gnss_work_q, &agnss_data_get_work);
		}
#endif /* !CONFIG_GNSS_SAMPLE_ASSISTANCE_NONE && !CONFIG_GNSS_SAMPLE_MODE_TTFF_TEST_COLD_START */
		break;

	default:
		break;
	}
}

#if !defined(CONFIG_GNSS_SAMPLE_ASSISTANCE_NONE)
#if defined(CONFIG_GNSS_SAMPLE_LTE_ON_DEMAND)
K_SEM_DEFINE(lte_ready, 0, 1);

static void lte_lc_event_handler(const struct lte_lc_evt *const evt)
{
	switch (evt->type) {
	case LTE_LC_EVT_NW_REG_STATUS:
		if ((evt->nw_reg_status == LTE_LC_NW_REG_REGISTERED_HOME) ||
		    (evt->nw_reg_status == LTE_LC_NW_REG_REGISTERED_ROAMING)) {
			LOG_INF("Connected to LTE network");
			k_sem_give(&lte_ready);
		}
		break;

	default:
		break;
	}
}

void lte_connect(void)
{
	int err;

	LOG_INF("Connecting to LTE network");

	err = lte_lc_func_mode_set(LTE_LC_FUNC_MODE_ACTIVATE_LTE);
	if (err) {
		LOG_ERR("Failed to activate LTE, error: %d", err);
		return;
	}

	k_sem_take(&lte_ready, K_FOREVER);

	/* Wait for a while, because with IPv4v6 PDN the IPv6 activation takes a bit more time. */
	k_sleep(K_SECONDS(1));
}

void lte_disconnect(void)
{
	int err;

	err = lte_lc_func_mode_set(LTE_LC_FUNC_MODE_DEACTIVATE_LTE);
	if (err) {
		LOG_ERR("Failed to deactivate LTE, error: %d", err);
		return;
	}

	LOG_INF("LTE disconnected");
}
#endif /* CONFIG_GNSS_SAMPLE_LTE_ON_DEMAND */

static const char *get_system_string(uint8_t system_id)
{
	switch (system_id) {
	case NRF_MODEM_GNSS_SYSTEM_INVALID:
		return "invalid";

	case NRF_MODEM_GNSS_SYSTEM_GPS:
		return "GPS";

	case NRF_MODEM_GNSS_SYSTEM_QZSS:
		return "QZSS";

	default:
		return "unknown";
	}
}

static void agnss_data_get_work_fn(struct k_work *item)
{
	ARG_UNUSED(item);

	int err;

	/* GPS data need is always expected to be present and first in list. */
	__ASSERT(last_agnss.system_count > 0,
		 "GNSS system data need not found");
	__ASSERT(last_agnss.system[0].system_id == NRF_MODEM_GNSS_SYSTEM_GPS,
		 "GPS data need not found");

#if defined(CONFIG_GNSS_SAMPLE_ASSISTANCE_SUPL)
	/* SUPL doesn't usually provide NeQuick ionospheric corrections and satellite real time
	 * integrity information. If GNSS asks only for those, the request should be ignored.
	 */
	if (last_agnss.system[0].sv_mask_ephe == 0 &&
	    last_agnss.system[0].sv_mask_alm == 0 &&
	    (last_agnss.data_flags & ~(NRF_MODEM_GNSS_AGNSS_NEQUICK_REQUEST |
				       NRF_MODEM_GNSS_AGNSS_INTEGRITY_REQUEST)) == 0) {
		LOG_INF("Ignoring assistance request for only NeQuick and/or integrity");
		return;
	}
#endif /* CONFIG_GNSS_SAMPLE_ASSISTANCE_SUPL */

#if defined(CONFIG_GNSS_SAMPLE_ASSISTANCE_MINIMAL)
	/* With minimal assistance, the request should be ignored if no GPS time or position
	 * is requested.
	 */
	if (!(last_agnss.data_flags & NRF_MODEM_GNSS_AGNSS_GPS_SYS_TIME_AND_SV_TOW_REQUEST) &&
	    !(last_agnss.data_flags & NRF_MODEM_GNSS_AGNSS_POSITION_REQUEST)) {
		LOG_INF("Ignoring assistance request because no GPS time or position is requested");
		return;
	}
#endif /* CONFIG_GNSS_SAMPLE_ASSISTANCE_MINIMAL */

	if (last_agnss.data_flags == 0 &&
	    last_agnss.system[0].sv_mask_ephe == 0 &&
	    last_agnss.system[0].sv_mask_alm == 0) {
		LOG_INF("Ignoring assistance request because only QZSS data is requested");
		return;
	}

	requesting_assistance = true;

	LOG_INF("Assistance data needed: data_flags: 0x%02x", last_agnss.data_flags);
	for (int i = 0; i < last_agnss.system_count; i++) {
		LOG_INF("Assistance data needed: %s ephe: 0x%llx, alm: 0x%llx",
			get_system_string(last_agnss.system[i].system_id),
			last_agnss.system[i].sv_mask_ephe,
			last_agnss.system[i].sv_mask_alm);
	}

#if defined(CONFIG_GNSS_SAMPLE_LTE_ON_DEMAND)
	lte_connect();
#endif /* CONFIG_GNSS_SAMPLE_LTE_ON_DEMAND */

	err = assistance_request(&last_agnss);
	if (err) {
		LOG_ERR("Failed to request assistance data");
	}

#if defined(CONFIG_GNSS_SAMPLE_LTE_ON_DEMAND)
	lte_disconnect();
#endif /* CONFIG_GNSS_SAMPLE_LTE_ON_DEMAND */

	requesting_assistance = false;
}
#endif /* !CONFIG_GNSS_SAMPLE_ASSISTANCE_NONE */

#if defined(CONFIG_GNSS_SAMPLE_MODE_TTFF_TEST)
static void ttff_test_got_fix_work_fn(struct k_work *item)
{
	LOG_INF("Time to fix: %.01f s", time_to_fix);
	if (time_blocked > 0) {
		LOG_INF("Time GNSS was blocked by LTE: %u s", time_blocked);
	}
	print_distance_from_reference(&last_pvt);
	LOG_INF("Sleeping for %u s", CONFIG_GNSS_SAMPLE_MODE_TTFF_TEST_INTERVAL);
}

static int ttff_test_force_cold_start(void)
{
	int err;
	uint32_t delete_mask;

	LOG_INF("Deleting GNSS data");

	/* Delete everything else except the TCXO offset. */
	delete_mask = NRF_MODEM_GNSS_DELETE_EPHEMERIDES |
		      NRF_MODEM_GNSS_DELETE_ALMANACS |
		      NRF_MODEM_GNSS_DELETE_IONO_CORRECTION_DATA |
		      NRF_MODEM_GNSS_DELETE_LAST_GOOD_FIX |
		      NRF_MODEM_GNSS_DELETE_GPS_TOW |
		      NRF_MODEM_GNSS_DELETE_GPS_WEEK |
		      NRF_MODEM_GNSS_DELETE_UTC_DATA |
		      NRF_MODEM_GNSS_DELETE_GPS_TOW_PRECISION;

	/* With minimal assistance, we want to keep the factory almanac. */
	if (IS_ENABLED(CONFIG_GNSS_SAMPLE_ASSISTANCE_MINIMAL)) {
		delete_mask &= ~NRF_MODEM_GNSS_DELETE_ALMANACS;
	}

	err = nrf_modem_gnss_nv_data_delete(delete_mask);
	if (err) {
		LOG_ERR("Failed to delete GNSS data");
		return -1;
	}

	return 0;
}

#if defined(CONFIG_GNSS_SAMPLE_ASSISTANCE_NRF_CLOUD)
static bool qzss_assistance_is_supported(void)
{
	char resp[32];

	if (nrf_modem_at_cmd(resp, sizeof(resp), "AT+CGMM") == 0) {
		/* nRF9160 does not support QZSS assistance, while nRF91x1 do. */
		if (strstr(resp, "nRF9160") != NULL) {
			return false;
		}
	}

	return true;
}
#endif /* CONFIG_GNSS_SAMPLE_ASSISTANCE_NRF_CLOUD */

static void ttff_test_prepare_work_fn(struct k_work *item)
{
	/* Make sure GNSS is stopped before next start. */
	nrf_modem_gnss_stop();

	if (IS_ENABLED(CONFIG_GNSS_SAMPLE_MODE_TTFF_TEST_COLD_START)) {
		if (ttff_test_force_cold_start() != 0) {
			return;
		}
	}

#if !defined(CONFIG_GNSS_SAMPLE_ASSISTANCE_NONE)
	if (IS_ENABLED(CONFIG_GNSS_SAMPLE_MODE_TTFF_TEST_COLD_START)) {
		/* All A-GNSS data is always requested before GNSS is started. */
		last_agnss.data_flags =
			NRF_MODEM_GNSS_AGNSS_GPS_UTC_REQUEST |
			NRF_MODEM_GNSS_AGNSS_KLOBUCHAR_REQUEST |
			NRF_MODEM_GNSS_AGNSS_NEQUICK_REQUEST |
			NRF_MODEM_GNSS_AGNSS_GPS_SYS_TIME_AND_SV_TOW_REQUEST |
			NRF_MODEM_GNSS_AGNSS_POSITION_REQUEST |
			NRF_MODEM_GNSS_AGNSS_INTEGRITY_REQUEST;
		last_agnss.system_count = 1;
		last_agnss.system[0].system_id = NRF_MODEM_GNSS_SYSTEM_GPS;
		last_agnss.system[0].sv_mask_ephe = 0xffffffff;
		last_agnss.system[0].sv_mask_alm = 0xffffffff;
#if defined(CONFIG_GNSS_SAMPLE_ASSISTANCE_NRF_CLOUD)
		if (qzss_assistance_is_supported()) {
			last_agnss.system_count = 2;
			last_agnss.system[0].system_id = NRF_MODEM_GNSS_SYSTEM_QZSS;
			last_agnss.system[1].sv_mask_ephe = 0x3ff;
			last_agnss.system[1].sv_mask_alm = 0x3ff;
		}
#endif /* CONFIG_GNSS_SAMPLE_ASSISTANCE_NRF_CLOUD */

		k_work_submit_to_queue(&gnss_work_q, &agnss_data_get_work);
	} else {
		/* Start and stop GNSS to trigger possible A-GNSS data request. If new A-GNSS
		 * data is needed it is fetched before GNSS is started.
		 */
		nrf_modem_gnss_start();
		nrf_modem_gnss_stop();
	}
#endif /* !CONFIG_GNSS_SAMPLE_ASSISTANCE_NONE */

	k_work_submit_to_queue(&gnss_work_q, &ttff_test_start_work);
}

static void ttff_test_start_work_fn(struct k_work *item)
{
	LOG_INF("Starting GNSS");
	if (nrf_modem_gnss_start() != 0) {
		LOG_ERR("Failed to start GNSS");
		return;
	}

	fix_timestamp = k_uptime_get();
	time_blocked = 0;
}
#endif /* CONFIG_GNSS_SAMPLE_MODE_TTFF_TEST */

static void date_time_evt_handler(const struct date_time_evt *evt)
{
	k_sem_give(&time_sem);
}

static int modem_init(void)
{
	if (IS_ENABLED(CONFIG_DATE_TIME)) {
		date_time_register_handler(date_time_evt_handler);
	}

#if defined(CONFIG_GNSS_SAMPLE_LTE_ON_DEMAND)
	lte_lc_register_handler(lte_lc_event_handler);
#elif !defined(CONFIG_GNSS_SAMPLE_ASSISTANCE_NONE)
	LOG_INF("Connecting to LTE network");

	if (lte_lc_connect() != 0) {
		LOG_ERR("Failed to connect to LTE network");
		return -1;
	}

	LOG_INF("Connected to LTE network");

	if (IS_ENABLED(CONFIG_DATE_TIME)) {
		LOG_INF("Waiting for current time");

		/* Wait for an event from the Date Time library. */
		k_sem_take(&time_sem, K_MINUTES(10));

		if (!date_time_is_valid()) {
			LOG_WRN("Failed to get current time, continuing anyway");
		}
	}
#endif

	return 0;
}

static int sample_init(void)
{
	int err = 0;

#if !defined(CONFIG_GNSS_SAMPLE_ASSISTANCE_NONE) || defined(CONFIG_GNSS_SAMPLE_MODE_TTFF_TEST)
	struct k_work_queue_config cfg = {
		.name = "gnss_work_q",
		.no_yield = false
	};

	k_work_queue_start(
		&gnss_work_q,
		gnss_workq_stack_area,
		K_THREAD_STACK_SIZEOF(gnss_workq_stack_area),
		GNSS_WORKQ_THREAD_PRIORITY,
		&cfg);
#endif /* !CONFIG_GNSS_SAMPLE_ASSISTANCE_NONE || CONFIG_GNSS_SAMPLE_MODE_TTFF_TEST */

#if !defined(CONFIG_GNSS_SAMPLE_ASSISTANCE_NONE)
	k_work_init(&agnss_data_get_work, agnss_data_get_work_fn);

	err = assistance_init(&gnss_work_q);
#endif /* !CONFIG_GNSS_SAMPLE_ASSISTANCE_NONE */

#if defined(CONFIG_GNSS_SAMPLE_MODE_TTFF_TEST)
	k_work_init_delayable(&ttff_test_got_fix_work, ttff_test_got_fix_work_fn);
	k_work_init_delayable(&ttff_test_prepare_work, ttff_test_prepare_work_fn);
	k_work_init(&ttff_test_start_work, ttff_test_start_work_fn);
#endif /* CONFIG_GNSS_SAMPLE_MODE_TTFF_TEST */

	return err;
}

static int gnss_init_and_start(void)
{
#if defined(CONFIG_GNSS_SAMPLE_ASSISTANCE_NONE) || defined(CONFIG_GNSS_SAMPLE_LTE_ON_DEMAND)
	/* Enable GNSS. */
	if (lte_lc_func_mode_set(LTE_LC_FUNC_MODE_ACTIVATE_GNSS) != 0) {
		LOG_ERR("Failed to activate GNSS functional mode");
		return -1;
	}
#endif /* CONFIG_GNSS_SAMPLE_ASSISTANCE_NONE || CONFIG_GNSS_SAMPLE_LTE_ON_DEMAND */

	/* Configure GNSS. */
	if (nrf_modem_gnss_event_handler_set(gnss_event_handler) != 0) {
		LOG_ERR("Failed to set GNSS event handler");
		return -1;
	}

	/* Enable all supported NMEA messages. */
	uint16_t nmea_mask = NRF_MODEM_GNSS_NMEA_RMC_MASK |
			     NRF_MODEM_GNSS_NMEA_GGA_MASK |
			     NRF_MODEM_GNSS_NMEA_GLL_MASK |
			     NRF_MODEM_GNSS_NMEA_GSA_MASK |
			     NRF_MODEM_GNSS_NMEA_GSV_MASK;

	if (nrf_modem_gnss_nmea_mask_set(nmea_mask) != 0) {
		LOG_ERR("Failed to set GNSS NMEA mask");
		return -1;
	}

	/* Make QZSS satellites visible in the NMEA output. */
	if (nrf_modem_gnss_qzss_nmea_mode_set(NRF_MODEM_GNSS_QZSS_NMEA_MODE_CUSTOM) != 0) {
		LOG_WRN("Failed to enable custom QZSS NMEA mode");
	}

	/* This use case flag should always be set. */
	uint8_t use_case = NRF_MODEM_GNSS_USE_CASE_MULTIPLE_HOT_START;

	if (IS_ENABLED(CONFIG_GNSS_SAMPLE_MODE_PERIODIC) &&
	    !IS_ENABLED(CONFIG_GNSS_SAMPLE_ASSISTANCE_NONE)) {
		/* Disable GNSS scheduled downloads when assistance is used. */
		use_case |= NRF_MODEM_GNSS_USE_CASE_SCHED_DOWNLOAD_DISABLE;
	}

	if (IS_ENABLED(CONFIG_GNSS_SAMPLE_LOW_ACCURACY)) {
		use_case |= NRF_MODEM_GNSS_USE_CASE_LOW_ACCURACY;
	}

	if (nrf_modem_gnss_use_case_set(use_case) != 0) {
		LOG_WRN("Failed to set GNSS use case");
	}

#if defined(CONFIG_NRF_CLOUD_AGNSS_ELEVATION_MASK)
	if (nrf_modem_gnss_elevation_threshold_set(CONFIG_NRF_CLOUD_AGNSS_ELEVATION_MASK) != 0) {
		LOG_ERR("Failed to set elevation threshold");
		return -1;
	}
	LOG_DBG("Set elevation threshold to %u", CONFIG_NRF_CLOUD_AGNSS_ELEVATION_MASK);
#endif

#if defined(CONFIG_GNSS_SAMPLE_MODE_CONTINUOUS)
	/* Default to no power saving. */
	uint8_t power_mode = NRF_MODEM_GNSS_PSM_DISABLED;

#if defined(CONFIG_GNSS_SAMPLE_POWER_SAVING_MODERATE)
	power_mode = NRF_MODEM_GNSS_PSM_DUTY_CYCLING_PERFORMANCE;
#elif defined(CONFIG_GNSS_SAMPLE_POWER_SAVING_HIGH)
	power_mode = NRF_MODEM_GNSS_PSM_DUTY_CYCLING_POWER;
#endif

	if (nrf_modem_gnss_power_mode_set(power_mode) != 0) {
		LOG_ERR("Failed to set GNSS power saving mode");
		return -1;
	}
#endif /* CONFIG_GNSS_SAMPLE_MODE_CONTINUOUS */

	/* Default to continuous tracking. */
	uint16_t fix_retry = 0;
	uint16_t fix_interval = 1;

#if defined(CONFIG_GNSS_SAMPLE_MODE_PERIODIC)
	fix_retry = CONFIG_GNSS_SAMPLE_PERIODIC_TIMEOUT;
	fix_interval = CONFIG_GNSS_SAMPLE_PERIODIC_INTERVAL;
#elif defined(CONFIG_GNSS_SAMPLE_MODE_TTFF_TEST)
	/* Single fix for TTFF test mode. */
	fix_retry = 0;
	fix_interval = 0;
#endif

	if (nrf_modem_gnss_fix_retry_set(fix_retry) != 0) {
		LOG_ERR("Failed to set GNSS fix retry");
		return -1;
	}

	if (nrf_modem_gnss_fix_interval_set(fix_interval) != 0) {
		LOG_ERR("Failed to set GNSS fix interval");
		return -1;
	}

#if defined(CONFIG_GNSS_SAMPLE_MODE_TTFF_TEST)
	k_work_schedule_for_queue(&gnss_work_q, &ttff_test_prepare_work, K_NO_WAIT);
#else /* !CONFIG_GNSS_SAMPLE_MODE_TTFF_TEST */
	if (nrf_modem_gnss_start() != 0) {
		LOG_ERR("Failed to start GNSS");
		return -1;
	}
#endif

	return 0;
}

static bool output_paused(void)
{
#if defined(CONFIG_GNSS_SAMPLE_ASSISTANCE_NONE) || defined(CONFIG_GNSS_SAMPLE_LOG_LEVEL_OFF)
	return false;
#else
	return (requesting_assistance || assistance_is_active()) ? true : false;
#endif
}

static void print_satellite_stats(struct nrf_modem_gnss_pvt_data_frame *pvt_data)
{
	uint8_t tracked   = 0;
	uint8_t in_fix    = 0;
	uint8_t unhealthy = 0;

	for (int i = 0; i < NRF_MODEM_GNSS_MAX_SATELLITES; ++i) {
		if (pvt_data->sv[i].sv > 0) {
			tracked++;

			if (pvt_data->sv[i].flags & NRF_MODEM_GNSS_SV_FLAG_USED_IN_FIX) {
				in_fix++;
			}

			if (pvt_data->sv[i].flags & NRF_MODEM_GNSS_SV_FLAG_UNHEALTHY) {
				unhealthy++;
			}
		}
	}

	LOG_INF("GPS status: %s | Tracking: %u Using: %u Unhealthy: %u Flags: 0x%02x",
		(pvt_data->flags & NRF_MODEM_GNSS_PVT_FLAG_FIX_VALID) ? "FIX_VALID" : "SEARCHING",
		tracked, in_fix, unhealthy, pvt_data->flags);
}

static void print_flags(struct nrf_modem_gnss_pvt_data_frame *pvt_data)
{
	if (pvt_data->flags & NRF_MODEM_GNSS_PVT_FLAG_DEADLINE_MISSED) {
		LOG_WRN("GPS status: BLOCKED_BY_LTE");
	}
	if (pvt_data->flags & NRF_MODEM_GNSS_PVT_FLAG_NOT_ENOUGH_WINDOW_TIME) {
		LOG_WRN("GPS status: INSUFFICIENT_RADIO_WINDOW");
	}
	if (pvt_data->flags & NRF_MODEM_GNSS_PVT_FLAG_SLEEP_BETWEEN_PVT) {
		LOG_INF("GPS status: SLEEP_BETWEEN_PVT");
	}
	if (pvt_data->flags & NRF_MODEM_GNSS_PVT_FLAG_SCHED_DOWNLOAD) {
		LOG_INF("GPS status: SCHEDULED_DOWNLOAD");
	}
}

static void print_fix_data(struct nrf_modem_gnss_pvt_data_frame *pvt_data)
{
	LOG_INF("GPS fix: lat=%.06f lon=%.06f accuracy=%.01f m",
		pvt_data->latitude, pvt_data->longitude, (double)pvt_data->accuracy);
	printf("Latitude:          %.06f\n", pvt_data->latitude);
	printf("Longitude:         %.06f\n", pvt_data->longitude);
	printf("Accuracy:          %.01f m\n", (double)pvt_data->accuracy);
	printf("Altitude:          %.01f m\n", (double)pvt_data->altitude);
	printf("Altitude accuracy: %.01f m\n", (double)pvt_data->altitude_accuracy);
	printf("Speed:             %.01f m/s\n", (double)pvt_data->speed);
	printf("Speed accuracy:    %.01f m/s\n", (double)pvt_data->speed_accuracy);
	printf("V. speed:          %.01f m/s\n", (double)pvt_data->vertical_speed);
	printf("V. speed accuracy: %.01f m/s\n", (double)pvt_data->vertical_speed_accuracy);
	printf("Heading:           %.01f deg\n", (double)pvt_data->heading);
	printf("Heading accuracy:  %.01f deg\n", (double)pvt_data->heading_accuracy);
	printf("Date:              %04u-%02u-%02u\n",
	       pvt_data->datetime.year,
	       pvt_data->datetime.month,
	       pvt_data->datetime.day);
	printf("Time (UTC):        %02u:%02u:%02u.%03u\n",
	       pvt_data->datetime.hour,
	       pvt_data->datetime.minute,
	       pvt_data->datetime.seconds,
	       pvt_data->datetime.ms);
	printf("PDOP:              %.01f\n", (double)pvt_data->pdop);
	printf("HDOP:              %.01f\n", (double)pvt_data->hdop);
	printf("VDOP:              %.01f\n", (double)pvt_data->vdop);
	printf("TDOP:              %.01f\n", (double)pvt_data->tdop);
}

int main(void)
{
	int err;
	uint8_t cnt = 0;
	struct nrf_modem_gnss_nmea_data_frame *nmea_data;

	LOG_INF("Starting gps_mqtt_tracker_temp: NCS GNSS sample baseline");
	LOG_INF("Continuous GNSS, normal accuracy, no assistance; PVT/NMEA over RTT");

	err = nrf_modem_lib_init();
	if (err) {
		LOG_ERR("Modem library initialization failed, error: %d", err);
		return err;
	}

	/* Initialize reference coordinates (if used). */
	if (sizeof(CONFIG_GNSS_SAMPLE_REFERENCE_LATITUDE) > 1 &&
	    sizeof(CONFIG_GNSS_SAMPLE_REFERENCE_LONGITUDE) > 1) {
		ref_used = true;
		ref_latitude = atof(CONFIG_GNSS_SAMPLE_REFERENCE_LATITUDE);
		ref_longitude = atof(CONFIG_GNSS_SAMPLE_REFERENCE_LONGITUDE);
	}

	if (modem_init() != 0) {
		LOG_ERR("Failed to initialize modem");
		return -1;
	}

	if (sample_init() != 0) {
		LOG_ERR("Failed to initialize sample");
		return -1;
	}

	if (gnss_init_and_start() != 0) {
		LOG_ERR("Failed to initialize and start GNSS");
		return -1;
	}

	fix_timestamp = k_uptime_get();
	LOG_INF("GPS status: SEARCHING | GNSS started; waiting for PVT");

	for (;;) {
		(void)k_poll(events, 2, K_FOREVER);

		if (events[0].state == K_POLL_STATE_SEM_AVAILABLE &&
		    k_sem_take(events[0].sem, K_NO_WAIT) == 0) {
			/* New PVT data available */

			if (IS_ENABLED(CONFIG_GNSS_SAMPLE_MODE_TTFF_TEST)) {
				/* TTFF test mode. */

				/* Calculate the time GNSS has been blocked by LTE. */
				if (last_pvt.flags & NRF_MODEM_GNSS_PVT_FLAG_DEADLINE_MISSED) {
					time_blocked++;
				}
			} else if (IS_ENABLED(CONFIG_GNSS_SAMPLE_NMEA_ONLY)) {
				/* NMEA-only output mode. */

				if (output_paused()) {
					goto handle_nmea;
				}

				if (last_pvt.flags & NRF_MODEM_GNSS_PVT_FLAG_FIX_VALID) {
					print_distance_from_reference(&last_pvt);
				}
			} else {
				/* PVT and NMEA output mode. */

				if (output_paused()) {
					goto handle_nmea;
				}

				print_satellite_stats(&last_pvt);
				print_flags(&last_pvt);
				printf("-----------------------------------\n");

				if (last_pvt.flags & NRF_MODEM_GNSS_PVT_FLAG_FIX_VALID) {
					fix_timestamp = k_uptime_get();
					print_fix_data(&last_pvt);
					print_distance_from_reference(&last_pvt);
				} else {
					printf("Seconds since last fix: %d\n",
					       (uint32_t)((k_uptime_get() - fix_timestamp) / 1000));
					cnt++;
					printf("Searching [%c]\n", update_indicator[cnt%4]);
				}

				printf("\nNMEA strings:\n\n");
			}
		}

handle_nmea:
		if (events[1].state == K_POLL_STATE_MSGQ_DATA_AVAILABLE &&
		    k_msgq_get(events[1].msgq, &nmea_data, K_NO_WAIT) == 0) {
			/* New NMEA data available */

			if (!output_paused()) {
				printf("%s", nmea_data->nmea_str);
			}
			k_free(nmea_data);
		}

		events[0].state = K_POLL_STATE_NOT_READY;
		events[1].state = K_POLL_STATE_NOT_READY;
	}

	return 0;
}
```

## src/circuitdojo_gnss.c
```c
/*
 * Copyright (c) 2021 Circuit Dojo LLC
 * Copyright (c) 2026 GPS MQTT tracker contributors
 *
 * SPDX-License-Identifier: Apache-2.0
 */

#include <errno.h>

#include <zephyr/device.h>
#include <zephyr/drivers/gpio.h>
#include <zephyr/init.h>
#include <zephyr/kernel.h>
#include <zephyr/logging/log.h>

LOG_MODULE_REGISTER(gnss_board_setup, LOG_LEVEL_INF);

#if defined(CONFIG_GNSS_HEARTBEAT_LED)
static const struct gpio_dt_spec heartbeat_led =
	GPIO_DT_SPEC_GET(DT_ALIAS(led0), gpios);
static struct k_work_delayable heartbeat_work;

static void heartbeat_handler(struct k_work *work)
{
	int err;

	ARG_UNUSED(work);
	err = gpio_pin_toggle_dt(&heartbeat_led);
	if (err != 0) {
		LOG_ERR("Failed to toggle heartbeat LED: %d", err);
		return;
	}
	err = k_work_reschedule(&heartbeat_work,
		K_MSEC(CONFIG_GNSS_HEARTBEAT_INTERVAL_MS));
	if (err < 0) {
		LOG_ERR("Failed to reschedule heartbeat LED: %d", err);
	}
}
#endif

static int circuit_dojo_gnss_setup(void)
{
	const struct device *gpio = DEVICE_DT_GET(DT_NODELABEL(gpio0));
	int err;

	if (!device_is_ready(gpio)) {
		return -ENODEV;
	}

	err = gpio_pin_configure(gpio, CONFIG_TRACKER_GNSS_POWER_MODE_PIN,
				  GPIO_OUTPUT_LOW);
	if (err != 0) {
		return err;
	}

#if defined(CONFIG_GNSS_HEARTBEAT_LED)
	if (!gpio_is_ready_dt(&heartbeat_led)) {
		return -ENODEV;
	}
	err = gpio_pin_configure_dt(&heartbeat_led, GPIO_OUTPUT_INACTIVE);
	if (err != 0) {
		return err;
	}
	k_work_init_delayable(&heartbeat_work, heartbeat_handler);
	err = k_work_schedule(&heartbeat_work,
		K_MSEC(CONFIG_GNSS_HEARTBEAT_INTERVAL_MS));
	if (err < 0) {
		return err;
	}
	LOG_INF("Heartbeat LED enabled: %d ms on/off",
		CONFIG_GNSS_HEARTBEAT_INTERVAL_MS);
#endif
	return 0;
}

SYS_INIT(circuit_dojo_gnss_setup, APPLICATION, CONFIG_APPLICATION_INIT_PRIORITY);
```

## src/tracker_gnss.c
```c
/*
 * Copyright (c) 2024 Nordic Semiconductor ASA
 * SPDX-License-Identifier: LicenseRef-Nordic-5-Clause
 */

#include <errno.h>
#include <zephyr/kernel.h>
#include <zephyr/logging/log.h>
#include <nrf_modem_gnss.h>

#include "tracker_gnss.h"
#include "tracker_status.h"

LOG_MODULE_REGISTER(tracker_gnss, LOG_LEVEL_INF);

K_MSGQ_DEFINE(gnss_pvt_queue, sizeof(struct nrf_modem_gnss_pvt_data_frame), 2, 4);
#if defined(CONFIG_TRACKER_GNSS_DIAGNOSTICS)
K_MSGQ_DEFINE(gnss_nmea_queue, sizeof(struct nrf_modem_gnss_nmea_data_frame), 20, 4);

static void print_satellite_stats(const struct nrf_modem_gnss_pvt_data_frame *pvt)
{
	uint8_t tracked = 0;
	uint8_t in_fix = 0;
	uint8_t unhealthy = 0;

	for (int i = 0; i < NRF_MODEM_GNSS_MAX_SATELLITES; i++) {
		if (pvt->sv[i].sv == 0) {
			continue;
		}

		tracked++;
		if ((pvt->sv[i].flags & NRF_MODEM_GNSS_SV_FLAG_USED_IN_FIX) != 0) {
			in_fix++;
		}
		if ((pvt->sv[i].flags & NRF_MODEM_GNSS_SV_FLAG_UNHEALTHY) != 0) {
			unhealthy++;
		}
	}

	LOG_RAW("Tracking: %2d Using: %2d Unhealthy: %d\n", tracked, in_fix, unhealthy);
}

static void print_gnss_flags(const struct nrf_modem_gnss_pvt_data_frame *pvt)
{
	if ((pvt->flags & NRF_MODEM_GNSS_PVT_FLAG_DEADLINE_MISSED) != 0) {
		LOG_RAW("GNSS operation blocked by LTE\n");
	}
	if ((pvt->flags & NRF_MODEM_GNSS_PVT_FLAG_NOT_ENOUGH_WINDOW_TIME) != 0) {
		LOG_RAW("Insufficient GNSS time windows\n");
	}
	if ((pvt->flags & NRF_MODEM_GNSS_PVT_FLAG_SLEEP_BETWEEN_PVT) != 0) {
		LOG_RAW("Sleep period(s) between PVT notifications\n");
	}
	if ((pvt->flags & NRF_MODEM_GNSS_PVT_FLAG_SCHED_DOWNLOAD) != 0) {
		LOG_RAW("Scheduled navigation data download\n");
	}
}

static void print_fix_data(const struct nrf_modem_gnss_pvt_data_frame *pvt)
{
	LOG_RAW("Latitude:          %.06f\n", pvt->latitude);
	LOG_RAW("Longitude:         %.06f\n", pvt->longitude);
	LOG_RAW("Accuracy:          %.01f m\n", (double)pvt->accuracy);
	LOG_RAW("Altitude:          %.01f m\n", (double)pvt->altitude);
	LOG_RAW("Altitude accuracy: %.01f m\n", (double)pvt->altitude_accuracy);
	LOG_RAW("Speed:             %.01f m/s\n", (double)pvt->speed);
	LOG_RAW("Speed accuracy:    %.01f m/s\n", (double)pvt->speed_accuracy);
	LOG_RAW("V. speed:          %.01f m/s\n", (double)pvt->vertical_speed);
	LOG_RAW("V. speed accuracy: %.01f m/s\n", (double)pvt->vertical_speed_accuracy);
	LOG_RAW("Heading:           %.01f deg\n", (double)pvt->heading);
	LOG_RAW("Heading accuracy:  %.01f deg\n", (double)pvt->heading_accuracy);
	LOG_RAW("Date:              %04u-%02u-%02u\n", pvt->datetime.year,
		pvt->datetime.month, pvt->datetime.day);
	LOG_RAW("Time (UTC):        %02u:%02u:%02u.%03u\n", pvt->datetime.hour,
		pvt->datetime.minute, pvt->datetime.seconds, pvt->datetime.ms);
	LOG_RAW("PDOP:              %.01f\n", (double)pvt->pdop);
	LOG_RAW("HDOP:              %.01f\n", (double)pvt->hdop);
	LOG_RAW("VDOP:              %.01f\n", (double)pvt->vdop);
	LOG_RAW("TDOP:              %.01f\n", (double)pvt->tdop);
}

static void print_gnss_status(const struct nrf_modem_gnss_pvt_data_frame *pvt)
{
	static const char update_indicator[] = {'\\', '|', '/', '-'};
	static int64_t fix_timestamp;
	static uint8_t indicator_count;
	struct nrf_modem_gnss_nmea_data_frame nmea;

	if (fix_timestamp == 0) {
		fix_timestamp = k_uptime_get();
	}

	LOG_RAW("\033[1;1H");
	LOG_RAW("\033[2J");
	print_satellite_stats(pvt);
	print_gnss_flags(pvt);
	LOG_RAW("-----------------------------------\n");

	if ((pvt->flags & NRF_MODEM_GNSS_PVT_FLAG_FIX_VALID) != 0) {
		fix_timestamp = k_uptime_get();
		print_fix_data(pvt);
	} else {
		LOG_RAW("Seconds since last fix: %u\n",
			(uint32_t)((k_uptime_get() - fix_timestamp) / 1000));
		indicator_count++;
		LOG_RAW("Searching [%c]\n", update_indicator[indicator_count % 4]);
	}

	LOG_RAW("\nNMEA strings:\n\n");
	while (k_msgq_get(&gnss_nmea_queue, &nmea, K_NO_WAIT) == 0) {
		LOG_RAW("%s", nmea.nmea_str);
	}
}
#endif

static void gnss_event_handler(int event)
{
	struct nrf_modem_gnss_pvt_data_frame pvt;
	int err;

	switch (event) {
	case NRF_MODEM_GNSS_EVT_PVT:
		err = nrf_modem_gnss_read(&pvt, sizeof(pvt), NRF_MODEM_GNSS_DATA_PVT);
		if (err != 0) {
			LOG_ERR("Failed to read GNSS PVT data: %d", err);
			break;
		}

		err = k_msgq_put(&gnss_pvt_queue, &pvt, K_NO_WAIT);
		if (err != 0) {
			LOG_WRN("GNSS PVT queue full; dropping one status frame");
		}
		break;

	case NRF_MODEM_GNSS_EVT_FIX:
		tracker_status_set("GNSS FIX EVENT");
		LOG_INF("GNSS fix event detected");
		break;

#if defined(CONFIG_TRACKER_GNSS_DIAGNOSTICS)
	case NRF_MODEM_GNSS_EVT_NMEA: {
		struct nrf_modem_gnss_nmea_data_frame nmea;

		err = nrf_modem_gnss_read(&nmea, sizeof(nmea), NRF_MODEM_GNSS_DATA_NMEA);
		if (err != 0) {
			LOG_ERR("Failed to read GNSS NMEA data: %d", err);
			break;
		}

		if (k_msgq_put(&gnss_nmea_queue, &nmea, K_NO_WAIT) != 0) {
			LOG_DBG("GNSS NMEA queue full; dropping one sentence");
		}
		break;
	}
#endif

	case NRF_MODEM_GNSS_EVT_PERIODIC_WAKEUP:
		tracker_status_set("GNSS PERIODIC WAKEUP");
		LOG_INF("GNSS woke up for periodic fix cycle");
		break;
	case NRF_MODEM_GNSS_EVT_BLOCKED:
		tracker_status_set("GNSS BLOCKED");
		LOG_WRN("GNSS blocked by LTE activity");
		break;
	case NRF_MODEM_GNSS_EVT_UNBLOCKED:
		tracker_status_set("GNSS UNBLOCKED");
		LOG_INF("GNSS unblocked; radio time is available again");
		break;
	case NRF_MODEM_GNSS_EVT_SLEEP_AFTER_FIX:
		tracker_status_set("GNSS SLEEP AFTER FIX");
		LOG_INF("GNSS sleeping after a valid fix");
		break;
	case NRF_MODEM_GNSS_EVT_SLEEP_AFTER_TIMEOUT:
		tracker_status_set("GNSS SLEEP AFTER TIMEOUT");
		LOG_WRN("GNSS fix timeout reached without valid fix");
		break;
	case NRF_MODEM_GNSS_EVT_REF_ALT_EXPIRED:
		tracker_status_set("GNSS REFERENCE ALTITUDE EXPIRED");
		LOG_WRN("GNSS reference altitude expired");
		break;
	default:
		tracker_status_set("GNSS EVENT UNHANDLED");
		LOG_INF("Unhandled GNSS event: %d", event);
		break;
	}
}

int tracker_gnss_start(void)
{
	uint16_t nmea_mask = 0;
	uint8_t use_case = NRF_MODEM_GNSS_USE_CASE_MULTIPLE_HOT_START;
	int err;

	tracker_status_set("GNSS INIT");

#if defined(CONFIG_TRACKER_GNSS_DIAGNOSTICS)
	nmea_mask = NRF_MODEM_GNSS_NMEA_RMC_MASK |
		NRF_MODEM_GNSS_NMEA_GGA_MASK | NRF_MODEM_GNSS_NMEA_GLL_MASK |
		NRF_MODEM_GNSS_NMEA_GSA_MASK | NRF_MODEM_GNSS_NMEA_GSV_MASK;
#endif

#if defined(CONFIG_GNSS_HIGH_ACCURACY_TIMING_SOURCE)
	tracker_status_set("GNSS TIMING SOURCE CONFIG");
	err = nrf_modem_gnss_timing_source_set(NRF_MODEM_GNSS_TIMING_SOURCE_TCXO);
	if (err != 0) {
		LOG_ERR("Failed to set TCXO timing source: %d", err);
		return err;
	}
#endif

#if defined(CONFIG_GNSS_LOW_ACCURACY)
	use_case |= NRF_MODEM_GNSS_USE_CASE_LOW_ACCURACY;
#endif

	tracker_status_set("GNSS USE CASE CONFIG");
	err = nrf_modem_gnss_use_case_set(use_case);
	if (err != 0) {
		LOG_ERR("Failed to set GNSS use case: %d", err);
		return err;
	}

	tracker_status_set("GNSS EVENT HANDLER CONFIG");
	err = nrf_modem_gnss_event_handler_set(gnss_event_handler);
	if (err != 0) {
		LOG_ERR("Failed to set GNSS event handler: %d", err);
		return err;
	}

	tracker_status_set("GNSS NMEA CONFIG");
	err = nrf_modem_gnss_nmea_mask_set(nmea_mask);
	if (err != 0) {
		LOG_ERR("Failed to configure GNSS NMEA output: %d", err);
		return err;
	}

	tracker_status_set("GNSS FIX INTERVAL CONFIG");
	err = nrf_modem_gnss_fix_interval_set(CONFIG_TRACKER_PERIODIC_INTERVAL);
	if (err != 0) {
		LOG_ERR("Failed to set GNSS fix interval: %d", err);
		return err;
	}

	tracker_status_set("GNSS FIX TIMEOUT CONFIG");
	err = nrf_modem_gnss_fix_retry_set(CONFIG_TRACKER_PERIODIC_TIMEOUT);
	if (err != 0) {
		LOG_ERR("Failed to set GNSS fix retry timeout: %d", err);
		return err;
	}

	tracker_status_set("GNSS START");
	err = nrf_modem_gnss_start();
	if (err != 0) {
		LOG_ERR("Failed to start GNSS module: %d", err);
		return err;
	}

	tracker_status_set("GNSS PRIORITY MODE CONFIG");
	err = nrf_modem_gnss_prio_mode_enable();
	if (err != 0) {
		LOG_ERR("Failed to enable GNSS priority mode: %d", err);
		return err;
	}

	LOG_INF("GNSS started (interval: %ds, timeout: %ds)",
		CONFIG_TRACKER_PERIODIC_INTERVAL, CONFIG_TRACKER_PERIODIC_TIMEOUT);
	return 0;
}

int tracker_gnss_wait_for_fix(struct nrf_modem_gnss_pvt_data_frame *pvt)
{
	/*
	 * CONFIG_TRACKER_PERIODIC_TIMEOUT also bounds the modem's own internal
	 * per-attempt search (see nrf_modem_gnss_fix_retry_set() in
	 * tracker_gnss_start()), but that only governs the modem's search
	 * scheduling -- it doesn't make this call return. Without a matching
	 * bound here, this function blocks on k_msgq_get() for as long as it
	 * takes to get a valid fix, however many modem-level retry cycles that
	 * spans (hours or more under poor sky view), and the tracker never
	 * reaches its GNSS-safe low-power state in the meantime.
	 */
	k_timeout_t search_timeout = (CONFIG_TRACKER_PERIODIC_TIMEOUT == 0) ?
		K_FOREVER : K_SECONDS(CONFIG_TRACKER_PERIODIC_TIMEOUT);
	k_timepoint_t deadline;
	int err;

	if (pvt == NULL) {
		return -EINVAL;
	}

	tracker_status_set("GNSS FINDING");
	LOG_INF("Waiting for GNSS fix...");

	/*
	 * Discard any PVT frames queued while nobody was reading (e.g. during
	 * the LTE/MQTT upload that follows the previous fix). Without this,
	 * the first k_msgq_get below can return a fix that is already
	 * minutes stale, triggering an immediate, unnecessary upload cycle.
	 */
	k_msgq_purge(&gnss_pvt_queue);

	/*
	 * A fresh deadline computed once, then re-derived into a remaining
	 * timeout each iteration: bounds the *overall* search, not just each
	 * individual k_msgq_get() call. A per-iteration K_SECONDS(...) would
	 * never fire as long as some (non-fix) PVT frame keeps arriving before
	 * its own timeout expires.
	 */
	deadline = sys_timepoint_calc(search_timeout);

	do {
		err = k_msgq_get(&gnss_pvt_queue, pvt, sys_timepoint_timeout(deadline));
		if (err != 0) {
			tracker_status_set("GNSS FIX TIMEOUT");
			LOG_WRN("No valid GNSS fix within %d s; falling back to low power",
				CONFIG_TRACKER_PERIODIC_TIMEOUT);
			return -ETIMEDOUT;
		}
#if defined(CONFIG_TRACKER_GNSS_DIAGNOSTICS)
		print_gnss_status(pvt);
#endif
	} while ((pvt->flags & NRF_MODEM_GNSS_PVT_FLAG_FIX_VALID) == 0);

	tracker_status_set("GNSS FIX ACQUIRED");

	return 0;
}
```

## src/tracker_modem.c
```c
/*
 * Copyright (c) 2024 Nordic Semiconductor ASA
 * SPDX-License-Identifier: LicenseRef-Nordic-5-Clause
 */

#include <errno.h>
#include <zephyr/kernel.h>
#include <zephyr/logging/log.h>
#include <zephyr/sys/atomic.h>
#include <modem/lte_lc.h>
#include <modem/nrf_modem_lib.h>

#include "tracker_modem.h"
#include "tracker_status.h"

LOG_MODULE_REGISTER(tracker_modem, LOG_LEVEL_INF);

static K_SEM_DEFINE(lte_connected, 0, 1);
static K_SEM_DEFINE(psm_entered, 0, 1);
static atomic_t lte_registered;
static atomic_t psm_granted;
static atomic_t modem_in_psm;

static const char *modem_sleep_status(enum lte_lc_modem_sleep_type type, bool entering)
{
	switch (type) {
	case LTE_LC_MODEM_SLEEP_PSM:
		return entering ? "MODEM SLEEP PSM" : "MODEM WAKE PSM";
	case LTE_LC_MODEM_SLEEP_RF_INACTIVITY:
		return entering ? "MODEM SLEEP RF INACTIVITY" :
			"MODEM WAKE RF INACTIVITY";
	case LTE_LC_MODEM_SLEEP_LIMITED_SERVICE:
		return entering ? "MODEM SLEEP LIMITED SERVICE" :
			"MODEM WAKE LIMITED SERVICE";
	case LTE_LC_MODEM_SLEEP_FLIGHT_MODE:
		return entering ? "MODEM SLEEP FLIGHT MODE" :
			"MODEM WAKE FLIGHT MODE";
	case LTE_LC_MODEM_SLEEP_PROPRIETARY_PSM:
		return entering ? "MODEM SLEEP PROPRIETARY PSM" :
			"MODEM WAKE PROPRIETARY PSM";
	default:
		return entering ? "MODEM SLEEP UNKNOWN" : "MODEM WAKE UNKNOWN";
	}
}

static const char *network_registration_status(enum lte_lc_nw_reg_status status)
{
	switch (status) {
	case LTE_LC_NW_REG_NOT_REGISTERED:
		return "LTE NOT REGISTERED";
	case LTE_LC_NW_REG_REGISTERED_HOME:
		return "LTE REGISTERED HOME";
	case LTE_LC_NW_REG_SEARCHING:
		return "LTE SEARCHING";
	case LTE_LC_NW_REG_REGISTRATION_DENIED:
		return "LTE REGISTRATION DENIED";
	case LTE_LC_NW_REG_UNKNOWN:
		return "LTE REGISTRATION UNKNOWN";
	case LTE_LC_NW_REG_REGISTERED_ROAMING:
		return "LTE REGISTERED ROAMING";
	case LTE_LC_NW_REG_RX_ONLY_NOT_REGISTERED:
		return "LTE RX ONLY NOT REGISTERED";
	case LTE_LC_NW_REG_RX_ONLY_REGISTERED_HOME:
		return "LTE RX ONLY REGISTERED HOME";
	case LTE_LC_NW_REG_RX_ONLY_SEARCHING:
		return "LTE RX ONLY SEARCHING";
	case LTE_LC_NW_REG_RX_ONLY_REGISTRATION_DENIED:
		return "LTE RX ONLY REGISTRATION DENIED";
	case LTE_LC_NW_REG_RX_ONLY_UNKNOWN:
		return "LTE RX ONLY REGISTRATION UNKNOWN";
	case LTE_LC_NW_REG_RX_ONLY_REGISTERED_ROAMING:
		return "LTE RX ONLY REGISTERED ROAMING";
	case LTE_LC_NW_REG_UICC_FAIL:
		return "LTE UICC FAILURE";
	case LTE_LC_NW_REG_NO_SUITABLE_CELL:
		return "LTE NO SUITABLE CELL";
	default:
		return "LTE REGISTRATION OTHER";
	}
}

static const char *modem_event_status(enum lte_lc_modem_evt_type type)
{
	switch (type) {
	case LTE_LC_MODEM_EVT_LIGHT_SEARCH_DONE:
		return "MODEM LIGHT SEARCH DONE";
	case LTE_LC_MODEM_EVT_SEARCH_DONE:
		return "MODEM SEARCH DONE";
	case LTE_LC_MODEM_EVT_RESET_LOOP:
		return "MODEM RESET LOOP";
	case LTE_LC_MODEM_EVT_BATTERY_LOW:
		return "MODEM BATTERY LOW";
	case LTE_LC_MODEM_EVT_OVERHEATED:
		return "MODEM OVERHEATED";
	case LTE_LC_MODEM_EVT_NO_IMEI:
		return "MODEM NO IMEI";
	case LTE_LC_MODEM_EVT_CE_LEVEL:
		return "MODEM CE LEVEL UPDATE";
	case LTE_LC_MODEM_EVT_RF_CAL_NOT_DONE:
		return "MODEM RF CALIBRATION NOT DONE";
	case LTE_LC_MODEM_EVT_INVALID_BAND_CONF:
		return "MODEM INVALID BAND CONFIG";
	case LTE_LC_MODEM_EVT_DETECTED_COUNTRY:
		return "MODEM COUNTRY DETECTED";
	default:
		return "MODEM EVENT OTHER";
	}
}

static void lte_event_handler(const struct lte_lc_evt *const evt)
{
	switch (evt->type) {
	case LTE_LC_EVT_NW_REG_STATUS:
		tracker_status_set(network_registration_status(evt->nw_reg_status));
		if (evt->nw_reg_status == LTE_LC_NW_REG_REGISTERED_HOME ||
		    evt->nw_reg_status == LTE_LC_NW_REG_REGISTERED_ROAMING) {
			atomic_set(&lte_registered, 1);
			LOG_INF("LTE registered (%s)",
				evt->nw_reg_status == LTE_LC_NW_REG_REGISTERED_HOME ?
				"home network" : "roaming");
			k_sem_give(&lte_connected);
		} else {
			atomic_clear(&lte_registered);
		}
		break;
	case LTE_LC_EVT_PSM_UPDATE:
		tracker_status_set((evt->psm_cfg.tau >= 0 && evt->psm_cfg.active_time >= 0) ?
			"MODEM PSM GRANTED" : "MODEM PSM NOT GRANTED");
		LOG_INF("PSM parameters update: TAU=%d s, active time=%d s",
			evt->psm_cfg.tau, evt->psm_cfg.active_time);
		if (evt->psm_cfg.tau >= 0 && evt->psm_cfg.active_time >= 0) {
			atomic_set(&psm_granted, 1);
		} else {
			atomic_clear(&psm_granted);
			LOG_WRN("Network did not grant PSM");
		}
		break;
	case LTE_LC_EVT_RRC_UPDATE:
		tracker_status_set(evt->rrc_mode == LTE_LC_RRC_MODE_CONNECTED ?
			"MODEM RRC CONNECTED" : "MODEM RRC IDLE");
		LOG_INF("RRC mode: %s", evt->rrc_mode == LTE_LC_RRC_MODE_CONNECTED ?
			"connected" : "idle");
		break;
	case LTE_LC_EVT_CELL_UPDATE:
		tracker_status_set(evt->cell.id == LTE_LC_CELL_EUTRAN_ID_INVALID ?
			"MODEM CELL LOST" : "MODEM CELL CONNECTED");
		LOG_INF("LTE cell update: id=%u, TAC=%u", evt->cell.id, evt->cell.tac);
		break;
	case LTE_LC_EVT_LTE_MODE_UPDATE:
		switch (evt->lte_mode) {
		case LTE_LC_LTE_MODE_LTEM:
			tracker_status_set("MODEM LTE M MODE");
			break;
		case LTE_LC_LTE_MODE_NBIOT:
			tracker_status_set("MODEM NB IOT MODE");
			break;
		case LTE_LC_LTE_MODE_NTN_NBIOT:
			tracker_status_set("MODEM NTN NB IOT MODE");
			break;
		default:
			tracker_status_set("MODEM LTE MODE NONE");
			break;
		}
		break;
	case LTE_LC_EVT_MODEM_SLEEP_EXIT_PRE_WARNING:
		tracker_status_set("MODEM SLEEP EXIT PRE WARNING");
		LOG_INF("Modem sleep exit in %lld ms", evt->modem_sleep.time);
		break;
	case LTE_LC_EVT_MODEM_SLEEP_ENTER:
		tracker_status_set(modem_sleep_status(evt->modem_sleep.type, true));
		if (evt->modem_sleep.type == LTE_LC_MODEM_SLEEP_PSM) {
			atomic_set(&modem_in_psm, 1);
			LOG_INF("Modem entered PSM for %lld ms", evt->modem_sleep.time);
			k_sem_give(&psm_entered);
		}
		break;
	case LTE_LC_EVT_MODEM_SLEEP_EXIT:
		tracker_status_set(modem_sleep_status(evt->modem_sleep.type, false));
		if (evt->modem_sleep.type == LTE_LC_MODEM_SLEEP_PSM) {
			atomic_clear(&modem_in_psm);
			LOG_INF("Modem exited PSM");
		}
		break;
	case LTE_LC_EVT_MODEM_EVENT:
		tracker_status_set(modem_event_status(evt->modem_evt.type));
		LOG_INF("LTE modem event: %d", evt->modem_evt.type);
		break;
	default:
		tracker_status_set("MODEM EVENT UNHANDLED");
		LOG_INF("Unhandled LTE event type: %d", evt->type);
		break;
	}
}

int tracker_modem_init(void)
{
	int err;

	tracker_status_set("MODEM LIBRARY INIT");
	LOG_INF("Initializing nRF modem library...");
	err = nrf_modem_lib_init();
	if (err != 0) {
		LOG_ERR("Failed to initialize nRF modem library: %d", err);
		return err;
	}
	tracker_status_set("MODEM LIBRARY READY");

	tracker_status_set("MODEM EVENT HANDLER CONFIG");
	lte_lc_register_handler(lte_event_handler);

	tracker_status_set("MODEM PSM PARAMETER CONFIG");
	err = lte_lc_psm_param_set_seconds(CONFIG_TRACKER_PSM_PERIODIC_TAU_SECONDS,
		CONFIG_TRACKER_PSM_ACTIVE_TIME_SECONDS);
	if (err != 0) {
		LOG_ERR("Failed to configure PSM parameters: %d", err);
		return err;
	}

	tracker_status_set("MODEM PSM REQUEST");
	err = lte_lc_psm_req(true);
	if (err != 0) {
		LOG_WRN("Failed to request PSM: %d", err);
	}

	err = tracker_modem_return_to_gnss();
	if (err != 0) {
		return err;
	}

	tracker_status_set("MODEM GNSS ACTIVATE");
	err = lte_lc_func_mode_set(LTE_LC_FUNC_MODE_ACTIVATE_GNSS);
	if (err != 0) {
		LOG_ERR("Failed to activate GNSS: %d", err);
	}

	if (err == 0) {
		tracker_status_set("MODEM READY");
	}

	return err;
}

int tracker_modem_prepare_upload(k_timeout_t timeout)
{
	int err;

	if (atomic_get(&lte_registered)) {
		tracker_status_set("LTE CONNECTION RETAINED");
		LOG_INF("LTE registration retained; preparing uplink from low-power mode");
		return 0;
	}

	tracker_status_set("LTE CONNECTION");
	LOG_INF("Activating LTE for location upload...");
	k_sem_reset(&lte_connected);
	err = lte_lc_func_mode_set(LTE_LC_FUNC_MODE_NORMAL);
	if (err != 0) {
		LOG_ERR("Failed to activate LTE: %d", err);
		return err;
	}

	err = k_sem_take(&lte_connected, timeout);
	if (err != 0) {
		tracker_status_set("LTE CONNECTION TIMEOUT");
		LOG_ERR("LTE registration timed out");
		return -ETIMEDOUT;
	}

	return 0;
}

int tracker_modem_enter_low_power(k_timeout_t timeout)
{
	int err;

	if (!atomic_get(&lte_registered) || !atomic_get(&psm_granted)) {
		tracker_status_set("GNSS SAFE LOW POWER");
		LOG_WRN("PSM is unavailable; deactivating LTE for the next GNSS cycle");
		return tracker_modem_return_to_gnss();
	}

	k_sem_reset(&psm_entered);
	if (atomic_get(&modem_in_psm)) {
		tracker_status_set("MODEM SLEEP PSM");
		return 0;
	}

	tracker_status_set("MODEM PSM WAIT");
	LOG_INF("Waiting for modem to enter PSM...");
	err = k_sem_take(&psm_entered, timeout);
	if (err == 0 || atomic_get(&modem_in_psm)) {
		return 0;
	}

	LOG_WRN("PSM entry timed out; deactivating LTE for the next GNSS cycle");
	tracker_status_set("MODEM PSM TIMEOUT");
	return tracker_modem_return_to_gnss();
}

int tracker_modem_return_to_gnss(void)
{
	int err;

	tracker_status_set("MODEM LTE DEACTIVATE");
	LOG_INF("Deactivating LTE to return radio control to GNSS...");
	atomic_clear(&lte_registered);
	atomic_clear(&psm_granted);
	atomic_clear(&modem_in_psm);
	err = lte_lc_func_mode_set(LTE_LC_FUNC_MODE_DEACTIVATE_LTE);
	if (err != 0) {
		LOG_ERR("Failed to deactivate LTE: %d", err);
		return err;
	}
	tracker_status_set("MODEM LTE DEACTIVATED");

	return 0;
}
```

## src/tracker_ui.h
```c
/* SPDX-License-Identifier: LicenseRef-Nordic-5-Clause */

#ifndef TRACKER_UI_H_
#define TRACKER_UI_H_

enum tracker_ui_state {
	TRACKER_UI_IDLE,
	TRACKER_UI_GNSS,
	TRACKER_UI_LTE,
	TRACKER_UI_LTE_CONNECTED,
};

int tracker_ui_init(void);
void tracker_ui_set_state(enum tracker_ui_state state);

#endif /* TRACKER_UI_H_ */
```
