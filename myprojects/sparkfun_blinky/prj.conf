## CMakeLists.txt
```
# SPDX-License-Identifier: Apache-2.0

cmake_minimum_required(VERSION 3.20.0)

find_package(Zephyr REQUIRED HINTS $ENV{ZEPHYR_BASE})
project(sparkfun_blinky)

target_sources(app PRIVATE src/main.c)
```

## Kconfig
```
# Copyright (c) 2026
# SPDX-License-Identifier: Apache-2.0

mainmenu "SparkFun nRF9160 Thing Plus Blinky"

source "Kconfig.zephyr"

config BLINK_INTERVAL_MS
	int "LED blink interval in milliseconds"
	range 1 60000
	default 1000
	help
	  Time between changes of the onboard LED state.
```

## sample.yaml
```
sample:
  name: SparkFun nRF9160 Thing Plus Blinky
  description: Blinks the onboard blue LED using the led0 devicetree alias.

common:
  tags:
    - gpio
    - LED
  depends_on: gpio
  filter: dt_compat_enabled_with_alias("gpio-leds", "led0")
  harness: led

tests:
  sample.sparkfun_thing_plus.blinky:
    integration_platforms:
      - sparkfun_thing_plus/nrf9160/ns
    platform_allow:
      - sparkfun_thing_plus/nrf9160/ns
```

## prj.conf
```kconfig
# GPIO drives the onboard blue LED through the board's led0 devicetree alias.
CONFIG_GPIO=y

# Produce an MCUboot-compatible application image for the board's USB DFU flow.
CONFIG_BOOTLOADER_MCUBOOT=y

# Application defaults.
CONFIG_BLINK_INTERVAL_MS=1000

# Report LED state through the USB serial console.
CONFIG_LOG=y
CONFIG_LOG_DEFAULT_LEVEL=3
```

## src/main.c
```c
/*
 * Copyright (c) 2026
 * SPDX-License-Identifier: Apache-2.0
 */

#include <stdbool.h>

#include <zephyr/devicetree.h>
#include <zephyr/drivers/gpio.h>
#include <zephyr/kernel.h>
#include <zephyr/logging/log.h>

LOG_MODULE_REGISTER(sparkfun_blinky, CONFIG_LOG_DEFAULT_LEVEL);

#define LED0_NODE DT_ALIAS(led0)

#if !DT_NODE_HAS_STATUS_OKAY(LED0_NODE)
#error "This application requires a board with an enabled led0 devicetree alias"
#endif

static const struct gpio_dt_spec led = GPIO_DT_SPEC_GET(LED0_NODE, gpios);

int main(void)
{
	bool led_is_on = true;
	int err;

	if (!gpio_is_ready_dt(&led)) {
		LOG_ERR("LED GPIO controller is not ready");
		return 0;
	}

	err = gpio_pin_configure_dt(&led, GPIO_OUTPUT_ACTIVE);
	if (err != 0) {
		LOG_ERR("Failed to configure LED GPIO: %d", err);
		return 0;
	}

	LOG_INF("Blinking the onboard LED every %d ms",
		CONFIG_BLINK_INTERVAL_MS);

	while (true) {
		k_msleep(CONFIG_BLINK_INTERVAL_MS);

		err = gpio_pin_toggle_dt(&led);
		if (err != 0) {
			LOG_ERR("Failed to toggle LED GPIO: %d", err);
			return 0;
		}

		led_is_on = !led_is_on;
		LOG_INF("LED state: %s", led_is_on ? "ON" : "OFF");
	}

	return 0;
}
```
