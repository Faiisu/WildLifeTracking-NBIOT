## CMakeLists.txt
```
#
# Copyright (c) 2024 Nordic Semiconductor ASA
# SPDX-License-Identifier: LicenseRef-Nordic-5-Clause
#

cmake_minimum_required(VERSION 3.20.0)

# Keep default application configuration grouped by subsystem. prj.conf remains
# the standard Zephyr entry point, while these fragments are merged in order
# before any command-line overlay configuration.
set(TRACKER_CONF_FILES
  ${CMAKE_CURRENT_SOURCE_DIR}/config/system.conf
  ${CMAKE_CURRENT_SOURCE_DIR}/config/logging.conf
  ${CMAKE_CURRENT_SOURCE_DIR}/config/hardware.conf
  ${CMAKE_CURRENT_SOURCE_DIR}/config/networking.conf
  ${CMAKE_CURRENT_SOURCE_DIR}/config/modem.conf
  ${CMAKE_CURRENT_SOURCE_DIR}/config/mqtt.conf
  ${CMAKE_CURRENT_SOURCE_DIR}/config/tracker.conf
)

# Load local broker endpoint/credentials overlay when present (ignored by Git).
set(TRACKER_MQTT_CREDENTIALS_FILE
  ${CMAKE_CURRENT_SOURCE_DIR}/config/mqtt-credentials.conf
)
if(EXISTS ${TRACKER_MQTT_CREDENTIALS_FILE})
  list(APPEND TRACKER_CONF_FILES ${TRACKER_MQTT_CREDENTIALS_FILE})
endif()

set(EXTRA_CONF_FILE ${TRACKER_CONF_FILES} ${EXTRA_CONF_FILE})

find_package(Zephyr REQUIRED HINTS $ENV{ZEPHYR_BASE})
project(lte_mqtt_tracker)

# The broker CA is a local deployment asset: provision it into the modem at
# startup, but never add it to Git. See credentials/README.md.
set(TRACKER_CERT_GEN_DIR ${CMAKE_CURRENT_BINARY_DIR}/certs)
zephyr_include_directories(${TRACKER_CERT_GEN_DIR})
if(EXISTS ${CMAKE_CURRENT_SOURCE_DIR}/credentials/ca-cert.pem)
  generate_inc_file_for_target(app credentials/ca-cert.pem
    ${TRACKER_CERT_GEN_DIR}/ca-cert.pem)
endif()

target_sources(app PRIVATE
  src/main.c
  src/tracker_status.c
  src/tracker_backlog.c
  src/tracker_modem.c
  src/tracker_mqtt.c
  src/tracker_ui.c
)
```

## Kconfig
```
#
# Copyright (c) 2024 Nordic Semiconductor ASA
# SPDX-License-Identifier: LicenseRef-Nordic-5-Clause
#

menu "LTE Cell MQTT Asset Tracker Configuration"

config TRACKER_VERSION_MAJOR
	int "Major version number"
	default 1

config TRACKER_VERSION_MINOR
	int "Minor version number"
	default 0

config TRACKER_VERSION_PATCH
	int "Patch version number"
	default 0

config MQTT_BROKER_HOSTNAME
	string "MQTT Broker Hostname"
	default "test.mosquitto.org"
	help
	  Hostname or IP address of the target MQTT broker.

config MQTT_BROKER_PORT
	int "MQTT Broker Port"
	default 1883
	help
	  Port number of the target MQTT broker (1883 for unencrypted, 8883 for TLS).

config MQTT_PUB_TOPIC
	string "MQTT Publish Topic"
	default "nrf91/tracker/cell"
	help
	  MQTT topic to publish LTE serving and neighbor cell measurements.

config MQTT_PUB_QOS
	int "MQTT publish QoS"
	range 0 1
	default 1
	help
	  MQTT delivery level for location publishes: 0 sends at most once and
	  does not wait for a broker acknowledgement; 1 sends at least once and
	  waits for PUBACK. QoS 2 is not supported by this tracker flow.

config MQTT_CLIENT_ID
	string "MQTT Client ID (Leave blank to use IMEI)"
	default ""
	help
	  Custom Client ID for MQTT connection. If left empty, nrf-<IMEI> will be
	  generated automatically from AT+CGSN.

config MQTT_BROKER_USERNAME
	string "MQTT broker username"
	default ""
	help
	  Optional username for MQTT broker authentication. Keep production
	  credentials in the ignored config/mqtt-credentials.conf overlay instead
	  of a tracked configuration file.

config MQTT_BROKER_PASSWORD
	string "MQTT broker password"
	default ""
	help
	  Optional password for MQTT broker authentication. A non-empty password
	  requires CONFIG_MQTT_BROKER_USERNAME to also be non-empty. Keep production
	  credentials in the ignored config/mqtt-credentials.conf overlay.

config TRACKER_PERIODIC_INTERVAL
	int "Periodic LTE Cell Measurement Interval (seconds)"
	range 10 65535
	default 300
	help
	  Sleep interval in seconds between LTE cell measurement and upload cycles.

config TRACKER_CELL_MEAS_TIMEOUT
	int "LTE Neighbor Cell Measurement Timeout (seconds)"
	range 5 300
	default 60
	help
	  Maximum time in seconds to wait for LTE_LC_EVT_NEIGHBOR_CELL_MEAS before
	  cancelling the measurement and falling back to low power.

config TRACKER_MAX_NEIGHBOR_CELLS
	int "Maximum neighbor cells stored per report"
	range 0 16
	default 6
	help
	  Maximum number of neighbor cells retained in each struct tracker_cell_report
	  and included in the published JSON payload.

config TRACKER_PSM_PERIODIC_TAU_SECONDS
	int "Requested PSM periodic TAU (seconds)"
	range 0 1152000
	default 28800
	help
	  Requested interval between periodic tracking area updates while the
	  modem is in Power Saving Mode. The network may grant a different value.

config TRACKER_PSM_ACTIVE_TIME_SECONDS
	int "Requested PSM active time (seconds)"
	range 0 11160
	default 0
	help
	  Requested paging time after LTE activity before entering PSM. Use zero
	  for an uplink-only tracker that does not need to receive downlink data.

config TRACKER_BACKLOG_CAPACITY
	int "Un-sent cell report backlog capacity"
	range 1 200
	default 40
	help
	  Maximum number of LTE cell reports retained in RAM while MQTT connect or
	  publish is failing. Stored in a static array in RAM (lost on reboot).
	  Once full, adaptive stride sampling keeps retained reports evenly spread
	  across the outage.

config STARTUP_LED
	bool "Show tracker states with board LED blink groups"
	default y if BOARD_CIRCUITDOJO_FEATHER_NRF9160_NS
	default y if BOARD_SPARKFUN_THING_PLUS_NRF9160_NS
	depends on GPIO
	help
	  Blink the devicetree led0 LED in groups: two for LTE registration, three
	  for LTE cell measurement, and four during MQTT upload. The LED is off
	  during initialization and low-power sleep.

config WORKING_LED_BLINK_INTERVAL_MS
	int "Status LED pulse interval (milliseconds)"
	range 100 60000
	default 200
	depends on STARTUP_LED
	help
	  On time of each blink and off time between blinks within a group.

config WORKING_LED_GROUP_PAUSE_MS
	int "Status LED pause between groups (milliseconds)"
	range 100 60000
	default 1000
	depends on STARTUP_LED
	help
	  Dark time after the last blink in each group and before a new state.

config ENABLE_LEDS
	bool "Enable status LEDs"
	default n
	select DK_LIBRARY
	help
	  Enable optional DK library status LEDs for LTE, cell scan, and MQTT states.

endmenu

menu "Zephyr Kernel"
source "Kconfig.zephyr"
endmenu
```

## sample.yaml
```
sample:
  description: LTE cell-location nRF9160 tracker that publishes serving and neighbor cells over MQTT
  name: LTE MQTT tracker

common:
  sysbuild: true
  build_only: true
  integration_platforms:
    - sparkfun_thing_plus/nrf9160/ns
  platform_allow:
    - circuitdojo_feather/nrf9160/ns
    - sparkfun_thing_plus/nrf9160/ns

tests:
  app.lte_mqtt_tracker: {}
```

## prj.conf
```kconfig
#
# Copyright (c) 2024 Nordic Semiconductor ASA
# SPDX-License-Identifier: LicenseRef-Nordic-5-Clause
#

# The default configuration is split by subsystem under config/ and loaded by
# CMakeLists.txt through EXTRA_CONF_FILE. Keep this file as the standard Zephyr
# project configuration entry point.
#
# Edit the matching fragment instead of adding unrelated settings here:
#   config/system.conf      C library, stack, and heap
#   config/logging.conf     RTT logging and serial/console policy
#   config/hardware.conf    GPIO and LED behavior
#   config/networking.conf  Zephyr networking and socket offload
#   config/modem.conf       modem, LTE-M/NB-IoT, neighbor cell meas, and PSM
#   config/mqtt.conf        MQTT library and broker destination
#   config/tracker.conf     measurement schedule, timeout, and PSM timing
```

## src/main.c
```c
/*
 * Copyright (c) 2024 Nordic Semiconductor ASA
 * SPDX-License-Identifier: LicenseRef-Nordic-5-Clause
 */

#include <zephyr/kernel.h>
#include <zephyr/logging/log.h>

#include "tracker_backlog.h"
#include "tracker_modem.h"
#include "tracker_mqtt.h"
#include "tracker_status.h"
#include "tracker_ui.h"

LOG_MODULE_REGISTER(lte_mqtt_tracker, LOG_LEVEL_INF);

enum tracker_state {
	TRACKER_STATE_CONNECT_LTE,
	TRACKER_STATE_MEASURE_CELLS,
	TRACKER_STATE_CONNECT_MQTT,
	TRACKER_STATE_PUBLISH_BACKLOG,
	TRACKER_STATE_DISCONNECT_MQTT,
	TRACKER_STATE_WAIT_NEXT_CYCLE,
};

static int tracker_init(void)
{
	int err;

	tracker_status_set("SYSTEM INIT");
	err = tracker_ui_init();
	if (err != 0) {
		LOG_WRN("Tracker UI initialization failed: %d", err);
	}

	LOG_INF("===============================================");
	LOG_INF("LTE Cell MQTT Asset Tracker Application Started");
	LOG_INF("Version: %d.%d.%d", CONFIG_TRACKER_VERSION_MAJOR,
		CONFIG_TRACKER_VERSION_MINOR, CONFIG_TRACKER_VERSION_PATCH);
	LOG_INF("===============================================");

	/* The modem must be initialized before MQTT, AT, or LTE APIs. */
	err = tracker_modem_init();
	if (err != 0) {
		return err;
	}

	return tracker_mqtt_init();
}

int main(void)
{
	enum tracker_state state = TRACKER_STATE_CONNECT_LTE;
	int err;

	err = tracker_init();
	if (err != 0) {
		tracker_status_set("SYSTEM ERROR");
		LOG_ERR("Tracker initialization failed: %d", err);
		return 0;
	}

	while (true) {
		switch (state) {
		case TRACKER_STATE_CONNECT_LTE:
			tracker_ui_set_state(TRACKER_UI_LTE);
			err = tracker_modem_connect(K_FOREVER);
			if (err != 0) {
				LOG_ERR("LTE connect failed: %d; retrying in 2 s", err);
				k_sleep(K_SECONDS(2));
				break;
			}
			state = TRACKER_STATE_MEASURE_CELLS;
			break;

		case TRACKER_STATE_MEASURE_CELLS: {
			struct tracker_cell_report report;

			tracker_ui_set_state(TRACKER_UI_CELL_SCAN);
			err = tracker_modem_measure_cells(&report,
				K_SECONDS(CONFIG_TRACKER_CELL_MEAS_TIMEOUT));
			if (err == 0) {
				tracker_backlog_add(&report);
				state = TRACKER_STATE_CONNECT_MQTT;
			} else {
				LOG_WRN("Cell measurement failed: %d", err);
				state = TRACKER_STATE_WAIT_NEXT_CYCLE;
			}
			break;
		}

		case TRACKER_STATE_CONNECT_MQTT:
			tracker_ui_set_state(TRACKER_UI_MQTT);
			err = tracker_mqtt_connect(K_SECONDS(15));
			state = (err == 0) ? TRACKER_STATE_PUBLISH_BACKLOG :
				TRACKER_STATE_DISCONNECT_MQTT;
			break;

		case TRACKER_STATE_PUBLISH_BACKLOG: {
			struct tracker_cell_report report;
			size_t delivered = 0;

			while (tracker_backlog_peek_oldest(&report)) {
				err = tracker_mqtt_publish_cell_report(&report, K_SECONDS(15));
				if (err != 0) {
					LOG_ERR("Cell report delivery failed: %d", err);
					break;
				}
				tracker_backlog_remove_oldest();
				delivered++;
			}
			if (delivered > 0) {
				LOG_INF("Delivered %zu buffered cell report(s)", delivered);
			}
			state = TRACKER_STATE_DISCONNECT_MQTT;
			break;
		}

		case TRACKER_STATE_DISCONNECT_MQTT:
			err = tracker_mqtt_disconnect(K_SECONDS(10));
			if (err != 0) {
				LOG_WRN("MQTT disconnect did not complete cleanly: %d", err);
			}
			state = TRACKER_STATE_WAIT_NEXT_CYCLE;
			break;

		case TRACKER_STATE_WAIT_NEXT_CYCLE:
			tracker_status_set("CYCLE WAIT");
			tracker_ui_set_state(TRACKER_UI_IDLE);
			LOG_INF("Waiting %d s before next LTE cell measurement",
				CONFIG_TRACKER_PERIODIC_INTERVAL);
			k_sleep(K_SECONDS(CONFIG_TRACKER_PERIODIC_INTERVAL));
			state = TRACKER_STATE_CONNECT_LTE;
			break;
		}
	}

	return 0;
}
```

## src/tracker_backlog.c
```c
/*
 * Copyright (c) 2024 Nordic Semiconductor ASA
 * SPDX-License-Identifier: LicenseRef-Nordic-5-Clause
 */

#include <string.h>
#include <zephyr/kernel.h>
#include <zephyr/logging/log.h>

#include "tracker_backlog.h"
#include "tracker_status.h"

LOG_MODULE_REGISTER(tracker_backlog, LOG_LEVEL_INF);

struct backlog_slot {
	struct tracker_cell_report report;
	uint32_t seq;
};

static struct backlog_slot entries[CONFIG_TRACKER_BACKLOG_CAPACITY];
static size_t count;
static uint32_t next_seq = 1;
static uint32_t stride = 1;

void tracker_backlog_add(const struct tracker_cell_report *report)
{
	uint32_t seq;

	if (count == 0) {
		stride = 1;
	}

	seq = next_seq++;
	if (seq % stride != 0) {
		return;
	}

	if (count == CONFIG_TRACKER_BACKLOG_CAPACITY) {
		size_t write = 0;

		stride *= 2;
		for (size_t i = 0; i < count; i++) {
			if (entries[i].seq % stride == 0) {
				entries[write++] = entries[i];
			}
		}
		count = write;

		if (seq % stride != 0) {
			tracker_status_set("BACKLOG STRIDE DOUBLED");
			LOG_INF("Backlog full; stride now %u", stride);
			return;
		}
	}

	entries[count].report = *report;
	entries[count].seq = seq;
	count++;

	tracker_status_set("BACKLOG REPORT STORED");
	LOG_INF("Buffered cell report (%zu/%d, stride %u)",
		count, CONFIG_TRACKER_BACKLOG_CAPACITY, stride);
}

bool tracker_backlog_peek_oldest(struct tracker_cell_report *out)
{
	if (count == 0) {
		return false;
	}

	*out = entries[0].report;
	return true;
}

void tracker_backlog_remove_oldest(void)
{
	if (count == 0) {
		return;
	}

	memmove(&entries[0], &entries[1], (count - 1) * sizeof(entries[0]));
	count--;
}
```

## src/tracker_backlog.h
```c
/* SPDX-License-Identifier: LicenseRef-Nordic-5-Clause */

#ifndef TRACKER_BACKLOG_H_
#define TRACKER_BACKLOG_H_

#include <stdbool.h>
#include <stddef.h>
#include <stdint.h>

#define TRACKER_RSRP_DBM_INVALID INT16_MIN
#define TRACKER_RSRQ_INVALID     INT16_MIN

struct tracker_neighbor_cell {
	uint32_t earfcn;
	uint16_t pci;
	int16_t rsrp_dbm;
	int16_t rsrq;
};

struct tracker_cell_report {
	int64_t uptime_ms;
	int mcc;
	int mnc;
	uint32_t tac;
	uint32_t cell_id;
	uint32_t earfcn;
	uint16_t pci;
	int16_t rsrp_dbm;
	int16_t rsrq;
	uint8_t ncell_count;
#if CONFIG_TRACKER_MAX_NEIGHBOR_CELLS > 0
	struct tracker_neighbor_cell ncells[CONFIG_TRACKER_MAX_NEIGHBOR_CELLS];
#endif
};

/*
 * Add a measured cell report to the RAM backlog.
 * Not synchronized: call only from the tracker's single application thread.
 */
void tracker_backlog_add(const struct tracker_cell_report *report);

/*
 * Read the oldest backlog entry without removing it.
 * Returns false if the backlog is empty.
 */
bool tracker_backlog_peek_oldest(struct tracker_cell_report *out);

/*
 * Remove the oldest backlog entry. Call only after confirmation (e.g. PUBACK)
 * that the entry was delivered.
 */
void tracker_backlog_remove_oldest(void);

#endif /* TRACKER_BACKLOG_H_ */
```

## src/tracker_modem.c
```c
/*
 * Copyright (c) 2024 Nordic Semiconductor ASA
 * SPDX-License-Identifier: LicenseRef-Nordic-5-Clause
 */

#include <errno.h>
#include <string.h>
#include <zephyr/kernel.h>
#include <zephyr/logging/log.h>
#include <zephyr/sys/atomic.h>
#include <modem/lte_lc.h>
#include <modem/nrf_modem_lib.h>

#include "tracker_modem.h"
#include "tracker_status.h"

LOG_MODULE_REGISTER(tracker_modem, LOG_LEVEL_INF);

static K_SEM_DEFINE(lte_connected, 0, 1);
static K_SEM_DEFINE(cell_meas_sem, 0, 1);

static atomic_t lte_registered;
static atomic_t meas_active;

/*
 * Written by lte_event_handler() only while holding the meas_active token
 * (claimed via atomic_cas) before giving cell_meas_sem; read by the tracker
 * thread only after taking cell_meas_sem.
 */
static struct tracker_cell_report latest_meas;
static int meas_result;

static int16_t convert_rsrp_dbm(int16_t rsrp_idx)
{
	if (rsrp_idx == LTE_LC_CELL_RSRP_INVALID) {
		return TRACKER_RSRP_DBM_INVALID;
	}

	return (rsrp_idx < 0) ? (rsrp_idx - 140) : (rsrp_idx - 141);
}

static int16_t convert_rsrq(int16_t rsrq_idx)
{
	if (rsrq_idx == LTE_LC_CELL_RSRQ_INVALID) {
		return TRACKER_RSRQ_INVALID;
	}

	return rsrq_idx;
}

static const char *network_registration_status(enum lte_lc_nw_reg_status status)
{
	switch (status) {
	case LTE_LC_NW_REG_NOT_REGISTERED:
		return "LTE NOT REGISTERED";
	case LTE_LC_NW_REG_REGISTERED_HOME:
		return "LTE REGISTERED HOME";
	case LTE_LC_NW_REG_SEARCHING:
		return "LTE SEARCHING";
	case LTE_LC_NW_REG_REGISTRATION_DENIED:
		return "LTE REGISTRATION DENIED";
	case LTE_LC_NW_REG_UNKNOWN:
		return "LTE REGISTRATION UNKNOWN";
	case LTE_LC_NW_REG_REGISTERED_ROAMING:
		return "LTE REGISTERED ROAMING";
	case LTE_LC_NW_REG_UICC_FAIL:
		return "LTE UICC FAILURE";
	case LTE_LC_NW_REG_NO_SUITABLE_CELL:
		return "LTE NO SUITABLE CELL";
	default:
		return "LTE REGISTRATION OTHER";
	}
}

static void handle_neighbor_cell_meas(const struct lte_lc_cells_info *cells)
{
	if (!atomic_cas(&meas_active, 1, 0)) {
		return;
	}

	memset(&latest_meas, 0, sizeof(latest_meas));
	if (cells->current_cell.id == LTE_LC_CELL_EUTRAN_ID_INVALID) {
		meas_result = -ENODATA;
		tracker_status_set("LTE CELL MEAS NO SERVING CELL");
		LOG_WRN("Cell measurement completed without a valid serving cell");
		k_sem_give(&cell_meas_sem);
		return;
	}

	latest_meas.uptime_ms = k_uptime_get();
	latest_meas.mcc = cells->current_cell.mcc;
	latest_meas.mnc = cells->current_cell.mnc;
	latest_meas.tac = cells->current_cell.tac;
	latest_meas.cell_id = cells->current_cell.id;
	latest_meas.earfcn = cells->current_cell.earfcn;
	latest_meas.pci = cells->current_cell.phys_cell_id;
	latest_meas.rsrp_dbm = convert_rsrp_dbm(cells->current_cell.rsrp);
	latest_meas.rsrq = convert_rsrq(cells->current_cell.rsrq);

#if CONFIG_TRACKER_MAX_NEIGHBOR_CELLS > 0
	if (cells->neighbor_cells != NULL && cells->ncells_count > 0) {
		uint8_t copy_count = cells->ncells_count;

		if (copy_count > CONFIG_TRACKER_MAX_NEIGHBOR_CELLS) {
			copy_count = CONFIG_TRACKER_MAX_NEIGHBOR_CELLS;
		}
		latest_meas.ncell_count = copy_count;
		for (uint8_t i = 0; i < copy_count; i++) {
			latest_meas.ncells[i].earfcn = cells->neighbor_cells[i].earfcn;
			latest_meas.ncells[i].pci = cells->neighbor_cells[i].phys_cell_id;
			latest_meas.ncells[i].rsrp_dbm =
				convert_rsrp_dbm(cells->neighbor_cells[i].rsrp);
			latest_meas.ncells[i].rsrq =
				convert_rsrq(cells->neighbor_cells[i].rsrq);
		}
	}
#endif

	meas_result = 0;
	tracker_status_set("LTE CELL MEAS COMPLETE");
	LOG_INF("Cell measurement: MCC=%d MNC=%d TAC=%u CID=%u PCI=%u RSRP=%d dBm (neighbors=%u)",
		latest_meas.mcc, latest_meas.mnc, latest_meas.tac,
		latest_meas.cell_id, latest_meas.pci, latest_meas.rsrp_dbm,
		latest_meas.ncell_count);
	k_sem_give(&cell_meas_sem);
}

static void lte_event_handler(const struct lte_lc_evt *const evt)
{
	switch (evt->type) {
	case LTE_LC_EVT_NW_REG_STATUS:
		tracker_status_set(network_registration_status(evt->nw_reg_status));
		if (evt->nw_reg_status == LTE_LC_NW_REG_REGISTERED_HOME ||
		    evt->nw_reg_status == LTE_LC_NW_REG_REGISTERED_ROAMING) {
			atomic_set(&lte_registered, 1);
			LOG_INF("LTE registered (%s)",
				evt->nw_reg_status == LTE_LC_NW_REG_REGISTERED_HOME ?
				"home network" : "roaming");
			k_sem_give(&lte_connected);
		} else {
			atomic_clear(&lte_registered);
		}
		break;
	case LTE_LC_EVT_PSM_UPDATE:
		tracker_status_set((evt->psm_cfg.tau >= 0 && evt->psm_cfg.active_time >= 0) ?
			"MODEM PSM GRANTED" : "MODEM PSM NOT GRANTED");
		LOG_INF("PSM update: TAU=%d s, active time=%d s",
			evt->psm_cfg.tau, evt->psm_cfg.active_time);
		break;
	case LTE_LC_EVT_RRC_UPDATE:
		LOG_INF("RRC mode: %s", evt->rrc_mode == LTE_LC_RRC_MODE_CONNECTED ?
			"connected" : "idle");
		break;
	case LTE_LC_EVT_CELL_UPDATE:
		LOG_INF("LTE cell update: id=%u, TAC=%u", evt->cell.id, evt->cell.tac);
		break;
	case LTE_LC_EVT_NEIGHBOR_CELL_MEAS:
		handle_neighbor_cell_meas(&evt->cells_info);
		break;
	case LTE_LC_EVT_MODEM_SLEEP_ENTER:
		if (evt->modem_sleep.type == LTE_LC_MODEM_SLEEP_PSM) {
			tracker_status_set("MODEM SLEEP PSM");
			LOG_INF("Modem entered PSM for %lld ms", evt->modem_sleep.time);
		}
		break;
	case LTE_LC_EVT_MODEM_SLEEP_EXIT:
		if (evt->modem_sleep.type == LTE_LC_MODEM_SLEEP_PSM) {
			tracker_status_set("MODEM WAKE PSM");
			LOG_INF("Modem exited PSM");
		}
		break;
	default:
		break;
	}
}

int tracker_modem_init(void)
{
	int err;

	tracker_status_set("MODEM LIBRARY INIT");
	LOG_INF("Initializing nRF modem library...");
	err = nrf_modem_lib_init();
	if (err != 0) {
		LOG_ERR("Failed to initialize nRF modem library: %d", err);
		return err;
	}

	lte_lc_register_handler(lte_event_handler);

	err = lte_lc_psm_param_set_seconds(CONFIG_TRACKER_PSM_PERIODIC_TAU_SECONDS,
		CONFIG_TRACKER_PSM_ACTIVE_TIME_SECONDS);
	if (err != 0) {
		LOG_ERR("Failed to configure PSM parameters: %d", err);
		return err;
	}

	err = lte_lc_psm_req(true);
	if (err != 0) {
		LOG_WRN("Failed to request PSM: %d", err);
	}

	tracker_status_set("MODEM READY");
	return 0;
}

int tracker_modem_connect(k_timeout_t timeout)
{
	int err;

	if (atomic_get(&lte_registered)) {
		tracker_status_set("LTE CONNECTION RETAINED");
		LOG_INF("LTE registration retained across sleep");
		return 0;
	}

	tracker_status_set("LTE CONNECTION");
	LOG_INF("Activating LTE for cell measurement and upload...");
	k_sem_reset(&lte_connected);
	err = lte_lc_func_mode_set(LTE_LC_FUNC_MODE_NORMAL);
	if (err != 0) {
		LOG_ERR("Failed to activate LTE: %d", err);
		return err;
	}

	err = k_sem_take(&lte_connected, timeout);
	if (err != 0) {
		tracker_status_set("LTE CONNECTION TIMEOUT");
		LOG_ERR("LTE registration timed out");
		return -ETIMEDOUT;
	}

	return 0;
}

int tracker_modem_measure_cells(struct tracker_cell_report *out, k_timeout_t timeout)
{
	struct lte_lc_ncellmeas_params params = {
		.search_type = LTE_LC_NEIGHBOR_SEARCH_TYPE_DEFAULT,
	};
	int err;

	if (out == NULL) {
		return -EINVAL;
	}

	tracker_status_set("LTE CELL MEAS START");
	LOG_INF("Starting LTE serving and neighbor cell measurement...");
	k_sem_reset(&cell_meas_sem);
	meas_result = -ENODATA;
	atomic_set(&meas_active, 1);

	err = lte_lc_neighbor_cell_measurement(&params);
	if (err != 0) {
		atomic_clear(&meas_active);
		LOG_ERR("Failed to start neighbor cell measurement: %d", err);
		return err;
	}

	err = k_sem_take(&cell_meas_sem, timeout);
	if (err != 0) {
		if (atomic_cas(&meas_active, 1, 0)) {
			(void)lte_lc_neighbor_cell_measurement_cancel();
			tracker_status_set("LTE CELL MEAS TIMEOUT");
			LOG_ERR("LTE cell measurement timed out");
			return -ETIMEDOUT;
		}
		/* Callback claimed meas_active just as the wait expired. */
		err = k_sem_take(&cell_meas_sem, K_MSEC(100));
		if (err != 0) {
			return -ETIMEDOUT;
		}
	}

	if (meas_result != 0) {
		return meas_result;
	}

	*out = latest_meas;
	return 0;
}
```

## src/tracker_modem.h
```c
/* SPDX-License-Identifier: LicenseRef-Nordic-5-Clause */

#ifndef TRACKER_MODEM_H_
#define TRACKER_MODEM_H_

#include <zephyr/kernel.h>

#include "tracker_backlog.h"

int tracker_modem_init(void);
int tracker_modem_connect(k_timeout_t timeout);
int tracker_modem_measure_cells(struct tracker_cell_report *out, k_timeout_t timeout);

#endif /* TRACKER_MODEM_H_ */
```

## src/tracker_mqtt.c
```c
/*
 * Copyright (c) 2024 Nordic Semiconductor ASA
 * SPDX-License-Identifier: LicenseRef-Nordic-5-Clause
 */

#include <errno.h>
#include <stdarg.h>
#include <stdio.h>
#include <string.h>
#include <zephyr/kernel.h>
#include <zephyr/logging/log.h>
#include <zephyr/sys/atomic.h>
#include <modem/lte_lc.h>
#include <modem/modem_key_mgmt.h>
#include <net/mqtt_helper.h>
#include <nrf_modem_at.h>

#include "tracker_mqtt.h"
#include "tracker_status.h"

LOG_MODULE_REGISTER(tracker_mqtt, LOG_LEVEL_INF);

#define IMEI_LEN 15
#define CGSN_RESPONSE_LENGTH (IMEI_LEN + 6 + 1)
#define CLIENT_ID_LEN (sizeof("nrf-") + IMEI_LEN)
#define MQTT_PAYLOAD_MAX_LEN 1024

static K_SEM_DEFINE(mqtt_conn_sem, 0, 1);
static K_SEM_DEFINE(mqtt_puback_sem, 0, 1);
static K_SEM_DEFINE(mqtt_disconnected_sem, 0, 1);

static char client_id_buf[CLIENT_ID_LEN];
static char payload_buf[MQTT_PAYLOAD_MAX_LEN];

static enum mqtt_conn_return_code connack_result;
static int puback_result;
static uint16_t pending_publish_id;
static atomic_t connect_attempted;

static const unsigned char broker_ca_certificate[] = {
#if __has_include("ca-cert.pem")
#include "ca-cert.pem"
#else
""
#endif
};

static int append_fmt(char *buf, size_t cap, size_t *pos, const char *fmt, ...)
{
	va_list args;
	int written;

	if (*pos >= cap) {
		return -EMSGSIZE;
	}

	va_start(args, fmt);
	written = vsnprintf(buf + *pos, cap - *pos, fmt, args);
	va_end(args);

	if (written < 0 || (size_t)written >= (cap - *pos)) {
		return -EMSGSIZE;
	}

	*pos += (size_t)written;
	return 0;
}

static int append_optional_int16(char *buf, size_t cap, size_t *pos,
	int16_t value, int16_t invalid_sentinel)
{
	if (value == invalid_sentinel) {
		return append_fmt(buf, cap, pos, "null");
	}
	return append_fmt(buf, cap, pos, "%d", value);
}

static int format_cell_report_json(const struct tracker_cell_report *report,
	char *buf, size_t cap, size_t *out_len)
{
	size_t pos = 0;
	int err;

	err = append_fmt(buf, cap, &pos,
		"{\"device_id\":\"%s\",\"uptime_ms\":%lld,"
		"\"source\":\"lte\",\"gnss\":null,\"lte\":{"
		"\"mcc\":%d,\"mnc\":%d,\"tac\":",
		client_id_buf, (long long)report->uptime_ms,
		report->mcc, report->mnc);
	if (err != 0) {
		return err;
	}

	if (report->tac == LTE_LC_CELL_TAC_INVALID) {
		err = append_fmt(buf, cap, &pos, "null");
	} else {
		err = append_fmt(buf, cap, &pos, "%u", report->tac);
	}
	if (err != 0) {
		return err;
	}

	err = append_fmt(buf, cap, &pos,
		",\"cid\":%u,\"earfcn\":%u,\"pci\":%u,\"rsrp\":",
		report->cell_id, report->earfcn, report->pci);
	if (err != 0) {
		return err;
	}

	err = append_optional_int16(buf, cap, &pos, report->rsrp_dbm,
		TRACKER_RSRP_DBM_INVALID);
	if (err != 0) {
		return err;
	}

	err = append_fmt(buf, cap, &pos, ",\"rsrq\":");
	if (err != 0) {
		return err;
	}

	err = append_optional_int16(buf, cap, &pos, report->rsrq,
		TRACKER_RSRQ_INVALID);
	if (err != 0) {
		return err;
	}

	err = append_fmt(buf, cap, &pos, ",\"ncells\":[");
	if (err != 0) {
		return err;
	}

#if CONFIG_TRACKER_MAX_NEIGHBOR_CELLS > 0
	for (uint8_t i = 0; i < report->ncell_count &&
	     i < CONFIG_TRACKER_MAX_NEIGHBOR_CELLS; i++) {
		const struct tracker_neighbor_cell *nc = &report->ncells[i];

		err = append_fmt(buf, cap, &pos,
			"%s{\"earfcn\":%u,\"pci\":%u,\"rsrp\":",
			(i > 0) ? "," : "", nc->earfcn, nc->pci);
		if (err != 0) {
			return err;
		}
		err = append_optional_int16(buf, cap, &pos, nc->rsrp_dbm,
			TRACKER_RSRP_DBM_INVALID);
		if (err != 0) {
			return err;
		}
		err = append_fmt(buf, cap, &pos, ",\"rsrq\":");
		if (err != 0) {
			return err;
		}
		err = append_optional_int16(buf, cap, &pos, nc->rsrq,
			TRACKER_RSRQ_INVALID);
		if (err != 0) {
			return err;
		}
		err = append_fmt(buf, cap, &pos, "}");
		if (err != 0) {
			return err;
		}
	}
#endif

	err = append_fmt(buf, cap, &pos, "]}}");
	if (err != 0) {
		return err;
	}

	*out_len = pos;
	return 0;
}

static int broker_ca_provision(void)
{
	bool exists;
	int err;
	int comparison;

	if (sizeof(broker_ca_certificate) <= 1) {
		LOG_ERR("TLS is enabled but credentials/ca-cert.pem is missing");
		return -ENOENT;
	}

	tracker_status_set("MQTT TLS CA CHECK");
	err = modem_key_mgmt_exists(CONFIG_MQTT_HELPER_SEC_TAG,
		MODEM_KEY_MGMT_CRED_TYPE_CA_CHAIN, &exists);
	if (err != 0) {
		LOG_ERR("Failed to check MQTT broker CA: %d", err);
		return err;
	}

	if (exists) {
		comparison = modem_key_mgmt_cmp(CONFIG_MQTT_HELPER_SEC_TAG,
			MODEM_KEY_MGMT_CRED_TYPE_CA_CHAIN, broker_ca_certificate,
			sizeof(broker_ca_certificate) - 1);
		if (comparison == 0) {
			tracker_status_set("MQTT TLS CA READY");
			LOG_INF("MQTT broker CA is already provisioned");
			return 0;
		}

		tracker_status_set("MQTT TLS CA DELETE");
		err = modem_key_mgmt_delete(CONFIG_MQTT_HELPER_SEC_TAG,
			MODEM_KEY_MGMT_CRED_TYPE_CA_CHAIN);
		if (err != 0) {
			LOG_ERR("Failed to replace MQTT broker CA: %d", err);
			return err;
		}
	}

	tracker_status_set("MQTT TLS CA WRITE");
	err = modem_key_mgmt_write(CONFIG_MQTT_HELPER_SEC_TAG,
		MODEM_KEY_MGMT_CRED_TYPE_CA_CHAIN, broker_ca_certificate,
		sizeof(broker_ca_certificate) - 1);
	if (err != 0) {
		LOG_ERR("Failed to provision MQTT broker CA: %d", err);
		return err;
	}

	tracker_status_set("MQTT TLS CA READY");
	LOG_INF("MQTT broker CA provisioned in sec tag %d", CONFIG_MQTT_HELPER_SEC_TAG);
	return 0;
}

static int client_id_get(char *buffer, size_t buffer_len)
{
	char imei_buf[CGSN_RESPONSE_LENGTH];
	int len;
	int err;

	if (strlen(CONFIG_MQTT_CLIENT_ID) > 0) {
		len = snprintf(buffer, buffer_len, "%s", CONFIG_MQTT_CLIENT_ID);
		if (len < 0 || (size_t)len >= buffer_len) {
			LOG_ERR("Configured MQTT client ID is too long");
			return -EMSGSIZE;
		}
		return 0;
	}

	err = nrf_modem_at_cmd(imei_buf, sizeof(imei_buf), "AT+CGSN");
	if (err != 0) {
		LOG_ERR("Failed to obtain IMEI with AT+CGSN: %d", err);
		return err;
	}

	imei_buf[IMEI_LEN] = '\0';
	len = snprintf(buffer, buffer_len, "nrf-%.*s", IMEI_LEN, imei_buf);
	if (len < 0 || (size_t)len >= buffer_len) {
		LOG_ERR("Generated MQTT client ID is too long");
		return -EMSGSIZE;
	}

	LOG_INF("Generated MQTT client ID: %s", buffer);
	return 0;
}

static void on_mqtt_connack(enum mqtt_conn_return_code return_code, bool session_present)
{
	ARG_UNUSED(session_present);

	connack_result = return_code;
	if (return_code == MQTT_CONNECTION_ACCEPTED) {
		tracker_status_set("MQTT CONNECTED");
		LOG_INF("Connected to MQTT broker: %s:%d", CONFIG_MQTT_BROKER_HOSTNAME,
			CONFIG_MQTT_BROKER_PORT);
	} else {
		tracker_status_set("MQTT CONNECTION REJECTED");
		LOG_ERR("MQTT broker rejected connection: %d", return_code);
	}

	k_sem_give(&mqtt_conn_sem);
}

static void on_mqtt_disconnect(int result)
{
	atomic_clear(&connect_attempted);
	tracker_status_set("MQTT DISCONNECTED");
	if (result == 0) {
		LOG_INF("MQTT client disconnected");
	} else {
		LOG_WRN("MQTT client disconnected with result: %d", result);
	}
	k_sem_give(&mqtt_disconnected_sem);
}

static void on_mqtt_puback(uint16_t message_id, int result)
{
	if (message_id != pending_publish_id) {
		LOG_WRN("Unexpected MQTT PUBACK ID: %u", message_id);
		return;
	}

	puback_result = result;
	if (result != 0) {
		tracker_status_set("MQTT PUBLISH ACK ERROR");
		LOG_ERR("MQTT PUBACK failed for ID %u: %d", message_id, result);
	} else {
		tracker_status_set("MQTT PUBLISH ACKNOWLEDGED");
		LOG_INF("MQTT broker acknowledged cell report (ID: %u)", message_id);
	}
	k_sem_give(&mqtt_puback_sem);
}

int tracker_mqtt_init(void)
{
	struct mqtt_helper_cfg mqtt_cfg = {
		.cb = {
			.on_connack = on_mqtt_connack,
			.on_disconnect = on_mqtt_disconnect,
			.on_puback = on_mqtt_puback,
		},
	};
	int err;

	tracker_status_set("MQTT INIT");

	if (strlen(CONFIG_MQTT_BROKER_PASSWORD) > 0 &&
	    strlen(CONFIG_MQTT_BROKER_USERNAME) == 0) {
		LOG_ERR("MQTT password is configured without a username");
		return -EINVAL;
	}

	if (IS_ENABLED(CONFIG_MQTT_LIB_TLS)) {
		err = broker_ca_provision();
		if (err != 0) {
			return err;
		}
	}

	err = mqtt_helper_init(&mqtt_cfg);
	if (err != 0) {
		LOG_ERR("Failed to initialize MQTT helper: %d", err);
		return err;
	}

	err = client_id_get(client_id_buf, sizeof(client_id_buf));
	if (err == 0) {
		tracker_status_set("MQTT READY");
	}

	return err;
}

int tracker_mqtt_connect(k_timeout_t timeout)
{
	struct mqtt_helper_conn_params conn_params = {
		.hostname.ptr = CONFIG_MQTT_BROKER_HOSTNAME,
		.hostname.size = strlen(CONFIG_MQTT_BROKER_HOSTNAME),
		.device_id.ptr = client_id_buf,
		.device_id.size = strlen(client_id_buf),
		.user_name.ptr = CONFIG_MQTT_BROKER_USERNAME,
		.user_name.size = strlen(CONFIG_MQTT_BROKER_USERNAME),
		.password.ptr = CONFIG_MQTT_BROKER_PASSWORD,
		.password.size = strlen(CONFIG_MQTT_BROKER_PASSWORD),
	};
	int err;

	tracker_status_set("MQTT CONNECTION");
	LOG_INF("Connecting to MQTT broker (%s:%d)...", CONFIG_MQTT_BROKER_HOSTNAME,
		CONFIG_MQTT_BROKER_PORT);
	k_sem_reset(&mqtt_conn_sem);
	connack_result = MQTT_UNACCEPTABLE_PROTOCOL_VERSION;
	err = mqtt_helper_connect(&conn_params);
	if (err != 0) {
		LOG_ERR("MQTT connection attempt failed: %d", err);
		return err;
	}
	atomic_set(&connect_attempted, 1);

	err = k_sem_take(&mqtt_conn_sem, timeout);
	if (err != 0) {
		tracker_status_set("MQTT CONNECTION TIMEOUT");
		LOG_ERR("MQTT CONNACK timed out");
		return -ETIMEDOUT;
	}
	if (connack_result != MQTT_CONNECTION_ACCEPTED) {
		return -ECONNREFUSED;
	}

	return 0;
}

int tracker_mqtt_publish_cell_report(
	const struct tracker_cell_report *report, k_timeout_t timeout)
{
	struct mqtt_publish_param param = {0};
	size_t payload_len = 0;
	int err;

	if (report == NULL) {
		return -EINVAL;
	}

	err = format_cell_report_json(report, payload_buf, sizeof(payload_buf), &payload_len);
	if (err != 0) {
		LOG_ERR("Cell report JSON formatting failed or was truncated: %d", err);
		return err;
	}

	param.message.payload.data = (uint8_t *)payload_buf;
	param.message.payload.len = payload_len;
	param.message.topic.qos = (enum mqtt_qos)CONFIG_MQTT_PUB_QOS;
	param.message.topic.topic.utf8 = CONFIG_MQTT_PUB_TOPIC;
	param.message.topic.topic.size = strlen(CONFIG_MQTT_PUB_TOPIC);
	pending_publish_id = mqtt_helper_msg_id_get();
	param.message_id = pending_publish_id;

	tracker_status_set("MQTT PUBLISH");
	LOG_INF("Publishing cell report to '%s' (QoS %d, %zu bytes): %s",
		CONFIG_MQTT_PUB_TOPIC, CONFIG_MQTT_PUB_QOS, payload_len, payload_buf);
	if (CONFIG_MQTT_PUB_QOS == MQTT_QOS_1_AT_LEAST_ONCE) {
		k_sem_reset(&mqtt_puback_sem);
		puback_result = 0;
	}

	err = mqtt_helper_publish(&param);
	if (err != 0) {
		LOG_ERR("Failed to publish MQTT message: %d", err);
		return err;
	}

	if (CONFIG_MQTT_PUB_QOS == MQTT_QOS_0_AT_MOST_ONCE) {
		tracker_status_set("MQTT PUBLISH COMPLETE");
		return 0;
	}

	err = k_sem_take(&mqtt_puback_sem, timeout);
	if (err != 0) {
		tracker_status_set("MQTT PUBLISH ACK TIMEOUT");
		LOG_ERR("MQTT PUBACK timed out");
		return -ETIMEDOUT;
	}

	return puback_result;
}

int tracker_mqtt_disconnect(k_timeout_t timeout)
{
	int err;

	if (!atomic_get(&connect_attempted)) {
		tracker_status_set("MQTT DISCONNECTED");
		return 0;
	}

	tracker_status_set("MQTT DISCONNECT");
	k_sem_reset(&mqtt_disconnected_sem);
	err = mqtt_helper_disconnect();
	if (err != 0) {
		LOG_ERR("Failed to disconnect MQTT: %d", err);
		return err;
	}

	err = k_sem_take(&mqtt_disconnected_sem, timeout);
	if (err != 0) {
		LOG_WRN("MQTT disconnect timed out");
		return -ETIMEDOUT;
	}

	return 0;
}
```

## src/tracker_mqtt.h
```c
/* SPDX-License-Identifier: LicenseRef-Nordic-5-Clause */

#ifndef TRACKER_MQTT_H_
#define TRACKER_MQTT_H_

#include <zephyr/kernel.h>

#include "tracker_backlog.h"

int tracker_mqtt_init(void);
int tracker_mqtt_connect(k_timeout_t timeout);
int tracker_mqtt_publish_cell_report(
	const struct tracker_cell_report *report, k_timeout_t timeout);
int tracker_mqtt_disconnect(k_timeout_t timeout);

#endif /* TRACKER_MQTT_H_ */
```

## src/tracker_status.h
```c
/* SPDX-License-Identifier: LicenseRef-Nordic-5-Clause */

#ifndef TRACKER_STATUS_H_
#define TRACKER_STATUS_H_

void tracker_status_set(const char *label);

#endif /* TRACKER_STATUS_H_ */
```

## src/tracker_ui.c
```c
/*
 * Copyright (c) 2024 Nordic Semiconductor ASA
 * SPDX-License-Identifier: LicenseRef-Nordic-5-Clause
 */

#include <errno.h>
#include <zephyr/kernel.h>
#include <zephyr/logging/log.h>
#include <zephyr/sys/atomic.h>
#if defined(CONFIG_STARTUP_LED)
#include <zephyr/drivers/gpio.h>
#endif
#if IS_ENABLED(CONFIG_ENABLE_LEDS)
#include <dk_buttons_and_leds.h>
#endif

#include "tracker_ui.h"

LOG_MODULE_REGISTER(tracker_ui, LOG_LEVEL_INF);

#if defined(CONFIG_STARTUP_LED)
#define STARTUP_LED_NODE DT_ALIAS(led0)

#if !DT_NODE_HAS_STATUS(STARTUP_LED_NODE, okay)
#error "CONFIG_STARTUP_LED requires a ready led0 devicetree alias"
#endif

static const struct gpio_dt_spec startup_led = GPIO_DT_SPEC_GET(STARTUP_LED_NODE, gpios);
static struct k_work_delayable working_led_work;
static bool working_led_state;
static bool working_led_ready;
static atomic_t requested_state = ATOMIC_INIT(TRACKER_UI_IDLE);
static enum tracker_ui_state displayed_state = TRACKER_UI_IDLE;
static unsigned int completed_blinks;

static void working_led_blink_handler(struct k_work *work)
{
	int err;
	int delay_ms = CONFIG_WORKING_LED_BLINK_INTERVAL_MS;
	enum tracker_ui_state state = atomic_get(&requested_state);
	unsigned int blink_count = 0;

	ARG_UNUSED(work);
	switch (state) {
	case TRACKER_UI_LTE:
		blink_count = 2;
		break;
	case TRACKER_UI_CELL_SCAN:
		blink_count = 3;
		break;
	case TRACKER_UI_MQTT:
		blink_count = 4;
		break;
	case TRACKER_UI_IDLE:
		break;
	}

	if (state != displayed_state) {
		displayed_state = state;
		completed_blinks = 0;
		working_led_state = false;
		delay_ms = CONFIG_WORKING_LED_GROUP_PAUSE_MS;
	} else if (blink_count == 0) {
		working_led_state = false;
		delay_ms = CONFIG_WORKING_LED_GROUP_PAUSE_MS;
	} else {
		working_led_state = !working_led_state;
		if (!working_led_state && ++completed_blinks == blink_count) {
			completed_blinks = 0;
			delay_ms = CONFIG_WORKING_LED_GROUP_PAUSE_MS;
		}
	}

	err = gpio_pin_set_dt(&startup_led, working_led_state);
	if (err != 0) {
		LOG_ERR("Failed to update working LED: %d", err);
		return;
	}

	if (state == TRACKER_UI_IDLE) {
		return;
	}

	err = k_work_reschedule(&working_led_work, K_MSEC(delay_ms));
	if (err < 0) {
		LOG_ERR("Failed to reschedule working LED: %d", err);
	}
}

static int working_led_start(void)
{
	int err;

	if (!gpio_is_ready_dt(&startup_led)) {
		return -ENODEV;
	}

	err = gpio_pin_configure_dt(&startup_led, GPIO_OUTPUT_INACTIVE);
	if (err != 0) {
		return err;
	}

	working_led_state = false;
	k_work_init_delayable(&working_led_work, working_led_blink_handler);
	working_led_ready = true;
	return 0;
}
#endif

int tracker_ui_init(void)
{
#if defined(CONFIG_STARTUP_LED) || defined(CONFIG_ENABLE_LEDS)
	int err;
#endif

#if defined(CONFIG_STARTUP_LED)
	err = working_led_start();
	if (err != 0) {
		return err;
	}
	LOG_INF("Status LED pulse interval: %d ms",
		CONFIG_WORKING_LED_BLINK_INTERVAL_MS);
#endif

#if IS_ENABLED(CONFIG_ENABLE_LEDS)
	err = dk_leds_init();
	if (err != 0) {
		LOG_ERR("Failed to initialize status LEDs: %d", err);
		return err;
	}
#endif

	return 0;
}

void tracker_ui_set_state(enum tracker_ui_state state)
{
#if defined(CONFIG_STARTUP_LED)
	if ((enum tracker_ui_state)atomic_set(&requested_state, state) != state &&
	    working_led_ready) {
		int err;

		if (state == TRACKER_UI_IDLE) {
			struct k_work_sync sync;

			(void)k_work_cancel_delayable_sync(&working_led_work, &sync);
			working_led_state = false;
			displayed_state = TRACKER_UI_IDLE;
			completed_blinks = 0;
			err = gpio_pin_set_dt(&startup_led, 0);
			if (err != 0) {
				LOG_ERR("Failed to turn off status LED: %d", err);
			}
		} else {
			err = k_work_reschedule(&working_led_work, K_NO_WAIT);
			if (err < 0) {
				LOG_ERR("Failed to schedule status LED: %d", err);
			}
		}
	}
#endif
#if IS_ENABLED(CONFIG_ENABLE_LEDS)
	(void)dk_set_leds(0);
	switch (state) {
	case TRACKER_UI_LTE:
		(void)dk_set_led_on(DK_LED1);
		break;
	case TRACKER_UI_CELL_SCAN:
		(void)dk_set_led_on(DK_LED2);
		break;
	case TRACKER_UI_MQTT:
		(void)dk_set_led_on(DK_LED4);
		break;
	case TRACKER_UI_IDLE:
		break;
	}
#else
	ARG_UNUSED(state);
#endif
}
```

## src/tracker_ui.h
```c
/* SPDX-License-Identifier: LicenseRef-Nordic-5-Clause */

#ifndef TRACKER_UI_H_
#define TRACKER_UI_H_

enum tracker_ui_state {
	TRACKER_UI_IDLE,
	TRACKER_UI_LTE,
	TRACKER_UI_CELL_SCAN,
	TRACKER_UI_MQTT,
};

int tracker_ui_init(void);
void tracker_ui_set_state(enum tracker_ui_state state);

#endif /* TRACKER_UI_H_ */
```
